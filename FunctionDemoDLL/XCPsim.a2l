ASAP2_VERSION 1 71
/begin PROJECT XCPsim ""
/begin MODULE CPP ""
/begin MOD_COMMON "" ALIGNMENT_BYTE 1 ALIGNMENT_WORD 1 ALIGNMENT_LONG 1 ALIGNMENT_FLOAT16_IEEE 1 ALIGNMENT_FLOAT32_IEEE 1 ALIGNMENT_FLOAT64_IEEE 1 ALIGNMENT_INT64 1 /end MOD_COMMON
/begin CHARACTERISTIC CALRAM_START "" VALUE 0x1C0000 __UWord_Value_ColumnDir 0 NO_COMPU_METHOD 0 65535 FORMAT "%.15" /end CHARACTERISTIC
/begin MEASUREMENT DtChannel1 "Time jitter of channel1" FLOAT32_IEEE DtChannel1.Calculation 0 0 0 100 FORMAT "%.3" /begin VIRTUAL channel1 /end VIRTUAL /end MEASUREMENT
/begin MEASUREMENT KL1Output "Value generated from curve KL1" UBYTE Identity 0 0 0 255 ECU_ADDRESS 0x1BDDD2 FORMAT "%.3" SYMBOL_LINK "curveOutput" 0 /end MEASUREMENT
/begin MEASUREMENT MaxChannel1 "Maximum value of channel1" FLOAT32_IEEE MaxChannel1.Calculation 0 0 -100 100 FORMAT "%.3" /begin VIRTUAL channel1 /end VIRTUAL /end MEASUREMENT
/begin MEASUREMENT MinChannel1 "Minimum value of channel1" FLOAT32_IEEE MinChannel1.Calculation 0 0 -100 100 FORMAT "%.3" /begin VIRTUAL channel1 /end VIRTUAL /end MEASUREMENT
/begin MEASUREMENT TestByte_000 "" UBYTE Identity 0 0 0 255 ECU_ADDRESS 0x1BE11C FORMAT "%.0" SYMBOL_LINK "testByte000" 4 /end MEASUREMENT
/begin MEASUREMENT TestByte_015 "" UBYTE Identity 0 0 0 255 ECU_ADDRESS 0x1BE158 FORMAT "%.0" SYMBOL_LINK "testByte000" 64 /end MEASUREMENT
/begin MEASUREMENT TestByte_016 "" UBYTE Identity 0 0 0 255 ECU_ADDRESS 0x1BE15C FORMAT "%.0" SYMBOL_LINK "testByte000" 68 /end MEASUREMENT
/begin MEASUREMENT TestByte_023 "" UBYTE Identity 0 0 0 255 ECU_ADDRESS 0x1BE178 FORMAT "%.0" SYMBOL_LINK "testByte000" 96 /end MEASUREMENT
/begin MEASUREMENT TestByte_024 "" UBYTE Identity 0 0 0 255 ECU_ADDRESS 0x1BE17C FORMAT "%.0" SYMBOL_LINK "testByte000" 100 /end MEASUREMENT
/begin MEASUREMENT TestByte_034 "" UBYTE Identity 0 0 0 255 ECU_ADDRESS 0x1BE1A4 FORMAT "%.0" SYMBOL_LINK "testByte000" 140 /end MEASUREMENT
/begin MEASUREMENT TestByte_059 "" UBYTE Identity 0 0 0 255 ECU_ADDRESS 0x1BE208 FORMAT "%.0" SYMBOL_LINK "testByte000" 240 /end MEASUREMENT
/begin MEASUREMENT TestByte_061 "" UBYTE Identity 0 0 0 255 ECU_ADDRESS 0x1BE210 FORMAT "%.0" SYMBOL_LINK "testByte000" 248 /end MEASUREMENT
/begin MEASUREMENT TestByte_063 "" UBYTE Identity 0 0 0 255 ECU_ADDRESS 0x1BE218 FORMAT "%.0" SYMBOL_LINK "testByte000" 256 /end MEASUREMENT
/begin MEASUREMENT TestByte_064 "" UBYTE Identity 0 0 0 255 ECU_ADDRESS 0x1BE21C FORMAT "%.0" SYMBOL_LINK "testByte000" 260 /end MEASUREMENT
/begin MEASUREMENT TestByte_097 "" UBYTE Identity 0 0 0 255 ECU_ADDRESS 0x1BE2A0 FORMAT "%.0" SYMBOL_LINK "testByte000" 392 /end MEASUREMENT
/begin MEASUREMENT TestByte_107 "" UBYTE Identity 0 0 0 255 ECU_ADDRESS 0x1BE2C8 FORMAT "%.0" SYMBOL_LINK "testByte000" 432 /end MEASUREMENT
/begin MEASUREMENT TestByte_131 "" UBYTE Identity 0 0 0 255 ECU_ADDRESS 0x1BE328 FORMAT "%.0" SYMBOL_LINK "testByte000" 528 /end MEASUREMENT
/begin MEASUREMENT TestByte_156 "" UBYTE Identity 0 0 0 255 ECU_ADDRESS 0x1BE38C FORMAT "%.0" SYMBOL_LINK "testByte000" 628 /end MEASUREMENT
/begin MEASUREMENT TestByte_159 "" UBYTE Identity 0 0 0 255 ECU_ADDRESS 0x1BE398 FORMAT "%.0" SYMBOL_LINK "testByte000" 640 /end MEASUREMENT
/begin MEASUREMENT TestByte_182 "" UBYTE Identity 0 0 0 255 ECU_ADDRESS 0x1BE3F4 FORMAT "%.0" SYMBOL_LINK "testByte000" 732 /end MEASUREMENT
/begin MEASUREMENT TestByte_183 "" UBYTE Identity 0 0 0 255 ECU_ADDRESS 0x1BE3F8 FORMAT "%.0" SYMBOL_LINK "testByte000" 736 /end MEASUREMENT
/begin MEASUREMENT TestByte_189 "" UBYTE Identity 0 0 0 255 ECU_ADDRESS 0x1BE410 FORMAT "%.0" SYMBOL_LINK "testByte000" 760 /end MEASUREMENT
/begin MEASUREMENT TestByte_195 "" UBYTE Identity 0 0 0 255 ECU_ADDRESS 0x1BE428 FORMAT "%.0" SYMBOL_LINK "testByte000" 784 /end MEASUREMENT
/begin MEASUREMENT TestByte_216 "" UBYTE Identity 0 0 0 255 ECU_ADDRESS 0x1BE47C FORMAT "%.0" SYMBOL_LINK "testByte000" 868 /end MEASUREMENT
/begin MEASUREMENT TestByte_218 "" UBYTE Identity 0 0 0 255 ECU_ADDRESS 0x1BE484 FORMAT "%.0" SYMBOL_LINK "testByte000" 876 /end MEASUREMENT
/begin MEASUREMENT TestByte_221 "" UBYTE Identity 0 0 0 255 ECU_ADDRESS 0x1BE490 FORMAT "%.0" SYMBOL_LINK "testByte000" 888 /end MEASUREMENT
/begin MEASUREMENT TestByte_251 "" UBYTE Identity 0 0 0 255 ECU_ADDRESS 0x1BE508 FORMAT "%.0" SYMBOL_LINK "testByte000" 1008 /end MEASUREMENT
/begin MEASUREMENT TestByte_263 "" UBYTE Identity 0 0 0 255 ECU_ADDRESS 0x1BE538 FORMAT "%.0" SYMBOL_LINK "testByte000" 1056 /end MEASUREMENT
/begin MEASUREMENT TestByte_276 "" UBYTE Identity 0 0 0 255 ECU_ADDRESS 0x1BE56C FORMAT "%.0" SYMBOL_LINK "testByte000" 1108 /end MEASUREMENT
/begin MEASUREMENT TestByte_277 "" UBYTE Identity 0 0 0 255 ECU_ADDRESS 0x1BE570 FORMAT "%.0" SYMBOL_LINK "testByte000" 1112 /end MEASUREMENT
/begin MEASUREMENT TestByte_297 "" UBYTE Identity 0 0 0 255 ECU_ADDRESS 0x1BE5C0 FORMAT "%.0" SYMBOL_LINK "testByte000" 1192 /end MEASUREMENT
/begin MEASUREMENT TestByte_302 "" UBYTE Identity 0 0 0 255 ECU_ADDRESS 0x1BE5D4 FORMAT "%.0" SYMBOL_LINK "testByte000" 1212 /end MEASUREMENT
/begin MEASUREMENT TestByte_324 "" UBYTE Identity 0 0 0 255 ECU_ADDRESS 0x1BE62C FORMAT "%.0" SYMBOL_LINK "testByte000" 1300 /end MEASUREMENT
/begin MEASUREMENT TestByte_344 "" UBYTE Identity 0 0 0 255 ECU_ADDRESS 0x1BE67C FORMAT "%.0" SYMBOL_LINK "testByte000" 1380 /end MEASUREMENT
/begin MEASUREMENT TestByte_346 "" UBYTE Identity 0 0 0 255 ECU_ADDRESS 0x1BE684 FORMAT "%.0" SYMBOL_LINK "testByte000" 1388 /end MEASUREMENT
/begin MEASUREMENT TestByte_354 "" UBYTE Identity 0 0 0 255 ECU_ADDRESS 0x1BE6A4 FORMAT "%.0" SYMBOL_LINK "testByte000" 1420 /end MEASUREMENT
/begin MEASUREMENT TestByte_359 "" UBYTE Identity 0 0 0 255 ECU_ADDRESS 0x1BE6B8 FORMAT "%.0" SYMBOL_LINK "testByte000" 1440 /end MEASUREMENT
/begin MEASUREMENT TestByte_378 "" UBYTE Identity 0 0 0 255 ECU_ADDRESS 0x1BE704 FORMAT "%.0" SYMBOL_LINK "testByte000" 1516 /end MEASUREMENT
/begin MEASUREMENT TestByte_402 "" UBYTE Identity 0 0 0 255 ECU_ADDRESS 0x1BE764 FORMAT "%.0" SYMBOL_LINK "testByte000" 1612 /end MEASUREMENT
/begin MEASUREMENT TestByte_403 "" UBYTE Identity 0 0 0 255 ECU_ADDRESS 0x1BE768 FORMAT "%.0" SYMBOL_LINK "testByte000" 1616 /end MEASUREMENT
/begin MEASUREMENT TestByte_406 "" UBYTE Identity 0 0 0 255 ECU_ADDRESS 0x1BE774 FORMAT "%.0" SYMBOL_LINK "testByte000" 1628 /end MEASUREMENT
/begin MEASUREMENT TestByte_413 "" UBYTE Identity 0 0 0 255 ECU_ADDRESS 0x1BE790 FORMAT "%.0" SYMBOL_LINK "testByte000" 1656 /end MEASUREMENT
/begin MEASUREMENT TestByte_414 "" UBYTE Identity 0 0 0 255 ECU_ADDRESS 0x1BE794 FORMAT "%.0" SYMBOL_LINK "testByte000" 1660 /end MEASUREMENT
/begin MEASUREMENT TestByte_415 "" UBYTE Identity 0 0 0 255 ECU_ADDRESS 0x1BE798 FORMAT "%.0" SYMBOL_LINK "testByte000" 1664 /end MEASUREMENT
/begin MEASUREMENT TestByte_427 "" UBYTE Identity 0 0 0 255 ECU_ADDRESS 0x1BE7C8 FORMAT "%.0" SYMBOL_LINK "testByte000" 1712 /end MEASUREMENT
/begin MEASUREMENT TestByte_438 "" UBYTE Identity 0 0 0 255 ECU_ADDRESS 0x1BE7F4 FORMAT "%.0" SYMBOL_LINK "testByte000" 1756 /end MEASUREMENT
/begin MEASUREMENT TestByte_446 "" UBYTE Identity 0 0 0 255 ECU_ADDRESS 0x1BE814 FORMAT "%.0" SYMBOL_LINK "testByte000" 1788 /end MEASUREMENT
/begin MEASUREMENT TestByte_448 "" UBYTE Identity 0 0 0 255 ECU_ADDRESS 0x1BE81C FORMAT "%.0" SYMBOL_LINK "testByte000" 1796 /end MEASUREMENT
/begin MEASUREMENT TestByte_451 "" UBYTE Identity 0 0 0 255 ECU_ADDRESS 0x1BE828 FORMAT "%.0" SYMBOL_LINK "testByte000" 1808 /end MEASUREMENT
/begin MEASUREMENT TestByte_462 "" UBYTE Identity 0 0 0 255 ECU_ADDRESS 0x1BE854 FORMAT "%.0" SYMBOL_LINK "testByte000" 1852 /end MEASUREMENT
/begin MEASUREMENT TestByte_466 "" UBYTE Identity 0 0 0 255 ECU_ADDRESS 0x1BE864 FORMAT "%.0" SYMBOL_LINK "testByte000" 1868 /end MEASUREMENT
/begin MEASUREMENT TestByte_469 "" UBYTE Identity 0 0 0 255 ECU_ADDRESS 0x1BE870 FORMAT "%.0" SYMBOL_LINK "testByte000" 1880 /end MEASUREMENT
/begin MEASUREMENT TestByte_486 "" UBYTE Identity 0 0 0 255 ECU_ADDRESS 0x1BE8B4 FORMAT "%.0" SYMBOL_LINK "testByte000" 1948 /end MEASUREMENT
/begin MEASUREMENT TestByte_494 "" UBYTE Identity 0 0 0 255 ECU_ADDRESS 0x1BE8D4 FORMAT "%.0" SYMBOL_LINK "testByte000" 1980 /end MEASUREMENT
/begin MEASUREMENT TestByte_500 "" UBYTE Identity 0 0 0 255 ECU_ADDRESS 0x1BE8EC FORMAT "%.0" SYMBOL_LINK "testByte000" 2004 /end MEASUREMENT
/begin MEASUREMENT TestByte_527 "" UBYTE Identity 0 0 0 255 ECU_ADDRESS 0x1BE958 FORMAT "%.0" SYMBOL_LINK "testByte000" 2112 /end MEASUREMENT
/begin MEASUREMENT TestByte_530 "" UBYTE Identity 0 0 0 255 ECU_ADDRESS 0x1BE964 FORMAT "%.0" SYMBOL_LINK "testByte000" 2124 /end MEASUREMENT
/begin MEASUREMENT TestByte_533 "" UBYTE Identity 0 0 0 255 ECU_ADDRESS 0x1BE970 FORMAT "%.0" SYMBOL_LINK "testByte000" 2136 /end MEASUREMENT
/begin MEASUREMENT TestByte_556 "" UBYTE Identity 0 0 0 255 ECU_ADDRESS 0x1BE9CC FORMAT "%.0" SYMBOL_LINK "testByte000" 2228 /end MEASUREMENT
/begin MEASUREMENT TestByte_589 "" UBYTE Identity 0 0 0 255 ECU_ADDRESS 0x1BEA50 FORMAT "%.0" SYMBOL_LINK "testByte000" 2360 /end MEASUREMENT
/begin MEASUREMENT TestByte_590 "" UBYTE Identity 0 0 0 255 ECU_ADDRESS 0x1BEA54 FORMAT "%.0" SYMBOL_LINK "testByte000" 2364 /end MEASUREMENT
/begin MEASUREMENT TestByte_591 "" UBYTE Identity 0 0 0 255 ECU_ADDRESS 0x1BEA58 FORMAT "%.0" SYMBOL_LINK "testByte000" 2368 /end MEASUREMENT
/begin MEASUREMENT TestByte_592 "" UBYTE Identity 0 0 0 255 ECU_ADDRESS 0x1BEA5C FORMAT "%.0" SYMBOL_LINK "testByte000" 2372 /end MEASUREMENT
/begin MEASUREMENT TestByte_598 "" UBYTE Identity 0 0 0 255 ECU_ADDRESS 0x1BEA74 FORMAT "%.0" SYMBOL_LINK "testByte000" 2396 /end MEASUREMENT
/begin MEASUREMENT TestByte_606 "" UBYTE Identity 0 0 0 255 ECU_ADDRESS 0x1BEA94 FORMAT "%.0" SYMBOL_LINK "testByte000" 2428 /end MEASUREMENT
/begin MEASUREMENT TestByte_608 "" UBYTE Identity 0 0 0 255 ECU_ADDRESS 0x1BEA9C FORMAT "%.0" SYMBOL_LINK "testByte000" 2436 /end MEASUREMENT
/begin MEASUREMENT TestByte_618 "" UBYTE Identity 0 0 0 255 ECU_ADDRESS 0x1BEAC4 FORMAT "%.0" SYMBOL_LINK "testByte000" 2476 /end MEASUREMENT
/begin MEASUREMENT TestByte_621 "" UBYTE Identity 0 0 0 255 ECU_ADDRESS 0x1BEAD0 FORMAT "%.0" SYMBOL_LINK "testByte000" 2488 /end MEASUREMENT
/begin MEASUREMENT TestByte_627 "" UBYTE Identity 0 0 0 255 ECU_ADDRESS 0x1BEAE8 FORMAT "%.0" SYMBOL_LINK "testByte000" 2512 /end MEASUREMENT
/begin MEASUREMENT TestByte_638 "" UBYTE Identity 0 0 0 255 ECU_ADDRESS 0x1BEB14 FORMAT "%.0" SYMBOL_LINK "testByte000" 2556 /end MEASUREMENT
/begin MEASUREMENT TestByte_644 "" UBYTE Identity 0 0 0 255 ECU_ADDRESS 0x1BEB2C FORMAT "%.0" SYMBOL_LINK "testByte000" 2580 /end MEASUREMENT
/begin MEASUREMENT TestByte_647 "" UBYTE Identity 0 0 0 255 ECU_ADDRESS 0x1BEB38 FORMAT "%.0" SYMBOL_LINK "testByte000" 2592 /end MEASUREMENT
/begin MEASUREMENT TestByte_648 "" UBYTE Identity 0 0 0 255 ECU_ADDRESS 0x1BEB3C FORMAT "%.0" SYMBOL_LINK "testByte000" 2596 /end MEASUREMENT
/begin MEASUREMENT TestByte_659 "" UBYTE Identity 0 0 0 255 ECU_ADDRESS 0x1BEB68 FORMAT "%.0" SYMBOL_LINK "testByte000" 2640 /end MEASUREMENT
/begin MEASUREMENT TestByte_668 "" UBYTE Identity 0 0 0 255 ECU_ADDRESS 0x1BEB8C FORMAT "%.0" SYMBOL_LINK "testByte000" 2676 /end MEASUREMENT
/begin MEASUREMENT TestByte_700 "" UBYTE Identity 0 0 0 255 ECU_ADDRESS 0x1BEC0C FORMAT "%.0" SYMBOL_LINK "testByte000" 2804 /end MEASUREMENT
/begin MEASUREMENT TestByte_711 "" UBYTE Identity 0 0 0 255 ECU_ADDRESS 0x1BEC38 FORMAT "%.0" SYMBOL_LINK "testByte000" 2848 /end MEASUREMENT
/begin MEASUREMENT TestByte_715 "" UBYTE Identity 0 0 0 255 ECU_ADDRESS 0x1BEC48 FORMAT "%.0" SYMBOL_LINK "testByte000" 2864 /end MEASUREMENT
/begin MEASUREMENT TestByte_728 "" UBYTE Identity 0 0 0 255 ECU_ADDRESS 0x1BEC7C FORMAT "%.0" SYMBOL_LINK "testByte000" 2916 /end MEASUREMENT
/begin MEASUREMENT TestByte_731 "" UBYTE Identity 0 0 0 255 ECU_ADDRESS 0x1BEC88 FORMAT "%.0" SYMBOL_LINK "testByte000" 2928 /end MEASUREMENT
/begin MEASUREMENT TestByte_732 "" UBYTE Identity 0 0 0 255 ECU_ADDRESS 0x1BEC8C FORMAT "%.0" SYMBOL_LINK "testByte000" 2932 /end MEASUREMENT
/begin MEASUREMENT TestByte_738 "" UBYTE Identity 0 0 0 255 ECU_ADDRESS 0x1BECA4 FORMAT "%.0" SYMBOL_LINK "testByte000" 2956 /end MEASUREMENT
/begin MEASUREMENT TestByte_746 "" UBYTE Identity 0 0 0 255 ECU_ADDRESS 0x1BECC4 FORMAT "%.0" SYMBOL_LINK "testByte000" 2988 /end MEASUREMENT
/begin MEASUREMENT TestByte_752 "" UBYTE Identity 0 0 0 255 ECU_ADDRESS 0x1BECDC FORMAT "%.0" SYMBOL_LINK "testByte000" 3012 /end MEASUREMENT
/begin MEASUREMENT TestByte_774 "" UBYTE Identity 0 0 0 255 ECU_ADDRESS 0x1BED34 FORMAT "%.0" SYMBOL_LINK "testByte000" 3100 /end MEASUREMENT
/begin MEASUREMENT TestByte_777 "" UBYTE Identity 0 0 0 255 ECU_ADDRESS 0x1BED40 FORMAT "%.0" SYMBOL_LINK "testByte000" 3112 /end MEASUREMENT
/begin MEASUREMENT TestByte_778 "" UBYTE Identity 0 0 0 255 ECU_ADDRESS 0x1BED44 FORMAT "%.0" SYMBOL_LINK "testByte000" 3116 /end MEASUREMENT
/begin MEASUREMENT TestByte_784 "" UBYTE Identity 0 0 0 255 ECU_ADDRESS 0x1BED5C FORMAT "%.0" SYMBOL_LINK "testByte000" 3140 /end MEASUREMENT
/begin MEASUREMENT TestByte_786 "" UBYTE Identity 0 0 0 255 ECU_ADDRESS 0x1BED64 FORMAT "%.0" SYMBOL_LINK "testByte000" 3148 /end MEASUREMENT
/begin MEASUREMENT TestByte_789 "" UBYTE Identity 0 0 0 255 ECU_ADDRESS 0x1BED70 FORMAT "%.0" SYMBOL_LINK "testByte000" 3160 /end MEASUREMENT
/begin MEASUREMENT TestByte_793 "" UBYTE Identity 0 0 0 255 ECU_ADDRESS 0x1BED80 FORMAT "%.0" SYMBOL_LINK "testByte000" 3176 /end MEASUREMENT
/begin MEASUREMENT TestByte_798 "" UBYTE Identity 0 0 0 255 ECU_ADDRESS 0x1BED94 FORMAT "%.0" SYMBOL_LINK "testByte000" 3196 /end MEASUREMENT
/begin MEASUREMENT TestByte_855 "" UBYTE Identity 0 0 0 255 ECU_ADDRESS 0x1BEE78 FORMAT "%.0" SYMBOL_LINK "testByte000" 3424 /end MEASUREMENT
/begin MEASUREMENT TestByte_857 "" UBYTE Identity 0 0 0 255 ECU_ADDRESS 0x1BEE80 FORMAT "%.0" SYMBOL_LINK "testByte000" 3432 /end MEASUREMENT
/begin MEASUREMENT TestByte_861 "" UBYTE Identity 0 0 0 255 ECU_ADDRESS 0x1BEE90 FORMAT "%.0" SYMBOL_LINK "testByte000" 3448 /end MEASUREMENT
/begin MEASUREMENT TestByte_865 "" UBYTE Identity 0 0 0 255 ECU_ADDRESS 0x1BEEA0 FORMAT "%.0" SYMBOL_LINK "testByte000" 3464 /end MEASUREMENT
/begin MEASUREMENT TestByte_880 "" UBYTE Identity 0 0 0 255 ECU_ADDRESS 0x1BEEDC FORMAT "%.0" SYMBOL_LINK "testByte000" 3524 /end MEASUREMENT
/begin MEASUREMENT TestByte_902 "" UBYTE Identity 0 0 0 255 ECU_ADDRESS 0x1BEF34 FORMAT "%.0" SYMBOL_LINK "testByte000" 3612 /end MEASUREMENT
/begin MEASUREMENT TestByte_905 "" UBYTE Identity 0 0 0 255 ECU_ADDRESS 0x1BEF40 FORMAT "%.0" SYMBOL_LINK "testByte000" 3624 /end MEASUREMENT
/begin MEASUREMENT TestByte_934 "" UBYTE Identity 0 0 0 255 ECU_ADDRESS 0x1BEFB4 FORMAT "%.0" SYMBOL_LINK "testByte000" 3740 /end MEASUREMENT
/begin MEASUREMENT TestByte_938 "" UBYTE Identity 0 0 0 255 ECU_ADDRESS 0x1BEFC4 FORMAT "%.0" SYMBOL_LINK "testByte000" 3756 /end MEASUREMENT
/begin MEASUREMENT TestByte_947 "" UBYTE Identity 0 0 0 255 ECU_ADDRESS 0x1BEFE8 FORMAT "%.0" SYMBOL_LINK "testByte000" 3792 /end MEASUREMENT
/begin MEASUREMENT TestByte_951 "" UBYTE Identity 0 0 0 255 ECU_ADDRESS 0x1BEFF8 FORMAT "%.0" SYMBOL_LINK "testByte000" 3808 /end MEASUREMENT
/begin MEASUREMENT TestByte_961 "" UBYTE Identity 0 0 0 255 ECU_ADDRESS 0x1BF020 FORMAT "%.0" SYMBOL_LINK "testByte000" 3848 /end MEASUREMENT
/begin MEASUREMENT TestByte_965 "" UBYTE Identity 0 0 0 255 ECU_ADDRESS 0x1BF030 FORMAT "%.0" SYMBOL_LINK "testByte000" 3864 /end MEASUREMENT
/begin MEASUREMENT TestByte_974 "" UBYTE Identity 0 0 0 255 ECU_ADDRESS 0x1BF054 FORMAT "%.0" SYMBOL_LINK "testByte000" 3900 /end MEASUREMENT
/begin MEASUREMENT TestByte_976 "" UBYTE Identity 0 0 0 255 ECU_ADDRESS 0x1BF05C FORMAT "%.0" SYMBOL_LINK "testByte000" 3908 /end MEASUREMENT
/begin MEASUREMENT TestByte_981 "" UBYTE Identity 0 0 0 255 ECU_ADDRESS 0x1BF070 FORMAT "%.0" SYMBOL_LINK "testByte000" 3928 /end MEASUREMENT
/begin MEASUREMENT TestByte_983 "" UBYTE Identity 0 0 0 255 ECU_ADDRESS 0x1BF078 FORMAT "%.0" SYMBOL_LINK "testByte000" 3936 /end MEASUREMENT
/begin MEASUREMENT TestByte_993 "" UBYTE Identity 0 0 0 255 ECU_ADDRESS 0x1BF0A0 FORMAT "%.0" SYMBOL_LINK "testByte000" 3976 /end MEASUREMENT
/begin MEASUREMENT TestDWord_002 "" ULONG Identity 0 0 0 255 ECU_ADDRESS 0x1BE124 FORMAT "%.0" SYMBOL_LINK "testByte000" 12 /end MEASUREMENT
/begin MEASUREMENT TestDWord_010 "" ULONG Identity 0 0 0 255 ECU_ADDRESS 0x1BE144 FORMAT "%.0" SYMBOL_LINK "testByte000" 44 /end MEASUREMENT
/begin MEASUREMENT TestDWord_018 "" ULONG Identity 0 0 0 255 ECU_ADDRESS 0x1BE164 FORMAT "%.0" SYMBOL_LINK "testByte000" 76 /end MEASUREMENT
/begin MEASUREMENT TestDWord_019 "" ULONG Identity 0 0 0 255 ECU_ADDRESS 0x1BE168 FORMAT "%.0" SYMBOL_LINK "testByte000" 80 /end MEASUREMENT
/begin MEASUREMENT TestDWord_022 "" ULONG Identity 0 0 0 255 ECU_ADDRESS 0x1BE174 FORMAT "%.0" SYMBOL_LINK "testByte000" 92 /end MEASUREMENT
/begin MEASUREMENT TestDWord_030 "" ULONG Identity 0 0 0 255 ECU_ADDRESS 0x1BE194 FORMAT "%.0" SYMBOL_LINK "testByte000" 124 /end MEASUREMENT
/begin MEASUREMENT TestDWord_045 "" ULONG Identity 0 0 0 255 ECU_ADDRESS 0x1BE1D0 FORMAT "%.0" SYMBOL_LINK "testByte000" 184 /end MEASUREMENT
/begin MEASUREMENT TestDWord_047 "" ULONG Identity 0 0 0 255 ECU_ADDRESS 0x1BE1D8 FORMAT "%.0" SYMBOL_LINK "testByte000" 192 /end MEASUREMENT
/begin MEASUREMENT TestDWord_049 "" ULONG Identity 0 0 0 255 ECU_ADDRESS 0x1BE1E0 FORMAT "%.0" SYMBOL_LINK "testByte000" 200 /end MEASUREMENT
/begin MEASUREMENT TestDWord_056 "" ULONG Identity 0 0 0 255 ECU_ADDRESS 0x1BE1FC FORMAT "%.0" SYMBOL_LINK "testByte000" 228 /end MEASUREMENT
/begin MEASUREMENT TestDWord_057 "" ULONG Identity 0 0 0 255 ECU_ADDRESS 0x1BE200 FORMAT "%.0" SYMBOL_LINK "testByte000" 232 /end MEASUREMENT
/begin MEASUREMENT TestDWord_066 "" ULONG Identity 0 0 0 255 ECU_ADDRESS 0x1BE224 FORMAT "%.0" SYMBOL_LINK "testByte000" 268 /end MEASUREMENT
/begin MEASUREMENT TestDWord_067 "" ULONG Identity 0 0 0 255 ECU_ADDRESS 0x1BE228 FORMAT "%.0" SYMBOL_LINK "testByte000" 272 /end MEASUREMENT
/begin MEASUREMENT TestDWord_073 "" ULONG Identity 0 0 0 255 ECU_ADDRESS 0x1BE240 FORMAT "%.0" SYMBOL_LINK "testByte000" 296 /end MEASUREMENT
/begin MEASUREMENT TestDWord_079 "" ULONG Identity 0 0 0 255 ECU_ADDRESS 0x1BE258 FORMAT "%.0" SYMBOL_LINK "testByte000" 320 /end MEASUREMENT
/begin MEASUREMENT TestDWord_086 "" ULONG Identity 0 0 0 255 ECU_ADDRESS 0x1BE274 FORMAT "%.0" SYMBOL_LINK "testByte000" 348 /end MEASUREMENT
/begin MEASUREMENT TestDWord_087 "" ULONG Identity 0 0 0 255 ECU_ADDRESS 0x1BE278 FORMAT "%.0" SYMBOL_LINK "testByte000" 352 /end MEASUREMENT
/begin MEASUREMENT TestDWord_094 "" ULONG Identity 0 0 0 255 ECU_ADDRESS 0x1BE294 FORMAT "%.0" SYMBOL_LINK "testByte000" 380 /end MEASUREMENT
/begin MEASUREMENT TestDWord_100 "" ULONG Identity 0 0 0 255 ECU_ADDRESS 0x1BE2AC FORMAT "%.0" SYMBOL_LINK "testByte000" 404 /end MEASUREMENT
/begin MEASUREMENT TestDWord_102 "" ULONG Identity 0 0 0 255 ECU_ADDRESS 0x1BE2B4 FORMAT "%.0" SYMBOL_LINK "testByte000" 412 /end MEASUREMENT
/begin MEASUREMENT TestDWord_110 "" ULONG Identity 0 0 0 255 ECU_ADDRESS 0x1BE2D4 FORMAT "%.0" SYMBOL_LINK "testByte000" 444 /end MEASUREMENT
/begin MEASUREMENT TestDWord_114 "" ULONG Identity 0 0 0 255 ECU_ADDRESS 0x1BE2E4 FORMAT "%.0" SYMBOL_LINK "testByte000" 460 /end MEASUREMENT
/begin MEASUREMENT TestDWord_115 "" ULONG Identity 0 0 0 255 ECU_ADDRESS 0x1BE2E8 FORMAT "%.0" SYMBOL_LINK "testByte000" 464 /end MEASUREMENT
/begin MEASUREMENT TestDWord_118 "" ULONG Identity 0 0 0 255 ECU_ADDRESS 0x1BE2F4 FORMAT "%.0" SYMBOL_LINK "testByte000" 476 /end MEASUREMENT
/begin MEASUREMENT TestDWord_122 "" ULONG Identity 0 0 0 255 ECU_ADDRESS 0x1BE304 FORMAT "%.0" SYMBOL_LINK "testByte000" 492 /end MEASUREMENT
/begin MEASUREMENT TestDWord_128 "" ULONG Identity 0 0 0 255 ECU_ADDRESS 0x1BE31C FORMAT "%.0" SYMBOL_LINK "testByte000" 516 /end MEASUREMENT
/begin MEASUREMENT TestDWord_135 "" ULONG Identity 0 0 0 255 ECU_ADDRESS 0x1BE338 FORMAT "%.0" SYMBOL_LINK "testByte000" 544 /end MEASUREMENT
/begin MEASUREMENT TestDWord_145 "" ULONG Identity 0 0 0 255 ECU_ADDRESS 0x1BE360 FORMAT "%.0" SYMBOL_LINK "testByte000" 584 /end MEASUREMENT
/begin MEASUREMENT TestDWord_147 "" ULONG Identity 0 0 0 255 ECU_ADDRESS 0x1BE368 FORMAT "%.0" SYMBOL_LINK "testByte000" 592 /end MEASUREMENT
/begin MEASUREMENT TestDWord_150 "" ULONG Identity 0 0 0 255 ECU_ADDRESS 0x1BE374 FORMAT "%.0" SYMBOL_LINK "testByte000" 604 /end MEASUREMENT
/begin MEASUREMENT TestDWord_161 "" ULONG Identity 0 0 0 255 ECU_ADDRESS 0x1BE3A0 FORMAT "%.0" SYMBOL_LINK "testByte000" 648 /end MEASUREMENT
/begin MEASUREMENT TestDWord_165 "" ULONG Identity 0 0 0 255 ECU_ADDRESS 0x1BE3B0 FORMAT "%.0" SYMBOL_LINK "testByte000" 664 /end MEASUREMENT
/begin MEASUREMENT TestDWord_167 "" ULONG Identity 0 0 0 255 ECU_ADDRESS 0x1BE3B8 FORMAT "%.0" SYMBOL_LINK "testByte000" 672 /end MEASUREMENT
/begin MEASUREMENT TestDWord_168 "" ULONG Identity 0 0 0 255 ECU_ADDRESS 0x1BE3BC FORMAT "%.0" SYMBOL_LINK "testByte000" 676 /end MEASUREMENT
/begin MEASUREMENT TestDWord_172 "" ULONG Identity 0 0 0 255 ECU_ADDRESS 0x1BE3CC FORMAT "%.0" SYMBOL_LINK "testByte000" 692 /end MEASUREMENT
/begin MEASUREMENT TestDWord_174 "" ULONG Identity 0 0 0 255 ECU_ADDRESS 0x1BE3D4 FORMAT "%.0" SYMBOL_LINK "testByte000" 700 /end MEASUREMENT
/begin MEASUREMENT TestDWord_180 "" ULONG Identity 0 0 0 255 ECU_ADDRESS 0x1BE3EC FORMAT "%.0" SYMBOL_LINK "testByte000" 724 /end MEASUREMENT
/begin MEASUREMENT TestDWord_181 "" ULONG Identity 0 0 0 255 ECU_ADDRESS 0x1BE3F0 FORMAT "%.0" SYMBOL_LINK "testByte000" 728 /end MEASUREMENT
/begin MEASUREMENT TestDWord_186 "" ULONG Identity 0 0 0 255 ECU_ADDRESS 0x1BE404 FORMAT "%.0" SYMBOL_LINK "testByte000" 748 /end MEASUREMENT
/begin MEASUREMENT TestDWord_187 "" ULONG Identity 0 0 0 255 ECU_ADDRESS 0x1BE408 FORMAT "%.0" SYMBOL_LINK "testByte000" 752 /end MEASUREMENT
/begin MEASUREMENT TestDWord_190 "" ULONG Identity 0 0 0 255 ECU_ADDRESS 0x1BE414 FORMAT "%.0" SYMBOL_LINK "testByte000" 764 /end MEASUREMENT
/begin MEASUREMENT TestDWord_197 "" ULONG Identity 0 0 0 255 ECU_ADDRESS 0x1BE430 FORMAT "%.0" SYMBOL_LINK "testByte000" 792 /end MEASUREMENT
/begin MEASUREMENT TestDWord_199 "" ULONG Identity 0 0 0 255 ECU_ADDRESS 0x1BE438 FORMAT "%.0" SYMBOL_LINK "testByte000" 800 /end MEASUREMENT
/begin MEASUREMENT TestDWord_201 "" ULONG Identity 0 0 0 255 ECU_ADDRESS 0x1BE440 FORMAT "%.0" SYMBOL_LINK "testByte000" 808 /end MEASUREMENT
/begin MEASUREMENT TestDWord_205 "" ULONG Identity 0 0 0 255 ECU_ADDRESS 0x1BE450 FORMAT "%.0" SYMBOL_LINK "testByte000" 824 /end MEASUREMENT
/begin MEASUREMENT TestDWord_210 "" ULONG Identity 0 0 0 255 ECU_ADDRESS 0x1BE464 FORMAT "%.0" SYMBOL_LINK "testByte000" 844 /end MEASUREMENT
/begin MEASUREMENT TestDWord_212 "" ULONG Identity 0 0 0 255 ECU_ADDRESS 0x1BE46C FORMAT "%.0" SYMBOL_LINK "testByte000" 852 /end MEASUREMENT
/begin MEASUREMENT TestDWord_223 "" ULONG Identity 0 0 0 255 ECU_ADDRESS 0x1BE498 FORMAT "%.0" SYMBOL_LINK "testByte000" 896 /end MEASUREMENT
/begin MEASUREMENT TestDWord_224 "" ULONG Identity 0 0 0 255 ECU_ADDRESS 0x1BE49C FORMAT "%.0" SYMBOL_LINK "testByte000" 900 /end MEASUREMENT
/begin MEASUREMENT TestDWord_227 "" ULONG Identity 0 0 0 255 ECU_ADDRESS 0x1BE4A8 FORMAT "%.0" SYMBOL_LINK "testByte000" 912 /end MEASUREMENT
/begin MEASUREMENT TestDWord_240 "" ULONG Identity 0 0 0 255 ECU_ADDRESS 0x1BE4DC FORMAT "%.0" SYMBOL_LINK "testByte000" 964 /end MEASUREMENT
/begin MEASUREMENT TestDWord_244 "" ULONG Identity 0 0 0 255 ECU_ADDRESS 0x1BE4EC FORMAT "%.0" SYMBOL_LINK "testByte000" 980 /end MEASUREMENT
/begin MEASUREMENT TestDWord_245 "" ULONG Identity 0 0 0 255 ECU_ADDRESS 0x1BE4F0 FORMAT "%.0" SYMBOL_LINK "testByte000" 984 /end MEASUREMENT
/begin MEASUREMENT TestDWord_257 "" ULONG Identity 0 0 0 255 ECU_ADDRESS 0x1BE520 FORMAT "%.0" SYMBOL_LINK "testByte000" 1032 /end MEASUREMENT
/begin MEASUREMENT TestDWord_269 "" ULONG Identity 0 0 0 255 ECU_ADDRESS 0x1BE550 FORMAT "%.0" SYMBOL_LINK "testByte000" 1080 /end MEASUREMENT
/begin MEASUREMENT TestDWord_270 "" ULONG Identity 0 0 0 255 ECU_ADDRESS 0x1BE554 FORMAT "%.0" SYMBOL_LINK "testByte000" 1084 /end MEASUREMENT
/begin MEASUREMENT TestDWord_274 "" ULONG Identity 0 0 0 255 ECU_ADDRESS 0x1BE564 FORMAT "%.0" SYMBOL_LINK "testByte000" 1100 /end MEASUREMENT
/begin MEASUREMENT TestDWord_283 "" ULONG Identity 0 0 0 255 ECU_ADDRESS 0x1BE588 FORMAT "%.0" SYMBOL_LINK "testByte000" 1136 /end MEASUREMENT
/begin MEASUREMENT TestDWord_286 "" ULONG Identity 0 0 0 255 ECU_ADDRESS 0x1BE594 FORMAT "%.0" SYMBOL_LINK "testByte000" 1148 /end MEASUREMENT
/begin MEASUREMENT TestDWord_296 "" ULONG Identity 0 0 0 255 ECU_ADDRESS 0x1BE5BC FORMAT "%.0" SYMBOL_LINK "testByte000" 1188 /end MEASUREMENT
/begin MEASUREMENT TestDWord_306 "" ULONG Identity 0 0 0 255 ECU_ADDRESS 0x1BE5E4 FORMAT "%.0" SYMBOL_LINK "testByte000" 1228 /end MEASUREMENT
/begin MEASUREMENT TestDWord_308 "" ULONG Identity 0 0 0 255 ECU_ADDRESS 0x1BE5EC FORMAT "%.0" SYMBOL_LINK "testByte000" 1236 /end MEASUREMENT
/begin MEASUREMENT TestDWord_309 "" ULONG Identity 0 0 0 255 ECU_ADDRESS 0x1BE5F0 FORMAT "%.0" SYMBOL_LINK "testByte000" 1240 /end MEASUREMENT
/begin MEASUREMENT TestDWord_313 "" ULONG Identity 0 0 0 255 ECU_ADDRESS 0x1BE600 FORMAT "%.0" SYMBOL_LINK "testByte000" 1256 /end MEASUREMENT
/begin MEASUREMENT TestDWord_326 "" ULONG Identity 0 0 0 255 ECU_ADDRESS 0x1BE634 FORMAT "%.0" SYMBOL_LINK "testByte000" 1308 /end MEASUREMENT
/begin MEASUREMENT TestDWord_338 "" ULONG Identity 0 0 0 255 ECU_ADDRESS 0x1BE664 FORMAT "%.0" SYMBOL_LINK "testByte000" 1356 /end MEASUREMENT
/begin MEASUREMENT TestDWord_340 "" ULONG Identity 0 0 0 255 ECU_ADDRESS 0x1BE66C FORMAT "%.0" SYMBOL_LINK "testByte000" 1364 /end MEASUREMENT
/begin MEASUREMENT TestDWord_348 "" ULONG Identity 0 0 0 255 ECU_ADDRESS 0x1BE68C FORMAT "%.0" SYMBOL_LINK "testByte000" 1396 /end MEASUREMENT
/begin MEASUREMENT TestDWord_355 "" ULONG Identity 0 0 0 255 ECU_ADDRESS 0x1BE6A8 FORMAT "%.0" SYMBOL_LINK "testByte000" 1424 /end MEASUREMENT
/begin MEASUREMENT TestDWord_358 "" ULONG Identity 0 0 0 255 ECU_ADDRESS 0x1BE6B4 FORMAT "%.0" SYMBOL_LINK "testByte000" 1436 /end MEASUREMENT
/begin MEASUREMENT TestDWord_360 "" ULONG Identity 0 0 0 255 ECU_ADDRESS 0x1BE6BC FORMAT "%.0" SYMBOL_LINK "testByte000" 1444 /end MEASUREMENT
/begin MEASUREMENT TestDWord_372 "" ULONG Identity 0 0 0 255 ECU_ADDRESS 0x1BE6EC FORMAT "%.0" SYMBOL_LINK "testByte000" 1492 /end MEASUREMENT
/begin MEASUREMENT TestDWord_375 "" ULONG Identity 0 0 0 255 ECU_ADDRESS 0x1BE6F8 FORMAT "%.0" SYMBOL_LINK "testByte000" 1504 /end MEASUREMENT
/begin MEASUREMENT TestDWord_376 "" ULONG Identity 0 0 0 255 ECU_ADDRESS 0x1BE6FC FORMAT "%.0" SYMBOL_LINK "testByte000" 1508 /end MEASUREMENT
/begin MEASUREMENT TestDWord_383 "" ULONG Identity 0 0 0 255 ECU_ADDRESS 0x1BE718 FORMAT "%.0" SYMBOL_LINK "testByte000" 1536 /end MEASUREMENT
/begin MEASUREMENT TestDWord_385 "" ULONG Identity 0 0 0 255 ECU_ADDRESS 0x1BE720 FORMAT "%.0" SYMBOL_LINK "testByte000" 1544 /end MEASUREMENT
/begin MEASUREMENT TestDWord_387 "" ULONG Identity 0 0 0 255 ECU_ADDRESS 0x1BE728 FORMAT "%.0" SYMBOL_LINK "testByte000" 1552 /end MEASUREMENT
/begin MEASUREMENT TestDWord_388 "" ULONG Identity 0 0 0 255 ECU_ADDRESS 0x1BE72C FORMAT "%.0" SYMBOL_LINK "testByte000" 1556 /end MEASUREMENT
/begin MEASUREMENT TestDWord_396 "" ULONG Identity 0 0 0 255 ECU_ADDRESS 0x1BE74C FORMAT "%.0" SYMBOL_LINK "testByte000" 1588 /end MEASUREMENT
/begin MEASUREMENT TestDWord_398 "" ULONG Identity 0 0 0 255 ECU_ADDRESS 0x1BE754 FORMAT "%.0" SYMBOL_LINK "testByte000" 1596 /end MEASUREMENT
/begin MEASUREMENT TestDWord_399 "" ULONG Identity 0 0 0 255 ECU_ADDRESS 0x1BE758 FORMAT "%.0" SYMBOL_LINK "testByte000" 1600 /end MEASUREMENT
/begin MEASUREMENT TestDWord_407 "" ULONG Identity 0 0 0 255 ECU_ADDRESS 0x1BE778 FORMAT "%.0" SYMBOL_LINK "testByte000" 1632 /end MEASUREMENT
/begin MEASUREMENT TestDWord_409 "" ULONG Identity 0 0 0 255 ECU_ADDRESS 0x1BE780 FORMAT "%.0" SYMBOL_LINK "testByte000" 1640 /end MEASUREMENT
/begin MEASUREMENT TestDWord_410 "" ULONG Identity 0 0 0 255 ECU_ADDRESS 0x1BE784 FORMAT "%.0" SYMBOL_LINK "testByte000" 1644 /end MEASUREMENT
/begin MEASUREMENT TestDWord_411 "" ULONG Identity 0 0 0 255 ECU_ADDRESS 0x1BE788 FORMAT "%.0" SYMBOL_LINK "testByte000" 1648 /end MEASUREMENT
/begin MEASUREMENT TestDWord_426 "" ULONG Identity 0 0 0 255 ECU_ADDRESS 0x1BE7C4 FORMAT "%.0" SYMBOL_LINK "testByte000" 1708 /end MEASUREMENT
/begin MEASUREMENT TestDWord_431 "" ULONG Identity 0 0 0 255 ECU_ADDRESS 0x1BE7D8 FORMAT "%.0" SYMBOL_LINK "testByte000" 1728 /end MEASUREMENT
/begin MEASUREMENT TestDWord_433 "" ULONG Identity 0 0 0 255 ECU_ADDRESS 0x1BE7E0 FORMAT "%.0" SYMBOL_LINK "testByte000" 1736 /end MEASUREMENT
/begin MEASUREMENT TestDWord_443 "" ULONG Identity 0 0 0 255 ECU_ADDRESS 0x1BE808 FORMAT "%.0" SYMBOL_LINK "testByte000" 1776 /end MEASUREMENT
/begin MEASUREMENT TestDWord_444 "" ULONG Identity 0 0 0 255 ECU_ADDRESS 0x1BE80C FORMAT "%.0" SYMBOL_LINK "testByte000" 1780 /end MEASUREMENT
/begin MEASUREMENT TestDWord_458 "" ULONG Identity 0 0 0 255 ECU_ADDRESS 0x1BE844 FORMAT "%.0" SYMBOL_LINK "testByte000" 1836 /end MEASUREMENT
/begin MEASUREMENT TestDWord_470 "" ULONG Identity 0 0 0 255 ECU_ADDRESS 0x1BE874 FORMAT "%.0" SYMBOL_LINK "testByte000" 1884 /end MEASUREMENT
/begin MEASUREMENT TestDWord_471 "" ULONG Identity 0 0 0 255 ECU_ADDRESS 0x1BE878 FORMAT "%.0" SYMBOL_LINK "testByte000" 1888 /end MEASUREMENT
/begin MEASUREMENT TestDWord_474 "" ULONG Identity 0 0 0 255 ECU_ADDRESS 0x1BE884 FORMAT "%.0" SYMBOL_LINK "testByte000" 1900 /end MEASUREMENT
/begin MEASUREMENT TestDWord_478 "" ULONG Identity 0 0 0 255 ECU_ADDRESS 0x1BE894 FORMAT "%.0" SYMBOL_LINK "testByte000" 1916 /end MEASUREMENT
/begin MEASUREMENT TestDWord_479 "" ULONG Identity 0 0 0 255 ECU_ADDRESS 0x1BE898 FORMAT "%.0" SYMBOL_LINK "testByte000" 1920 /end MEASUREMENT
/begin MEASUREMENT TestDWord_480 "" ULONG Identity 0 0 0 255 ECU_ADDRESS 0x1BE89C FORMAT "%.0" SYMBOL_LINK "testByte000" 1924 /end MEASUREMENT
/begin MEASUREMENT TestDWord_483 "" ULONG Identity 0 0 0 255 ECU_ADDRESS 0x1BE8A8 FORMAT "%.0" SYMBOL_LINK "testByte000" 1936 /end MEASUREMENT
/begin MEASUREMENT TestDWord_488 "" ULONG Identity 0 0 0 255 ECU_ADDRESS 0x1BE8BC FORMAT "%.0" SYMBOL_LINK "testByte000" 1956 /end MEASUREMENT
/begin MEASUREMENT TestDWord_492 "" ULONG Identity 0 0 0 255 ECU_ADDRESS 0x1BE8CC FORMAT "%.0" SYMBOL_LINK "testByte000" 1972 /end MEASUREMENT
/begin MEASUREMENT TestDWord_496 "" ULONG Identity 0 0 0 255 ECU_ADDRESS 0x1BE8DC FORMAT "%.0" SYMBOL_LINK "testByte000" 1988 /end MEASUREMENT
/begin MEASUREMENT TestDWord_501 "" ULONG Identity 0 0 0 255 ECU_ADDRESS 0x1BE8F0 FORMAT "%.0" SYMBOL_LINK "testByte000" 2008 /end MEASUREMENT
/begin MEASUREMENT TestDWord_502 "" ULONG Identity 0 0 0 255 ECU_ADDRESS 0x1BE8F4 FORMAT "%.0" SYMBOL_LINK "testByte000" 2012 /end MEASUREMENT
/begin MEASUREMENT TestDWord_503 "" ULONG Identity 0 0 0 255 ECU_ADDRESS 0x1BE8F8 FORMAT "%.0" SYMBOL_LINK "testByte000" 2016 /end MEASUREMENT
/begin MEASUREMENT TestDWord_504 "" ULONG Identity 0 0 0 255 ECU_ADDRESS 0x1BE8FC FORMAT "%.0" SYMBOL_LINK "testByte000" 2020 /end MEASUREMENT
/begin MEASUREMENT TestDWord_508 "" ULONG Identity 0 0 0 255 ECU_ADDRESS 0x1BE90C FORMAT "%.0" SYMBOL_LINK "testByte000" 2036 /end MEASUREMENT
/begin MEASUREMENT TestDWord_516 "" ULONG Identity 0 0 0 255 ECU_ADDRESS 0x1BE92C FORMAT "%.0" SYMBOL_LINK "testByte000" 2068 /end MEASUREMENT
/begin MEASUREMENT TestDWord_524 "" ULONG Identity 0 0 0 255 ECU_ADDRESS 0x1BE94C FORMAT "%.0" SYMBOL_LINK "testByte000" 2100 /end MEASUREMENT
/begin MEASUREMENT TestDWord_529 "" ULONG Identity 0 0 0 255 ECU_ADDRESS 0x1BE960 FORMAT "%.0" SYMBOL_LINK "testByte000" 2120 /end MEASUREMENT
/begin MEASUREMENT TestDWord_534 "" ULONG Identity 0 0 0 255 ECU_ADDRESS 0x1BE974 FORMAT "%.0" SYMBOL_LINK "testByte000" 2140 /end MEASUREMENT
/begin MEASUREMENT TestDWord_535 "" ULONG Identity 0 0 0 255 ECU_ADDRESS 0x1BE978 FORMAT "%.0" SYMBOL_LINK "testByte000" 2144 /end MEASUREMENT
/begin MEASUREMENT TestDWord_545 "" ULONG Identity 0 0 0 255 ECU_ADDRESS 0x1BE9A0 FORMAT "%.0" SYMBOL_LINK "testByte000" 2184 /end MEASUREMENT
/begin MEASUREMENT TestDWord_550 "" ULONG Identity 0 0 0 255 ECU_ADDRESS 0x1BE9B4 FORMAT "%.0" SYMBOL_LINK "testByte000" 2204 /end MEASUREMENT
/begin MEASUREMENT TestDWord_557 "" ULONG Identity 0 0 0 255 ECU_ADDRESS 0x1BE9D0 FORMAT "%.0" SYMBOL_LINK "testByte000" 2232 /end MEASUREMENT
/begin MEASUREMENT TestDWord_558 "" ULONG Identity 0 0 0 255 ECU_ADDRESS 0x1BE9D4 FORMAT "%.0" SYMBOL_LINK "testByte000" 2236 /end MEASUREMENT
/begin MEASUREMENT TestDWord_575 "" ULONG Identity 0 0 0 255 ECU_ADDRESS 0x1BEA18 FORMAT "%.0" SYMBOL_LINK "testByte000" 2304 /end MEASUREMENT
/begin MEASUREMENT TestDWord_576 "" ULONG Identity 0 0 0 255 ECU_ADDRESS 0x1BEA1C FORMAT "%.0" SYMBOL_LINK "testByte000" 2308 /end MEASUREMENT
/begin MEASUREMENT TestDWord_577 "" ULONG Identity 0 0 0 255 ECU_ADDRESS 0x1BEA20 FORMAT "%.0" SYMBOL_LINK "testByte000" 2312 /end MEASUREMENT
/begin MEASUREMENT TestDWord_582 "" ULONG Identity 0 0 0 255 ECU_ADDRESS 0x1BEA34 FORMAT "%.0" SYMBOL_LINK "testByte000" 2332 /end MEASUREMENT
/begin MEASUREMENT TestDWord_584 "" ULONG Identity 0 0 0 255 ECU_ADDRESS 0x1BEA3C FORMAT "%.0" SYMBOL_LINK "testByte000" 2340 /end MEASUREMENT
/begin MEASUREMENT TestDWord_596 "" ULONG Identity 0 0 0 255 ECU_ADDRESS 0x1BEA6C FORMAT "%.0" SYMBOL_LINK "testByte000" 2388 /end MEASUREMENT
/begin MEASUREMENT TestDWord_601 "" ULONG Identity 0 0 0 255 ECU_ADDRESS 0x1BEA80 FORMAT "%.0" SYMBOL_LINK "testByte000" 2408 /end MEASUREMENT
/begin MEASUREMENT TestDWord_620 "" ULONG Identity 0 0 0 255 ECU_ADDRESS 0x1BEACC FORMAT "%.0" SYMBOL_LINK "testByte000" 2484 /end MEASUREMENT
/begin MEASUREMENT TestDWord_624 "" ULONG Identity 0 0 0 255 ECU_ADDRESS 0x1BEADC FORMAT "%.0" SYMBOL_LINK "testByte000" 2500 /end MEASUREMENT
/begin MEASUREMENT TestDWord_643 "" ULONG Identity 0 0 0 255 ECU_ADDRESS 0x1BEB28 FORMAT "%.0" SYMBOL_LINK "testByte000" 2576 /end MEASUREMENT
/begin MEASUREMENT TestDWord_669 "" ULONG Identity 0 0 0 255 ECU_ADDRESS 0x1BEB90 FORMAT "%.0" SYMBOL_LINK "testByte000" 2680 /end MEASUREMENT
/begin MEASUREMENT TestDWord_671 "" ULONG Identity 0 0 0 255 ECU_ADDRESS 0x1BEB98 FORMAT "%.0" SYMBOL_LINK "testByte000" 2688 /end MEASUREMENT
/begin MEASUREMENT TestDWord_675 "" ULONG Identity 0 0 0 255 ECU_ADDRESS 0x1BEBA8 FORMAT "%.0" SYMBOL_LINK "testByte000" 2704 /end MEASUREMENT
/begin MEASUREMENT TestDWord_679 "" ULONG Identity 0 0 0 255 ECU_ADDRESS 0x1BEBB8 FORMAT "%.0" SYMBOL_LINK "testByte000" 2720 /end MEASUREMENT
/begin MEASUREMENT TestDWord_684 "" ULONG Identity 0 0 0 255 ECU_ADDRESS 0x1BEBCC FORMAT "%.0" SYMBOL_LINK "testByte000" 2740 /end MEASUREMENT
/begin MEASUREMENT TestDWord_691 "" ULONG Identity 0 0 0 255 ECU_ADDRESS 0x1BEBE8 FORMAT "%.0" SYMBOL_LINK "testByte000" 2768 /end MEASUREMENT
/begin MEASUREMENT TestDWord_693 "" ULONG Identity 0 0 0 255 ECU_ADDRESS 0x1BEBF0 FORMAT "%.0" SYMBOL_LINK "testByte000" 2776 /end MEASUREMENT
/begin MEASUREMENT TestDWord_694 "" ULONG Identity 0 0 0 255 ECU_ADDRESS 0x1BEBF4 FORMAT "%.0" SYMBOL_LINK "testByte000" 2780 /end MEASUREMENT
/begin MEASUREMENT TestDWord_697 "" ULONG Identity 0 0 0 255 ECU_ADDRESS 0x1BEC00 FORMAT "%.0" SYMBOL_LINK "testByte000" 2792 /end MEASUREMENT
/begin MEASUREMENT TestDWord_703 "" ULONG Identity 0 0 0 255 ECU_ADDRESS 0x1BEC18 FORMAT "%.0" SYMBOL_LINK "testByte000" 2816 /end MEASUREMENT
/begin MEASUREMENT TestDWord_708 "" ULONG Identity 0 0 0 255 ECU_ADDRESS 0x1BEC2C FORMAT "%.0" SYMBOL_LINK "testByte000" 2836 /end MEASUREMENT
/begin MEASUREMENT TestDWord_714 "" ULONG Identity 0 0 0 255 ECU_ADDRESS 0x1BEC44 FORMAT "%.0" SYMBOL_LINK "testByte000" 2860 /end MEASUREMENT
/begin MEASUREMENT TestDWord_716 "" ULONG Identity 0 0 0 255 ECU_ADDRESS 0x1BEC4C FORMAT "%.0" SYMBOL_LINK "testByte000" 2868 /end MEASUREMENT
/begin MEASUREMENT TestDWord_722 "" ULONG Identity 0 0 0 255 ECU_ADDRESS 0x1BEC64 FORMAT "%.0" SYMBOL_LINK "testByte000" 2892 /end MEASUREMENT
/begin MEASUREMENT TestDWord_724 "" ULONG Identity 0 0 0 255 ECU_ADDRESS 0x1BEC6C FORMAT "%.0" SYMBOL_LINK "testByte000" 2900 /end MEASUREMENT
/begin MEASUREMENT TestDWord_725 "" ULONG Identity 0 0 0 255 ECU_ADDRESS 0x1BEC70 FORMAT "%.0" SYMBOL_LINK "testByte000" 2904 /end MEASUREMENT
/begin MEASUREMENT TestDWord_727 "" ULONG Identity 0 0 0 255 ECU_ADDRESS 0x1BEC78 FORMAT "%.0" SYMBOL_LINK "testByte000" 2912 /end MEASUREMENT
/begin MEASUREMENT TestDWord_730 "" ULONG Identity 0 0 0 255 ECU_ADDRESS 0x1BEC84 FORMAT "%.0" SYMBOL_LINK "testByte000" 2924 /end MEASUREMENT
/begin MEASUREMENT TestDWord_748 "" ULONG Identity 0 0 0 255 ECU_ADDRESS 0x1BECCC FORMAT "%.0" SYMBOL_LINK "testByte000" 2996 /end MEASUREMENT
/begin MEASUREMENT TestDWord_758 "" ULONG Identity 0 0 0 255 ECU_ADDRESS 0x1BECF4 FORMAT "%.0" SYMBOL_LINK "testByte000" 3036 /end MEASUREMENT
/begin MEASUREMENT TestDWord_769 "" ULONG Identity 0 0 0 255 ECU_ADDRESS 0x1BED20 FORMAT "%.0" SYMBOL_LINK "testByte000" 3080 /end MEASUREMENT
/begin MEASUREMENT TestDWord_773 "" ULONG Identity 0 0 0 255 ECU_ADDRESS 0x1BED30 FORMAT "%.0" SYMBOL_LINK "testByte000" 3096 /end MEASUREMENT
/begin MEASUREMENT TestDWord_782 "" ULONG Identity 0 0 0 255 ECU_ADDRESS 0x1BED54 FORMAT "%.0" SYMBOL_LINK "testByte000" 3132 /end MEASUREMENT
/begin MEASUREMENT TestDWord_783 "" ULONG Identity 0 0 0 255 ECU_ADDRESS 0x1BED58 FORMAT "%.0" SYMBOL_LINK "testByte000" 3136 /end MEASUREMENT
/begin MEASUREMENT TestDWord_794 "" ULONG Identity 0 0 0 255 ECU_ADDRESS 0x1BED84 FORMAT "%.0" SYMBOL_LINK "testByte000" 3180 /end MEASUREMENT
/begin MEASUREMENT TestDWord_800 "" ULONG Identity 0 0 0 255 ECU_ADDRESS 0x1BED9C FORMAT "%.0" SYMBOL_LINK "testByte000" 3204 /end MEASUREMENT
/begin MEASUREMENT TestDWord_805 "" ULONG Identity 0 0 0 255 ECU_ADDRESS 0x1BEDB0 FORMAT "%.0" SYMBOL_LINK "testByte000" 3224 /end MEASUREMENT
/begin MEASUREMENT TestDWord_811 "" ULONG Identity 0 0 0 255 ECU_ADDRESS 0x1BEDC8 FORMAT "%.0" SYMBOL_LINK "testByte000" 3248 /end MEASUREMENT
/begin MEASUREMENT TestDWord_814 "" ULONG Identity 0 0 0 255 ECU_ADDRESS 0x1BEDD4 FORMAT "%.0" SYMBOL_LINK "testByte000" 3260 /end MEASUREMENT
/begin MEASUREMENT TestDWord_823 "" ULONG Identity 0 0 0 255 ECU_ADDRESS 0x1BEDF8 FORMAT "%.0" SYMBOL_LINK "testByte000" 3296 /end MEASUREMENT
/begin MEASUREMENT TestDWord_825 "" ULONG Identity 0 0 0 255 ECU_ADDRESS 0x1BEE00 FORMAT "%.0" SYMBOL_LINK "testByte000" 3304 /end MEASUREMENT
/begin MEASUREMENT TestDWord_828 "" ULONG Identity 0 0 0 255 ECU_ADDRESS 0x1BEE0C FORMAT "%.0" SYMBOL_LINK "testByte000" 3316 /end MEASUREMENT
/begin MEASUREMENT TestDWord_839 "" ULONG Identity 0 0 0 255 ECU_ADDRESS 0x1BEE38 FORMAT "%.0" SYMBOL_LINK "testByte000" 3360 /end MEASUREMENT
/begin MEASUREMENT TestDWord_849 "" ULONG Identity 0 0 0 255 ECU_ADDRESS 0x1BEE60 FORMAT "%.0" SYMBOL_LINK "testByte000" 3400 /end MEASUREMENT
/begin MEASUREMENT TestDWord_850 "" ULONG Identity 0 0 0 255 ECU_ADDRESS 0x1BEE64 FORMAT "%.0" SYMBOL_LINK "testByte000" 3404 /end MEASUREMENT
/begin MEASUREMENT TestDWord_851 "" ULONG Identity 0 0 0 255 ECU_ADDRESS 0x1BEE68 FORMAT "%.0" SYMBOL_LINK "testByte000" 3408 /end MEASUREMENT
/begin MEASUREMENT TestDWord_863 "" ULONG Identity 0 0 0 255 ECU_ADDRESS 0x1BEE98 FORMAT "%.0" SYMBOL_LINK "testByte000" 3456 /end MEASUREMENT
/begin MEASUREMENT TestDWord_866 "" ULONG Identity 0 0 0 255 ECU_ADDRESS 0x1BEEA4 FORMAT "%.0" SYMBOL_LINK "testByte000" 3468 /end MEASUREMENT
/begin MEASUREMENT TestDWord_873 "" ULONG Identity 0 0 0 255 ECU_ADDRESS 0x1BEEC0 FORMAT "%.0" SYMBOL_LINK "testByte000" 3496 /end MEASUREMENT
/begin MEASUREMENT TestDWord_875 "" ULONG Identity 0 0 0 255 ECU_ADDRESS 0x1BEEC8 FORMAT "%.0" SYMBOL_LINK "testByte000" 3504 /end MEASUREMENT
/begin MEASUREMENT TestDWord_883 "" ULONG Identity 0 0 0 255 ECU_ADDRESS 0x1BEEE8 FORMAT "%.0" SYMBOL_LINK "testByte000" 3536 /end MEASUREMENT
/begin MEASUREMENT TestDWord_895 "" ULONG Identity 0 0 0 255 ECU_ADDRESS 0x1BEF18 FORMAT "%.0" SYMBOL_LINK "testByte000" 3584 /end MEASUREMENT
/begin MEASUREMENT TestDWord_899 "" ULONG Identity 0 0 0 255 ECU_ADDRESS 0x1BEF28 FORMAT "%.0" SYMBOL_LINK "testByte000" 3600 /end MEASUREMENT
/begin MEASUREMENT TestDWord_906 "" ULONG Identity 0 0 0 255 ECU_ADDRESS 0x1BEF44 FORMAT "%.0" SYMBOL_LINK "testByte000" 3628 /end MEASUREMENT
/begin MEASUREMENT TestDWord_907 "" ULONG Identity 0 0 0 255 ECU_ADDRESS 0x1BEF48 FORMAT "%.0" SYMBOL_LINK "testByte000" 3632 /end MEASUREMENT
/begin MEASUREMENT TestDWord_908 "" ULONG Identity 0 0 0 255 ECU_ADDRESS 0x1BEF4C FORMAT "%.0" SYMBOL_LINK "testByte000" 3636 /end MEASUREMENT
/begin MEASUREMENT TestDWord_910 "" ULONG Identity 0 0 0 255 ECU_ADDRESS 0x1BEF54 FORMAT "%.0" SYMBOL_LINK "testByte000" 3644 /end MEASUREMENT
/begin MEASUREMENT TestDWord_917 "" ULONG Identity 0 0 0 255 ECU_ADDRESS 0x1BEF70 FORMAT "%.0" SYMBOL_LINK "testByte000" 3672 /end MEASUREMENT
/begin MEASUREMENT TestDWord_922 "" ULONG Identity 0 0 0 255 ECU_ADDRESS 0x1BEF84 FORMAT "%.0" SYMBOL_LINK "testByte000" 3692 /end MEASUREMENT
/begin MEASUREMENT TestDWord_923 "" ULONG Identity 0 0 0 255 ECU_ADDRESS 0x1BEF88 FORMAT "%.0" SYMBOL_LINK "testByte000" 3696 /end MEASUREMENT
/begin MEASUREMENT TestDWord_925 "" ULONG Identity 0 0 0 255 ECU_ADDRESS 0x1BEF90 FORMAT "%.0" SYMBOL_LINK "testByte000" 3704 /end MEASUREMENT
/begin MEASUREMENT TestDWord_927 "" ULONG Identity 0 0 0 255 ECU_ADDRESS 0x1BEF98 FORMAT "%.0" SYMBOL_LINK "testByte000" 3712 /end MEASUREMENT
/begin MEASUREMENT TestDWord_929 "" ULONG Identity 0 0 0 255 ECU_ADDRESS 0x1BEFA0 FORMAT "%.0" SYMBOL_LINK "testByte000" 3720 /end MEASUREMENT
/begin MEASUREMENT TestDWord_932 "" ULONG Identity 0 0 0 255 ECU_ADDRESS 0x1BEFAC FORMAT "%.0" SYMBOL_LINK "testByte000" 3732 /end MEASUREMENT
/begin MEASUREMENT TestDWord_933 "" ULONG Identity 0 0 0 255 ECU_ADDRESS 0x1BEFB0 FORMAT "%.0" SYMBOL_LINK "testByte000" 3736 /end MEASUREMENT
/begin MEASUREMENT TestDWord_945 "" ULONG Identity 0 0 0 255 ECU_ADDRESS 0x1BEFE0 FORMAT "%.0" SYMBOL_LINK "testByte000" 3784 /end MEASUREMENT
/begin MEASUREMENT TestDWord_956 "" ULONG Identity 0 0 0 255 ECU_ADDRESS 0x1BF00C FORMAT "%.0" SYMBOL_LINK "testByte000" 3828 /end MEASUREMENT
/begin MEASUREMENT TestDWord_959 "" ULONG Identity 0 0 0 255 ECU_ADDRESS 0x1BF018 FORMAT "%.0" SYMBOL_LINK "testByte000" 3840 /end MEASUREMENT
/begin MEASUREMENT TestDWord_979 "" ULONG Identity 0 0 0 255 ECU_ADDRESS 0x1BF068 FORMAT "%.0" SYMBOL_LINK "testByte000" 3920 /end MEASUREMENT
/begin MEASUREMENT TestDWord_980 "" ULONG Identity 0 0 0 255 ECU_ADDRESS 0x1BF06C FORMAT "%.0" SYMBOL_LINK "testByte000" 3924 /end MEASUREMENT
/begin MEASUREMENT TestDWord_990 "" ULONG Identity 0 0 0 255 ECU_ADDRESS 0x1BF094 FORMAT "%.0" SYMBOL_LINK "testByte000" 3964 /end MEASUREMENT
/begin MEASUREMENT TestDWord_994 "" ULONG Identity 0 0 0 255 ECU_ADDRESS 0x1BF0A4 FORMAT "%.0" SYMBOL_LINK "testByte000" 3980 /end MEASUREMENT
/begin MEASUREMENT TestDWord_995 "" ULONG Identity 0 0 0 255 ECU_ADDRESS 0x1BF0A8 FORMAT "%.0" SYMBOL_LINK "testByte000" 3984 /end MEASUREMENT
/begin MEASUREMENT TestDWord_996 "" ULONG Identity 0 0 0 255 ECU_ADDRESS 0x1BF0AC FORMAT "%.0" SYMBOL_LINK "testByte000" 3988 /end MEASUREMENT
/begin MEASUREMENT TestWord_001 "" UWORD Identity 0 0 0 255 ECU_ADDRESS 0x1BE120 FORMAT "%.0" SYMBOL_LINK "testByte000" 8 /end MEASUREMENT
/begin MEASUREMENT TestWord_003 "" UWORD Identity 0 0 0 255 ECU_ADDRESS 0x1BE128 FORMAT "%.0" SYMBOL_LINK "testByte000" 16 /end MEASUREMENT
/begin MEASUREMENT TestWord_004 "" UWORD Identity 0 0 0 255 ECU_ADDRESS 0x1BE12C FORMAT "%.0" SYMBOL_LINK "testByte000" 20 /end MEASUREMENT
/begin MEASUREMENT TestWord_005 "" UWORD Identity 0 0 0 255 ECU_ADDRESS 0x1BE130 FORMAT "%.0" SYMBOL_LINK "testByte000" 24 /end MEASUREMENT
/begin MEASUREMENT TestWord_006 "" UWORD Identity 0 0 0 255 ECU_ADDRESS 0x1BE134 FORMAT "%.0" SYMBOL_LINK "testByte000" 28 /end MEASUREMENT
/begin MEASUREMENT TestWord_007 "" UWORD Identity 0 0 0 255 ECU_ADDRESS 0x1BE138 FORMAT "%.0" SYMBOL_LINK "testByte000" 32 /end MEASUREMENT
/begin MEASUREMENT TestWord_008 "" UWORD Identity 0 0 0 255 ECU_ADDRESS 0x1BE13C FORMAT "%.0" SYMBOL_LINK "testByte000" 36 /end MEASUREMENT
/begin MEASUREMENT TestWord_009 "" UWORD Identity 0 0 0 255 ECU_ADDRESS 0x1BE140 FORMAT "%.0" SYMBOL_LINK "testByte000" 40 /end MEASUREMENT
/begin MEASUREMENT TestWord_011 "" UWORD Identity 0 0 0 255 ECU_ADDRESS 0x1BE148 FORMAT "%.0" SYMBOL_LINK "testByte000" 48 /end MEASUREMENT
/begin MEASUREMENT TestWord_012 "" UWORD Identity 0 0 0 255 ECU_ADDRESS 0x1BE14C FORMAT "%.0" SYMBOL_LINK "testByte000" 52 /end MEASUREMENT
/begin MEASUREMENT TestWord_013 "" UWORD Identity 0 0 0 255 ECU_ADDRESS 0x1BE150 FORMAT "%.0" SYMBOL_LINK "testByte000" 56 /end MEASUREMENT
/begin MEASUREMENT TestWord_014 "" UWORD Identity 0 0 0 255 ECU_ADDRESS 0x1BE154 FORMAT "%.0" SYMBOL_LINK "testByte000" 60 /end MEASUREMENT
/begin MEASUREMENT TestWord_017 "" UWORD Identity 0 0 0 255 ECU_ADDRESS 0x1BE160 FORMAT "%.0" SYMBOL_LINK "testByte000" 72 /end MEASUREMENT
/begin MEASUREMENT TestWord_020 "" UWORD Identity 0 0 0 255 ECU_ADDRESS 0x1BE16C FORMAT "%.0" SYMBOL_LINK "testByte000" 84 /end MEASUREMENT
/begin MEASUREMENT TestWord_021 "" UWORD Identity 0 0 0 255 ECU_ADDRESS 0x1BE170 FORMAT "%.0" SYMBOL_LINK "testByte000" 88 /end MEASUREMENT
/begin MEASUREMENT TestWord_025 "" UWORD Identity 0 0 0 255 ECU_ADDRESS 0x1BE180 FORMAT "%.0" SYMBOL_LINK "testByte000" 104 /end MEASUREMENT
/begin MEASUREMENT TestWord_026 "" UWORD Identity 0 0 0 255 ECU_ADDRESS 0x1BE184 FORMAT "%.0" SYMBOL_LINK "testByte000" 108 /end MEASUREMENT
/begin MEASUREMENT TestWord_027 "" UWORD Identity 0 0 0 255 ECU_ADDRESS 0x1BE188 FORMAT "%.0" SYMBOL_LINK "testByte000" 112 /end MEASUREMENT
/begin MEASUREMENT TestWord_028 "" UWORD Identity 0 0 0 255 ECU_ADDRESS 0x1BE18C FORMAT "%.0" SYMBOL_LINK "testByte000" 116 /end MEASUREMENT
/begin MEASUREMENT TestWord_029 "" UWORD Identity 0 0 0 255 ECU_ADDRESS 0x1BE190 FORMAT "%.0" SYMBOL_LINK "testByte000" 120 /end MEASUREMENT
/begin MEASUREMENT TestWord_031 "" UWORD Identity 0 0 0 255 ECU_ADDRESS 0x1BE198 FORMAT "%.0" SYMBOL_LINK "testByte000" 128 /end MEASUREMENT
/begin MEASUREMENT TestWord_032 "" UWORD Identity 0 0 0 255 ECU_ADDRESS 0x1BE19C FORMAT "%.0" SYMBOL_LINK "testByte000" 132 /end MEASUREMENT
/begin MEASUREMENT TestWord_033 "" UWORD Identity 0 0 0 255 ECU_ADDRESS 0x1BE1A0 FORMAT "%.0" SYMBOL_LINK "testByte000" 136 /end MEASUREMENT
/begin MEASUREMENT TestWord_035 "" UWORD Identity 0 0 0 255 ECU_ADDRESS 0x1BE1A8 FORMAT "%.0" SYMBOL_LINK "testByte000" 144 /end MEASUREMENT
/begin MEASUREMENT TestWord_036 "" UWORD Identity 0 0 0 255 ECU_ADDRESS 0x1BE1AC FORMAT "%.0" SYMBOL_LINK "testByte000" 148 /end MEASUREMENT
/begin MEASUREMENT TestWord_037 "" UWORD Identity 0 0 0 255 ECU_ADDRESS 0x1BE1B0 FORMAT "%.0" SYMBOL_LINK "testByte000" 152 /end MEASUREMENT
/begin MEASUREMENT TestWord_038 "" UWORD Identity 0 0 0 255 ECU_ADDRESS 0x1BE1B4 FORMAT "%.0" SYMBOL_LINK "testByte000" 156 /end MEASUREMENT
/begin MEASUREMENT TestWord_039 "" UWORD Identity 0 0 0 255 ECU_ADDRESS 0x1BE1B8 FORMAT "%.0" SYMBOL_LINK "testByte000" 160 /end MEASUREMENT
/begin MEASUREMENT TestWord_040 "" UWORD Identity 0 0 0 255 ECU_ADDRESS 0x1BE1BC FORMAT "%.0" SYMBOL_LINK "testByte000" 164 /end MEASUREMENT
/begin MEASUREMENT TestWord_041 "" UWORD Identity 0 0 0 255 ECU_ADDRESS 0x1BE1C0 FORMAT "%.0" SYMBOL_LINK "testByte000" 168 /end MEASUREMENT
/begin MEASUREMENT TestWord_042 "" UWORD Identity 0 0 0 255 ECU_ADDRESS 0x1BE1C4 FORMAT "%.0" SYMBOL_LINK "testByte000" 172 /end MEASUREMENT
/begin MEASUREMENT TestWord_043 "" UWORD Identity 0 0 0 255 ECU_ADDRESS 0x1BE1C8 FORMAT "%.0" SYMBOL_LINK "testByte000" 176 /end MEASUREMENT
/begin MEASUREMENT TestWord_044 "" UWORD Identity 0 0 0 255 ECU_ADDRESS 0x1BE1CC FORMAT "%.0" SYMBOL_LINK "testByte000" 180 /end MEASUREMENT
/begin MEASUREMENT TestWord_046 "" UWORD Identity 0 0 0 255 ECU_ADDRESS 0x1BE1D4 FORMAT "%.0" SYMBOL_LINK "testByte000" 188 /end MEASUREMENT
/begin MEASUREMENT TestWord_048 "" UWORD Identity 0 0 0 255 ECU_ADDRESS 0x1BE1DC FORMAT "%.0" SYMBOL_LINK "testByte000" 196 /end MEASUREMENT
/begin MEASUREMENT TestWord_050 "" UWORD Identity 0 0 0 255 ECU_ADDRESS 0x1BE1E4 FORMAT "%.0" SYMBOL_LINK "testByte000" 204 /end MEASUREMENT
/begin MEASUREMENT TestWord_051 "" UWORD Identity 0 0 0 255 ECU_ADDRESS 0x1BE1E8 FORMAT "%.0" SYMBOL_LINK "testByte000" 208 /end MEASUREMENT
/begin MEASUREMENT TestWord_052 "" UWORD Identity 0 0 0 255 ECU_ADDRESS 0x1BE1EC FORMAT "%.0" SYMBOL_LINK "testByte000" 212 /end MEASUREMENT
/begin MEASUREMENT TestWord_053 "" UWORD Identity 0 0 0 255 ECU_ADDRESS 0x1BE1F0 FORMAT "%.0" SYMBOL_LINK "testByte000" 216 /end MEASUREMENT
/begin MEASUREMENT TestWord_054 "" UWORD Identity 0 0 0 255 ECU_ADDRESS 0x1BE1F4 FORMAT "%.0" SYMBOL_LINK "testByte000" 220 /end MEASUREMENT
/begin MEASUREMENT TestWord_055 "" UWORD Identity 0 0 0 255 ECU_ADDRESS 0x1BE1F8 FORMAT "%.0" SYMBOL_LINK "testByte000" 224 /end MEASUREMENT
/begin MEASUREMENT TestWord_058 "" UWORD Identity 0 0 0 255 ECU_ADDRESS 0x1BE204 FORMAT "%.0" SYMBOL_LINK "testByte000" 236 /end MEASUREMENT
/begin MEASUREMENT TestWord_060 "" UWORD Identity 0 0 0 255 ECU_ADDRESS 0x1BE20C FORMAT "%.0" SYMBOL_LINK "testByte000" 244 /end MEASUREMENT
/begin MEASUREMENT TestWord_062 "" UWORD Identity 0 0 0 255 ECU_ADDRESS 0x1BE214 FORMAT "%.0" SYMBOL_LINK "testByte000" 252 /end MEASUREMENT
/begin MEASUREMENT TestWord_065 "" UWORD Identity 0 0 0 255 ECU_ADDRESS 0x1BE220 FORMAT "%.0" SYMBOL_LINK "testByte000" 264 /end MEASUREMENT
/begin MEASUREMENT TestWord_068 "" UWORD Identity 0 0 0 255 ECU_ADDRESS 0x1BE22C FORMAT "%.0" SYMBOL_LINK "testByte000" 276 /end MEASUREMENT
/begin MEASUREMENT TestWord_069 "" UWORD Identity 0 0 0 255 ECU_ADDRESS 0x1BE230 FORMAT "%.0" SYMBOL_LINK "testByte000" 280 /end MEASUREMENT
/begin MEASUREMENT TestWord_070 "" UWORD Identity 0 0 0 255 ECU_ADDRESS 0x1BE234 FORMAT "%.0" SYMBOL_LINK "testByte000" 284 /end MEASUREMENT
/begin MEASUREMENT TestWord_071 "" UWORD Identity 0 0 0 255 ECU_ADDRESS 0x1BE238 FORMAT "%.0" SYMBOL_LINK "testByte000" 288 /end MEASUREMENT
/begin MEASUREMENT TestWord_072 "" UWORD Identity 0 0 0 255 ECU_ADDRESS 0x1BE23C FORMAT "%.0" SYMBOL_LINK "testByte000" 292 /end MEASUREMENT
/begin MEASUREMENT TestWord_074 "" UWORD Identity 0 0 0 255 ECU_ADDRESS 0x1BE244 FORMAT "%.0" SYMBOL_LINK "testByte000" 300 /end MEASUREMENT
/begin MEASUREMENT TestWord_075 "" UWORD Identity 0 0 0 255 ECU_ADDRESS 0x1BE248 FORMAT "%.0" SYMBOL_LINK "testByte000" 304 /end MEASUREMENT
/begin MEASUREMENT TestWord_076 "" UWORD Identity 0 0 0 255 ECU_ADDRESS 0x1BE24C FORMAT "%.0" SYMBOL_LINK "testByte000" 308 /end MEASUREMENT
/begin MEASUREMENT TestWord_077 "" UWORD Identity 0 0 0 255 ECU_ADDRESS 0x1BE250 FORMAT "%.0" SYMBOL_LINK "testByte000" 312 /end MEASUREMENT
/begin MEASUREMENT TestWord_078 "" UWORD Identity 0 0 0 255 ECU_ADDRESS 0x1BE254 FORMAT "%.0" SYMBOL_LINK "testByte000" 316 /end MEASUREMENT
/begin MEASUREMENT TestWord_080 "" UWORD Identity 0 0 0 255 ECU_ADDRESS 0x1BE25C FORMAT "%.0" SYMBOL_LINK "testByte000" 324 /end MEASUREMENT
/begin MEASUREMENT TestWord_081 "" UWORD Identity 0 0 0 255 ECU_ADDRESS 0x1BE260 FORMAT "%.0" SYMBOL_LINK "testByte000" 328 /end MEASUREMENT
/begin MEASUREMENT TestWord_082 "" UWORD Identity 0 0 0 255 ECU_ADDRESS 0x1BE264 FORMAT "%.0" SYMBOL_LINK "testByte000" 332 /end MEASUREMENT
/begin MEASUREMENT TestWord_083 "" UWORD Identity 0 0 0 255 ECU_ADDRESS 0x1BE268 FORMAT "%.0" SYMBOL_LINK "testByte000" 336 /end MEASUREMENT
/begin MEASUREMENT TestWord_084 "" UWORD Identity 0 0 0 255 ECU_ADDRESS 0x1BE26C FORMAT "%.0" SYMBOL_LINK "testByte000" 340 /end MEASUREMENT
/begin MEASUREMENT TestWord_085 "" UWORD Identity 0 0 0 255 ECU_ADDRESS 0x1BE270 FORMAT "%.0" SYMBOL_LINK "testByte000" 344 /end MEASUREMENT
/begin MEASUREMENT TestWord_088 "" UWORD Identity 0 0 0 255 ECU_ADDRESS 0x1BE27C FORMAT "%.0" SYMBOL_LINK "testByte000" 356 /end MEASUREMENT
/begin MEASUREMENT TestWord_089 "" UWORD Identity 0 0 0 255 ECU_ADDRESS 0x1BE280 FORMAT "%.0" SYMBOL_LINK "testByte000" 360 /end MEASUREMENT
/begin MEASUREMENT TestWord_090 "" UWORD Identity 0 0 0 255 ECU_ADDRESS 0x1BE284 FORMAT "%.0" SYMBOL_LINK "testByte000" 364 /end MEASUREMENT
/begin MEASUREMENT TestWord_091 "" UWORD Identity 0 0 0 255 ECU_ADDRESS 0x1BE288 FORMAT "%.0" SYMBOL_LINK "testByte000" 368 /end MEASUREMENT
/begin MEASUREMENT TestWord_092 "" UWORD Identity 0 0 0 255 ECU_ADDRESS 0x1BE28C FORMAT "%.0" SYMBOL_LINK "testByte000" 372 /end MEASUREMENT
/begin MEASUREMENT TestWord_093 "" UWORD Identity 0 0 0 255 ECU_ADDRESS 0x1BE290 FORMAT "%.0" SYMBOL_LINK "testByte000" 376 /end MEASUREMENT
/begin MEASUREMENT TestWord_095 "" UWORD Identity 0 0 0 255 ECU_ADDRESS 0x1BE298 FORMAT "%.0" SYMBOL_LINK "testByte000" 384 /end MEASUREMENT
/begin MEASUREMENT TestWord_096 "" UWORD Identity 0 0 0 255 ECU_ADDRESS 0x1BE29C FORMAT "%.0" SYMBOL_LINK "testByte000" 388 /end MEASUREMENT
/begin MEASUREMENT TestWord_098 "" UWORD Identity 0 0 0 255 ECU_ADDRESS 0x1BE2A4 FORMAT "%.0" SYMBOL_LINK "testByte000" 396 /end MEASUREMENT
/begin MEASUREMENT TestWord_099 "" UWORD Identity 0 0 0 255 ECU_ADDRESS 0x1BE2A8 FORMAT "%.0" SYMBOL_LINK "testByte000" 400 /end MEASUREMENT
/begin MEASUREMENT TestWord_101 "" UWORD Identity 0 0 0 255 ECU_ADDRESS 0x1BE2B0 FORMAT "%.0" SYMBOL_LINK "testByte000" 408 /end MEASUREMENT
/begin MEASUREMENT TestWord_103 "" UWORD Identity 0 0 0 255 ECU_ADDRESS 0x1BE2B8 FORMAT "%.0" SYMBOL_LINK "testByte000" 416 /end MEASUREMENT
/begin MEASUREMENT TestWord_104 "" UWORD Identity 0 0 0 255 ECU_ADDRESS 0x1BE2BC FORMAT "%.0" SYMBOL_LINK "testByte000" 420 /end MEASUREMENT
/begin MEASUREMENT TestWord_105 "" UWORD Identity 0 0 0 255 ECU_ADDRESS 0x1BE2C0 FORMAT "%.0" SYMBOL_LINK "testByte000" 424 /end MEASUREMENT
/begin MEASUREMENT TestWord_106 "" UWORD Identity 0 0 0 255 ECU_ADDRESS 0x1BE2C4 FORMAT "%.0" SYMBOL_LINK "testByte000" 428 /end MEASUREMENT
/begin MEASUREMENT TestWord_108 "" UWORD Identity 0 0 0 255 ECU_ADDRESS 0x1BE2CC FORMAT "%.0" SYMBOL_LINK "testByte000" 436 /end MEASUREMENT
/begin MEASUREMENT TestWord_109 "" UWORD Identity 0 0 0 255 ECU_ADDRESS 0x1BE2D0 FORMAT "%.0" SYMBOL_LINK "testByte000" 440 /end MEASUREMENT
/begin MEASUREMENT TestWord_111 "" UWORD Identity 0 0 0 255 ECU_ADDRESS 0x1BE2D8 FORMAT "%.0" SYMBOL_LINK "testByte000" 448 /end MEASUREMENT
/begin MEASUREMENT TestWord_112 "" UWORD Identity 0 0 0 255 ECU_ADDRESS 0x1BE2DC FORMAT "%.0" SYMBOL_LINK "testByte000" 452 /end MEASUREMENT
/begin MEASUREMENT TestWord_113 "" UWORD Identity 0 0 0 255 ECU_ADDRESS 0x1BE2E0 FORMAT "%.0" SYMBOL_LINK "testByte000" 456 /end MEASUREMENT
/begin MEASUREMENT TestWord_116 "" UWORD Identity 0 0 0 255 ECU_ADDRESS 0x1BE2EC FORMAT "%.0" SYMBOL_LINK "testByte000" 468 /end MEASUREMENT
/begin MEASUREMENT TestWord_117 "" UWORD Identity 0 0 0 255 ECU_ADDRESS 0x1BE2F0 FORMAT "%.0" SYMBOL_LINK "testByte000" 472 /end MEASUREMENT
/begin MEASUREMENT TestWord_119 "" UWORD Identity 0 0 0 255 ECU_ADDRESS 0x1BE2F8 FORMAT "%.0" SYMBOL_LINK "testByte000" 480 /end MEASUREMENT
/begin MEASUREMENT TestWord_120 "" UWORD Identity 0 0 0 255 ECU_ADDRESS 0x1BE2FC FORMAT "%.0" SYMBOL_LINK "testByte000" 484 /end MEASUREMENT
/begin MEASUREMENT TestWord_121 "" UWORD Identity 0 0 0 255 ECU_ADDRESS 0x1BE300 FORMAT "%.0" SYMBOL_LINK "testByte000" 488 /end MEASUREMENT
/begin MEASUREMENT TestWord_123 "" UWORD Identity 0 0 0 255 ECU_ADDRESS 0x1BE308 FORMAT "%.0" SYMBOL_LINK "testByte000" 496 /end MEASUREMENT
/begin MEASUREMENT TestWord_124 "" UWORD Identity 0 0 0 255 ECU_ADDRESS 0x1BE30C FORMAT "%.0" SYMBOL_LINK "testByte000" 500 /end MEASUREMENT
/begin MEASUREMENT TestWord_125 "" UWORD Identity 0 0 0 255 ECU_ADDRESS 0x1BE310 FORMAT "%.0" SYMBOL_LINK "testByte000" 504 /end MEASUREMENT
/begin MEASUREMENT TestWord_126 "" UWORD Identity 0 0 0 255 ECU_ADDRESS 0x1BE314 FORMAT "%.0" SYMBOL_LINK "testByte000" 508 /end MEASUREMENT
/begin MEASUREMENT TestWord_127 "" UWORD Identity 0 0 0 255 ECU_ADDRESS 0x1BE318 FORMAT "%.0" SYMBOL_LINK "testByte000" 512 /end MEASUREMENT
/begin MEASUREMENT TestWord_129 "" UWORD Identity 0 0 0 255 ECU_ADDRESS 0x1BE320 FORMAT "%.0" SYMBOL_LINK "testByte000" 520 /end MEASUREMENT
/begin MEASUREMENT TestWord_130 "" UWORD Identity 0 0 0 255 ECU_ADDRESS 0x1BE324 FORMAT "%.0" SYMBOL_LINK "testByte000" 524 /end MEASUREMENT
/begin MEASUREMENT TestWord_132 "" UWORD Identity 0 0 0 255 ECU_ADDRESS 0x1BE32C FORMAT "%.0" SYMBOL_LINK "testByte000" 532 /end MEASUREMENT
/begin MEASUREMENT TestWord_133 "" UWORD Identity 0 0 0 255 ECU_ADDRESS 0x1BE330 FORMAT "%.0" SYMBOL_LINK "testByte000" 536 /end MEASUREMENT
/begin MEASUREMENT TestWord_134 "" UWORD Identity 0 0 0 255 ECU_ADDRESS 0x1BE334 FORMAT "%.0" SYMBOL_LINK "testByte000" 540 /end MEASUREMENT
/begin MEASUREMENT TestWord_136 "" UWORD Identity 0 0 0 255 ECU_ADDRESS 0x1BE33C FORMAT "%.0" SYMBOL_LINK "testByte000" 548 /end MEASUREMENT
/begin MEASUREMENT TestWord_137 "" UWORD Identity 0 0 0 255 ECU_ADDRESS 0x1BE340 FORMAT "%.0" SYMBOL_LINK "testByte000" 552 /end MEASUREMENT
/begin MEASUREMENT TestWord_138 "" UWORD Identity 0 0 0 255 ECU_ADDRESS 0x1BE344 FORMAT "%.0" SYMBOL_LINK "testByte000" 556 /end MEASUREMENT
/begin MEASUREMENT TestWord_139 "" UWORD Identity 0 0 0 255 ECU_ADDRESS 0x1BE348 FORMAT "%.0" SYMBOL_LINK "testByte000" 560 /end MEASUREMENT
/begin MEASUREMENT TestWord_140 "" UWORD Identity 0 0 0 255 ECU_ADDRESS 0x1BE34C FORMAT "%.0" SYMBOL_LINK "testByte000" 564 /end MEASUREMENT
/begin MEASUREMENT TestWord_141 "" UWORD Identity 0 0 0 255 ECU_ADDRESS 0x1BE350 FORMAT "%.0" SYMBOL_LINK "testByte000" 568 /end MEASUREMENT
/begin MEASUREMENT TestWord_142 "" UWORD Identity 0 0 0 255 ECU_ADDRESS 0x1BE354 FORMAT "%.0" SYMBOL_LINK "testByte000" 572 /end MEASUREMENT
/begin MEASUREMENT TestWord_143 "" UWORD Identity 0 0 0 255 ECU_ADDRESS 0x1BE358 FORMAT "%.0" SYMBOL_LINK "testByte000" 576 /end MEASUREMENT
/begin MEASUREMENT TestWord_144 "" UWORD Identity 0 0 0 255 ECU_ADDRESS 0x1BE35C FORMAT "%.0" SYMBOL_LINK "testByte000" 580 /end MEASUREMENT
/begin MEASUREMENT TestWord_146 "" UWORD Identity 0 0 0 255 ECU_ADDRESS 0x1BE364 FORMAT "%.0" SYMBOL_LINK "testByte000" 588 /end MEASUREMENT
/begin MEASUREMENT TestWord_148 "" UWORD Identity 0 0 0 255 ECU_ADDRESS 0x1BE36C FORMAT "%.0" SYMBOL_LINK "testByte000" 596 /end MEASUREMENT
/begin MEASUREMENT TestWord_149 "" UWORD Identity 0 0 0 255 ECU_ADDRESS 0x1BE370 FORMAT "%.0" SYMBOL_LINK "testByte000" 600 /end MEASUREMENT
/begin MEASUREMENT TestWord_151 "" UWORD Identity 0 0 0 255 ECU_ADDRESS 0x1BE378 FORMAT "%.0" SYMBOL_LINK "testByte000" 608 /end MEASUREMENT
/begin MEASUREMENT TestWord_152 "" UWORD Identity 0 0 0 255 ECU_ADDRESS 0x1BE37C FORMAT "%.0" SYMBOL_LINK "testByte000" 612 /end MEASUREMENT
/begin MEASUREMENT TestWord_153 "" UWORD Identity 0 0 0 255 ECU_ADDRESS 0x1BE380 FORMAT "%.0" SYMBOL_LINK "testByte000" 616 /end MEASUREMENT
/begin MEASUREMENT TestWord_154 "" UWORD Identity 0 0 0 255 ECU_ADDRESS 0x1BE384 FORMAT "%.0" SYMBOL_LINK "testByte000" 620 /end MEASUREMENT
/begin MEASUREMENT TestWord_155 "" UWORD Identity 0 0 0 255 ECU_ADDRESS 0x1BE388 FORMAT "%.0" SYMBOL_LINK "testByte000" 624 /end MEASUREMENT
/begin MEASUREMENT TestWord_157 "" UWORD Identity 0 0 0 255 ECU_ADDRESS 0x1BE390 FORMAT "%.0" SYMBOL_LINK "testByte000" 632 /end MEASUREMENT
/begin MEASUREMENT TestWord_158 "" UWORD Identity 0 0 0 255 ECU_ADDRESS 0x1BE394 FORMAT "%.0" SYMBOL_LINK "testByte000" 636 /end MEASUREMENT
/begin MEASUREMENT TestWord_160 "" UWORD Identity 0 0 0 255 ECU_ADDRESS 0x1BE39C FORMAT "%.0" SYMBOL_LINK "testByte000" 644 /end MEASUREMENT
/begin MEASUREMENT TestWord_162 "" UWORD Identity 0 0 0 255 ECU_ADDRESS 0x1BE3A4 FORMAT "%.0" SYMBOL_LINK "testByte000" 652 /end MEASUREMENT
/begin MEASUREMENT TestWord_163 "" UWORD Identity 0 0 0 255 ECU_ADDRESS 0x1BE3A8 FORMAT "%.0" SYMBOL_LINK "testByte000" 656 /end MEASUREMENT
/begin MEASUREMENT TestWord_164 "" UWORD Identity 0 0 0 255 ECU_ADDRESS 0x1BE3AC FORMAT "%.0" SYMBOL_LINK "testByte000" 660 /end MEASUREMENT
/begin MEASUREMENT TestWord_166 "" UWORD Identity 0 0 0 255 ECU_ADDRESS 0x1BE3B4 FORMAT "%.0" SYMBOL_LINK "testByte000" 668 /end MEASUREMENT
/begin MEASUREMENT TestWord_169 "" UWORD Identity 0 0 0 255 ECU_ADDRESS 0x1BE3C0 FORMAT "%.0" SYMBOL_LINK "testByte000" 680 /end MEASUREMENT
/begin MEASUREMENT TestWord_170 "" UWORD Identity 0 0 0 255 ECU_ADDRESS 0x1BE3C4 FORMAT "%.0" SYMBOL_LINK "testByte000" 684 /end MEASUREMENT
/begin MEASUREMENT TestWord_171 "" UWORD Identity 0 0 0 255 ECU_ADDRESS 0x1BE3C8 FORMAT "%.0" SYMBOL_LINK "testByte000" 688 /end MEASUREMENT
/begin MEASUREMENT TestWord_173 "" UWORD Identity 0 0 0 255 ECU_ADDRESS 0x1BE3D0 FORMAT "%.0" SYMBOL_LINK "testByte000" 696 /end MEASUREMENT
/begin MEASUREMENT TestWord_175 "" UWORD Identity 0 0 0 255 ECU_ADDRESS 0x1BE3D8 FORMAT "%.0" SYMBOL_LINK "testByte000" 704 /end MEASUREMENT
/begin MEASUREMENT TestWord_176 "" UWORD Identity 0 0 0 255 ECU_ADDRESS 0x1BE3DC FORMAT "%.0" SYMBOL_LINK "testByte000" 708 /end MEASUREMENT
/begin MEASUREMENT TestWord_177 "" UWORD Identity 0 0 0 255 ECU_ADDRESS 0x1BE3E0 FORMAT "%.0" SYMBOL_LINK "testByte000" 712 /end MEASUREMENT
/begin MEASUREMENT TestWord_178 "" UWORD Identity 0 0 0 255 ECU_ADDRESS 0x1BE3E4 FORMAT "%.0" SYMBOL_LINK "testByte000" 716 /end MEASUREMENT
/begin MEASUREMENT TestWord_179 "" UWORD Identity 0 0 0 255 ECU_ADDRESS 0x1BE3E8 FORMAT "%.0" SYMBOL_LINK "testByte000" 720 /end MEASUREMENT
/begin MEASUREMENT TestWord_184 "" UWORD Identity 0 0 0 255 ECU_ADDRESS 0x1BE3FC FORMAT "%.0" SYMBOL_LINK "testByte000" 740 /end MEASUREMENT
/begin MEASUREMENT TestWord_185 "" UWORD Identity 0 0 0 255 ECU_ADDRESS 0x1BE400 FORMAT "%.0" SYMBOL_LINK "testByte000" 744 /end MEASUREMENT
/begin MEASUREMENT TestWord_188 "" UWORD Identity 0 0 0 255 ECU_ADDRESS 0x1BE40C FORMAT "%.0" SYMBOL_LINK "testByte000" 756 /end MEASUREMENT
/begin MEASUREMENT TestWord_191 "" UWORD Identity 0 0 0 255 ECU_ADDRESS 0x1BE418 FORMAT "%.0" SYMBOL_LINK "testByte000" 768 /end MEASUREMENT
/begin MEASUREMENT TestWord_192 "" UWORD Identity 0 0 0 255 ECU_ADDRESS 0x1BE41C FORMAT "%.0" SYMBOL_LINK "testByte000" 772 /end MEASUREMENT
/begin MEASUREMENT TestWord_193 "" UWORD Identity 0 0 0 255 ECU_ADDRESS 0x1BE420 FORMAT "%.0" SYMBOL_LINK "testByte000" 776 /end MEASUREMENT
/begin MEASUREMENT TestWord_194 "" UWORD Identity 0 0 0 255 ECU_ADDRESS 0x1BE424 FORMAT "%.0" SYMBOL_LINK "testByte000" 780 /end MEASUREMENT
/begin MEASUREMENT TestWord_196 "" UWORD Identity 0 0 0 255 ECU_ADDRESS 0x1BE42C FORMAT "%.0" SYMBOL_LINK "testByte000" 788 /end MEASUREMENT
/begin MEASUREMENT TestWord_198 "" UWORD Identity 0 0 0 255 ECU_ADDRESS 0x1BE434 FORMAT "%.0" SYMBOL_LINK "testByte000" 796 /end MEASUREMENT
/begin MEASUREMENT TestWord_200 "" UWORD Identity 0 0 0 255 ECU_ADDRESS 0x1BE43C FORMAT "%.0" SYMBOL_LINK "testByte000" 804 /end MEASUREMENT
/begin MEASUREMENT TestWord_202 "" UWORD Identity 0 0 0 255 ECU_ADDRESS 0x1BE444 FORMAT "%.0" SYMBOL_LINK "testByte000" 812 /end MEASUREMENT
/begin MEASUREMENT TestWord_203 "" UWORD Identity 0 0 0 255 ECU_ADDRESS 0x1BE448 FORMAT "%.0" SYMBOL_LINK "testByte000" 816 /end MEASUREMENT
/begin MEASUREMENT TestWord_204 "" UWORD Identity 0 0 0 255 ECU_ADDRESS 0x1BE44C FORMAT "%.0" SYMBOL_LINK "testByte000" 820 /end MEASUREMENT
/begin MEASUREMENT TestWord_206 "" UWORD Identity 0 0 0 255 ECU_ADDRESS 0x1BE454 FORMAT "%.0" SYMBOL_LINK "testByte000" 828 /end MEASUREMENT
/begin MEASUREMENT TestWord_207 "" UWORD Identity 0 0 0 255 ECU_ADDRESS 0x1BE458 FORMAT "%.0" SYMBOL_LINK "testByte000" 832 /end MEASUREMENT
/begin MEASUREMENT TestWord_208 "" UWORD Identity 0 0 0 255 ECU_ADDRESS 0x1BE45C FORMAT "%.0" SYMBOL_LINK "testByte000" 836 /end MEASUREMENT
/begin MEASUREMENT TestWord_209 "" UWORD Identity 0 0 0 255 ECU_ADDRESS 0x1BE460 FORMAT "%.0" SYMBOL_LINK "testByte000" 840 /end MEASUREMENT
/begin MEASUREMENT TestWord_211 "" UWORD Identity 0 0 0 255 ECU_ADDRESS 0x1BE468 FORMAT "%.0" SYMBOL_LINK "testByte000" 848 /end MEASUREMENT
/begin MEASUREMENT TestWord_213 "" UWORD Identity 0 0 0 255 ECU_ADDRESS 0x1BE470 FORMAT "%.0" SYMBOL_LINK "testByte000" 856 /end MEASUREMENT
/begin MEASUREMENT TestWord_214 "" UWORD Identity 0 0 0 255 ECU_ADDRESS 0x1BE474 FORMAT "%.0" SYMBOL_LINK "testByte000" 860 /end MEASUREMENT
/begin MEASUREMENT TestWord_215 "" UWORD Identity 0 0 0 255 ECU_ADDRESS 0x1BE478 FORMAT "%.0" SYMBOL_LINK "testByte000" 864 /end MEASUREMENT
/begin MEASUREMENT TestWord_217 "" UWORD Identity 0 0 0 255 ECU_ADDRESS 0x1BE480 FORMAT "%.0" SYMBOL_LINK "testByte000" 872 /end MEASUREMENT
/begin MEASUREMENT TestWord_219 "" UWORD Identity 0 0 0 255 ECU_ADDRESS 0x1BE488 FORMAT "%.0" SYMBOL_LINK "testByte000" 880 /end MEASUREMENT
/begin MEASUREMENT TestWord_220 "" UWORD Identity 0 0 0 255 ECU_ADDRESS 0x1BE48C FORMAT "%.0" SYMBOL_LINK "testByte000" 884 /end MEASUREMENT
/begin MEASUREMENT TestWord_222 "" UWORD Identity 0 0 0 255 ECU_ADDRESS 0x1BE494 FORMAT "%.0" SYMBOL_LINK "testByte000" 892 /end MEASUREMENT
/begin MEASUREMENT TestWord_225 "" UWORD Identity 0 0 0 255 ECU_ADDRESS 0x1BE4A0 FORMAT "%.0" SYMBOL_LINK "testByte000" 904 /end MEASUREMENT
/begin MEASUREMENT TestWord_226 "" UWORD Identity 0 0 0 255 ECU_ADDRESS 0x1BE4A4 FORMAT "%.0" SYMBOL_LINK "testByte000" 908 /end MEASUREMENT
/begin MEASUREMENT TestWord_228 "" UWORD Identity 0 0 0 255 ECU_ADDRESS 0x1BE4AC FORMAT "%.0" SYMBOL_LINK "testByte000" 916 /end MEASUREMENT
/begin MEASUREMENT TestWord_229 "" UWORD Identity 0 0 0 255 ECU_ADDRESS 0x1BE4B0 FORMAT "%.0" SYMBOL_LINK "testByte000" 920 /end MEASUREMENT
/begin MEASUREMENT TestWord_230 "" UWORD Identity 0 0 0 255 ECU_ADDRESS 0x1BE4B4 FORMAT "%.0" SYMBOL_LINK "testByte000" 924 /end MEASUREMENT
/begin MEASUREMENT TestWord_231 "" UWORD Identity 0 0 0 255 ECU_ADDRESS 0x1BE4B8 FORMAT "%.0" SYMBOL_LINK "testByte000" 928 /end MEASUREMENT
/begin MEASUREMENT TestWord_232 "" UWORD Identity 0 0 0 255 ECU_ADDRESS 0x1BE4BC FORMAT "%.0" SYMBOL_LINK "testByte000" 932 /end MEASUREMENT
/begin MEASUREMENT TestWord_233 "" UWORD Identity 0 0 0 255 ECU_ADDRESS 0x1BE4C0 FORMAT "%.0" SYMBOL_LINK "testByte000" 936 /end MEASUREMENT
/begin MEASUREMENT TestWord_234 "" UWORD Identity 0 0 0 255 ECU_ADDRESS 0x1BE4C4 FORMAT "%.0" SYMBOL_LINK "testByte000" 940 /end MEASUREMENT
/begin MEASUREMENT TestWord_235 "" UWORD Identity 0 0 0 255 ECU_ADDRESS 0x1BE4C8 FORMAT "%.0" SYMBOL_LINK "testByte000" 944 /end MEASUREMENT
/begin MEASUREMENT TestWord_236 "" UWORD Identity 0 0 0 255 ECU_ADDRESS 0x1BE4CC FORMAT "%.0" SYMBOL_LINK "testByte000" 948 /end MEASUREMENT
/begin MEASUREMENT TestWord_237 "" UWORD Identity 0 0 0 255 ECU_ADDRESS 0x1BE4D0 FORMAT "%.0" SYMBOL_LINK "testByte000" 952 /end MEASUREMENT
/begin MEASUREMENT TestWord_238 "" UWORD Identity 0 0 0 255 ECU_ADDRESS 0x1BE4D4 FORMAT "%.0" SYMBOL_LINK "testByte000" 956 /end MEASUREMENT
/begin MEASUREMENT TestWord_239 "" UWORD Identity 0 0 0 255 ECU_ADDRESS 0x1BE4D8 FORMAT "%.0" SYMBOL_LINK "testByte000" 960 /end MEASUREMENT
/begin MEASUREMENT TestWord_241 "" UWORD Identity 0 0 0 255 ECU_ADDRESS 0x1BE4E0 FORMAT "%.0" SYMBOL_LINK "testByte000" 968 /end MEASUREMENT
/begin MEASUREMENT TestWord_242 "" UWORD Identity 0 0 0 255 ECU_ADDRESS 0x1BE4E4 FORMAT "%.0" SYMBOL_LINK "testByte000" 972 /end MEASUREMENT
/begin MEASUREMENT TestWord_243 "" UWORD Identity 0 0 0 255 ECU_ADDRESS 0x1BE4E8 FORMAT "%.0" SYMBOL_LINK "testByte000" 976 /end MEASUREMENT
/begin MEASUREMENT TestWord_246 "" UWORD Identity 0 0 0 255 ECU_ADDRESS 0x1BE4F4 FORMAT "%.0" SYMBOL_LINK "testByte000" 988 /end MEASUREMENT
/begin MEASUREMENT TestWord_247 "" UWORD Identity 0 0 0 255 ECU_ADDRESS 0x1BE4F8 FORMAT "%.0" SYMBOL_LINK "testByte000" 992 /end MEASUREMENT
/begin MEASUREMENT TestWord_248 "" UWORD Identity 0 0 0 255 ECU_ADDRESS 0x1BE4FC FORMAT "%.0" SYMBOL_LINK "testByte000" 996 /end MEASUREMENT
/begin MEASUREMENT TestWord_249 "" UWORD Identity 0 0 0 255 ECU_ADDRESS 0x1BE500 FORMAT "%.0" SYMBOL_LINK "testByte000" 1000 /end MEASUREMENT
/begin MEASUREMENT TestWord_250 "" UWORD Identity 0 0 0 255 ECU_ADDRESS 0x1BE504 FORMAT "%.0" SYMBOL_LINK "testByte000" 1004 /end MEASUREMENT
/begin MEASUREMENT TestWord_252 "" UWORD Identity 0 0 0 255 ECU_ADDRESS 0x1BE50C FORMAT "%.0" SYMBOL_LINK "testByte000" 1012 /end MEASUREMENT
/begin MEASUREMENT TestWord_253 "" UWORD Identity 0 0 0 255 ECU_ADDRESS 0x1BE510 FORMAT "%.0" SYMBOL_LINK "testByte000" 1016 /end MEASUREMENT
/begin MEASUREMENT TestWord_254 "" UWORD Identity 0 0 0 255 ECU_ADDRESS 0x1BE514 FORMAT "%.0" SYMBOL_LINK "testByte000" 1020 /end MEASUREMENT
/begin MEASUREMENT TestWord_255 "" UWORD Identity 0 0 0 255 ECU_ADDRESS 0x1BE518 FORMAT "%.0" SYMBOL_LINK "testByte000" 1024 /end MEASUREMENT
/begin MEASUREMENT TestWord_256 "" UWORD Identity 0 0 0 255 ECU_ADDRESS 0x1BE51C FORMAT "%.0" SYMBOL_LINK "testByte000" 1028 /end MEASUREMENT
/begin MEASUREMENT TestWord_258 "" UWORD Identity 0 0 0 255 ECU_ADDRESS 0x1BE524 FORMAT "%.0" SYMBOL_LINK "testByte000" 1036 /end MEASUREMENT
/begin MEASUREMENT TestWord_259 "" UWORD Identity 0 0 0 255 ECU_ADDRESS 0x1BE528 FORMAT "%.0" SYMBOL_LINK "testByte000" 1040 /end MEASUREMENT
/begin MEASUREMENT TestWord_260 "" UWORD Identity 0 0 0 255 ECU_ADDRESS 0x1BE52C FORMAT "%.0" SYMBOL_LINK "testByte000" 1044 /end MEASUREMENT
/begin MEASUREMENT TestWord_261 "" UWORD Identity 0 0 0 255 ECU_ADDRESS 0x1BE530 FORMAT "%.0" SYMBOL_LINK "testByte000" 1048 /end MEASUREMENT
/begin MEASUREMENT TestWord_262 "" UWORD Identity 0 0 0 255 ECU_ADDRESS 0x1BE534 FORMAT "%.0" SYMBOL_LINK "testByte000" 1052 /end MEASUREMENT
/begin MEASUREMENT TestWord_264 "" UWORD Identity 0 0 0 255 ECU_ADDRESS 0x1BE53C FORMAT "%.0" SYMBOL_LINK "testByte000" 1060 /end MEASUREMENT
/begin MEASUREMENT TestWord_265 "" UWORD Identity 0 0 0 255 ECU_ADDRESS 0x1BE540 FORMAT "%.0" SYMBOL_LINK "testByte000" 1064 /end MEASUREMENT
/begin MEASUREMENT TestWord_266 "" UWORD Identity 0 0 0 255 ECU_ADDRESS 0x1BE544 FORMAT "%.0" SYMBOL_LINK "testByte000" 1068 /end MEASUREMENT
/begin MEASUREMENT TestWord_267 "" UWORD Identity 0 0 0 255 ECU_ADDRESS 0x1BE548 FORMAT "%.0" SYMBOL_LINK "testByte000" 1072 /end MEASUREMENT
/begin MEASUREMENT TestWord_268 "" UWORD Identity 0 0 0 255 ECU_ADDRESS 0x1BE54C FORMAT "%.0" SYMBOL_LINK "testByte000" 1076 /end MEASUREMENT
/begin MEASUREMENT TestWord_271 "" UWORD Identity 0 0 0 255 ECU_ADDRESS 0x1BE558 FORMAT "%.0" SYMBOL_LINK "testByte000" 1088 /end MEASUREMENT
/begin MEASUREMENT TestWord_272 "" UWORD Identity 0 0 0 255 ECU_ADDRESS 0x1BE55C FORMAT "%.0" SYMBOL_LINK "testByte000" 1092 /end MEASUREMENT
/begin MEASUREMENT TestWord_273 "" UWORD Identity 0 0 0 255 ECU_ADDRESS 0x1BE560 FORMAT "%.0" SYMBOL_LINK "testByte000" 1096 /end MEASUREMENT
/begin MEASUREMENT TestWord_275 "" UWORD Identity 0 0 0 255 ECU_ADDRESS 0x1BE568 FORMAT "%.0" SYMBOL_LINK "testByte000" 1104 /end MEASUREMENT
/begin MEASUREMENT TestWord_278 "" UWORD Identity 0 0 0 255 ECU_ADDRESS 0x1BE574 FORMAT "%.0" SYMBOL_LINK "testByte000" 1116 /end MEASUREMENT
/begin MEASUREMENT TestWord_279 "" UWORD Identity 0 0 0 255 ECU_ADDRESS 0x1BE578 FORMAT "%.0" SYMBOL_LINK "testByte000" 1120 /end MEASUREMENT
/begin MEASUREMENT TestWord_280 "" UWORD Identity 0 0 0 255 ECU_ADDRESS 0x1BE57C FORMAT "%.0" SYMBOL_LINK "testByte000" 1124 /end MEASUREMENT
/begin MEASUREMENT TestWord_281 "" UWORD Identity 0 0 0 255 ECU_ADDRESS 0x1BE580 FORMAT "%.0" SYMBOL_LINK "testByte000" 1128 /end MEASUREMENT
/begin MEASUREMENT TestWord_282 "" UWORD Identity 0 0 0 255 ECU_ADDRESS 0x1BE584 FORMAT "%.0" SYMBOL_LINK "testByte000" 1132 /end MEASUREMENT
/begin MEASUREMENT TestWord_284 "" UWORD Identity 0 0 0 255 ECU_ADDRESS 0x1BE58C FORMAT "%.0" SYMBOL_LINK "testByte000" 1140 /end MEASUREMENT
/begin MEASUREMENT TestWord_285 "" UWORD Identity 0 0 0 255 ECU_ADDRESS 0x1BE590 FORMAT "%.0" SYMBOL_LINK "testByte000" 1144 /end MEASUREMENT
/begin MEASUREMENT TestWord_287 "" UWORD Identity 0 0 0 255 ECU_ADDRESS 0x1BE598 FORMAT "%.0" SYMBOL_LINK "testByte000" 1152 /end MEASUREMENT
/begin MEASUREMENT TestWord_288 "" UWORD Identity 0 0 0 255 ECU_ADDRESS 0x1BE59C FORMAT "%.0" SYMBOL_LINK "testByte000" 1156 /end MEASUREMENT
/begin MEASUREMENT TestWord_289 "" UWORD Identity 0 0 0 255 ECU_ADDRESS 0x1BE5A0 FORMAT "%.0" SYMBOL_LINK "testByte000" 1160 /end MEASUREMENT
/begin MEASUREMENT TestWord_290 "" UWORD Identity 0 0 0 255 ECU_ADDRESS 0x1BE5A4 FORMAT "%.0" SYMBOL_LINK "testByte000" 1164 /end MEASUREMENT
/begin MEASUREMENT TestWord_291 "" UWORD Identity 0 0 0 255 ECU_ADDRESS 0x1BE5A8 FORMAT "%.0" SYMBOL_LINK "testByte000" 1168 /end MEASUREMENT
/begin MEASUREMENT TestWord_292 "" UWORD Identity 0 0 0 255 ECU_ADDRESS 0x1BE5AC FORMAT "%.0" SYMBOL_LINK "testByte000" 1172 /end MEASUREMENT
/begin MEASUREMENT TestWord_293 "" UWORD Identity 0 0 0 255 ECU_ADDRESS 0x1BE5B0 FORMAT "%.0" SYMBOL_LINK "testByte000" 1176 /end MEASUREMENT
/begin MEASUREMENT TestWord_294 "" UWORD Identity 0 0 0 255 ECU_ADDRESS 0x1BE5B4 FORMAT "%.0" SYMBOL_LINK "testByte000" 1180 /end MEASUREMENT
/begin MEASUREMENT TestWord_295 "" UWORD Identity 0 0 0 255 ECU_ADDRESS 0x1BE5B8 FORMAT "%.0" SYMBOL_LINK "testByte000" 1184 /end MEASUREMENT
/begin MEASUREMENT TestWord_298 "" UWORD Identity 0 0 0 255 ECU_ADDRESS 0x1BE5C4 FORMAT "%.0" SYMBOL_LINK "testByte000" 1196 /end MEASUREMENT
/begin MEASUREMENT TestWord_299 "" UWORD Identity 0 0 0 255 ECU_ADDRESS 0x1BE5C8 FORMAT "%.0" SYMBOL_LINK "testByte000" 1200 /end MEASUREMENT
/begin MEASUREMENT TestWord_300 "" UWORD Identity 0 0 0 255 ECU_ADDRESS 0x1BE5CC FORMAT "%.0" SYMBOL_LINK "testByte000" 1204 /end MEASUREMENT
/begin MEASUREMENT TestWord_301 "" UWORD Identity 0 0 0 255 ECU_ADDRESS 0x1BE5D0 FORMAT "%.0" SYMBOL_LINK "testByte000" 1208 /end MEASUREMENT
/begin MEASUREMENT TestWord_303 "" UWORD Identity 0 0 0 255 ECU_ADDRESS 0x1BE5D8 FORMAT "%.0" SYMBOL_LINK "testByte000" 1216 /end MEASUREMENT
/begin MEASUREMENT TestWord_304 "" UWORD Identity 0 0 0 255 ECU_ADDRESS 0x1BE5DC FORMAT "%.0" SYMBOL_LINK "testByte000" 1220 /end MEASUREMENT
/begin MEASUREMENT TestWord_305 "" UWORD Identity 0 0 0 255 ECU_ADDRESS 0x1BE5E0 FORMAT "%.0" SYMBOL_LINK "testByte000" 1224 /end MEASUREMENT
/begin MEASUREMENT TestWord_307 "" UWORD Identity 0 0 0 255 ECU_ADDRESS 0x1BE5E8 FORMAT "%.0" SYMBOL_LINK "testByte000" 1232 /end MEASUREMENT
/begin MEASUREMENT TestWord_310 "" UWORD Identity 0 0 0 255 ECU_ADDRESS 0x1BE5F4 FORMAT "%.0" SYMBOL_LINK "testByte000" 1244 /end MEASUREMENT
/begin MEASUREMENT TestWord_311 "" UWORD Identity 0 0 0 255 ECU_ADDRESS 0x1BE5F8 FORMAT "%.0" SYMBOL_LINK "testByte000" 1248 /end MEASUREMENT
/begin MEASUREMENT TestWord_312 "" UWORD Identity 0 0 0 255 ECU_ADDRESS 0x1BE5FC FORMAT "%.0" SYMBOL_LINK "testByte000" 1252 /end MEASUREMENT
/begin MEASUREMENT TestWord_314 "" UWORD Identity 0 0 0 255 ECU_ADDRESS 0x1BE604 FORMAT "%.0" SYMBOL_LINK "testByte000" 1260 /end MEASUREMENT
/begin MEASUREMENT TestWord_315 "" UWORD Identity 0 0 0 255 ECU_ADDRESS 0x1BE608 FORMAT "%.0" SYMBOL_LINK "testByte000" 1264 /end MEASUREMENT
/begin MEASUREMENT TestWord_316 "" UWORD Identity 0 0 0 255 ECU_ADDRESS 0x1BE60C FORMAT "%.0" SYMBOL_LINK "testByte000" 1268 /end MEASUREMENT
/begin MEASUREMENT TestWord_317 "" UWORD Identity 0 0 0 255 ECU_ADDRESS 0x1BE610 FORMAT "%.0" SYMBOL_LINK "testByte000" 1272 /end MEASUREMENT
/begin MEASUREMENT TestWord_318 "" UWORD Identity 0 0 0 255 ECU_ADDRESS 0x1BE614 FORMAT "%.0" SYMBOL_LINK "testByte000" 1276 /end MEASUREMENT
/begin MEASUREMENT TestWord_319 "" UWORD Identity 0 0 0 255 ECU_ADDRESS 0x1BE618 FORMAT "%.0" SYMBOL_LINK "testByte000" 1280 /end MEASUREMENT
/begin MEASUREMENT TestWord_320 "" UWORD Identity 0 0 0 255 ECU_ADDRESS 0x1BE61C FORMAT "%.0" SYMBOL_LINK "testByte000" 1284 /end MEASUREMENT
/begin MEASUREMENT TestWord_321 "" UWORD Identity 0 0 0 255 ECU_ADDRESS 0x1BE620 FORMAT "%.0" SYMBOL_LINK "testByte000" 1288 /end MEASUREMENT
/begin MEASUREMENT TestWord_322 "" UWORD Identity 0 0 0 255 ECU_ADDRESS 0x1BE624 FORMAT "%.0" SYMBOL_LINK "testByte000" 1292 /end MEASUREMENT
/begin MEASUREMENT TestWord_323 "" UWORD Identity 0 0 0 255 ECU_ADDRESS 0x1BE628 FORMAT "%.0" SYMBOL_LINK "testByte000" 1296 /end MEASUREMENT
/begin MEASUREMENT TestWord_325 "" UWORD Identity 0 0 0 255 ECU_ADDRESS 0x1BE630 FORMAT "%.0" SYMBOL_LINK "testByte000" 1304 /end MEASUREMENT
/begin MEASUREMENT TestWord_327 "" UWORD Identity 0 0 0 255 ECU_ADDRESS 0x1BE638 FORMAT "%.0" SYMBOL_LINK "testByte000" 1312 /end MEASUREMENT
/begin MEASUREMENT TestWord_328 "" UWORD Identity 0 0 0 255 ECU_ADDRESS 0x1BE63C FORMAT "%.0" SYMBOL_LINK "testByte000" 1316 /end MEASUREMENT
/begin MEASUREMENT TestWord_329 "" UWORD Identity 0 0 0 255 ECU_ADDRESS 0x1BE640 FORMAT "%.0" SYMBOL_LINK "testByte000" 1320 /end MEASUREMENT
/begin MEASUREMENT TestWord_330 "" UWORD Identity 0 0 0 255 ECU_ADDRESS 0x1BE644 FORMAT "%.0" SYMBOL_LINK "testByte000" 1324 /end MEASUREMENT
/begin MEASUREMENT TestWord_331 "" UWORD Identity 0 0 0 255 ECU_ADDRESS 0x1BE648 FORMAT "%.0" SYMBOL_LINK "testByte000" 1328 /end MEASUREMENT
/begin MEASUREMENT TestWord_332 "" UWORD Identity 0 0 0 255 ECU_ADDRESS 0x1BE64C FORMAT "%.0" SYMBOL_LINK "testByte000" 1332 /end MEASUREMENT
/begin MEASUREMENT TestWord_333 "" UWORD Identity 0 0 0 255 ECU_ADDRESS 0x1BE650 FORMAT "%.0" SYMBOL_LINK "testByte000" 1336 /end MEASUREMENT
/begin MEASUREMENT TestWord_334 "" UWORD Identity 0 0 0 255 ECU_ADDRESS 0x1BE654 FORMAT "%.0" SYMBOL_LINK "testByte000" 1340 /end MEASUREMENT
/begin MEASUREMENT TestWord_335 "" UWORD Identity 0 0 0 255 ECU_ADDRESS 0x1BE658 FORMAT "%.0" SYMBOL_LINK "testByte000" 1344 /end MEASUREMENT
/begin MEASUREMENT TestWord_336 "" UWORD Identity 0 0 0 255 ECU_ADDRESS 0x1BE65C FORMAT "%.0" SYMBOL_LINK "testByte000" 1348 /end MEASUREMENT
/begin MEASUREMENT TestWord_337 "" UWORD Identity 0 0 0 255 ECU_ADDRESS 0x1BE660 FORMAT "%.0" SYMBOL_LINK "testByte000" 1352 /end MEASUREMENT
/begin MEASUREMENT TestWord_339 "" UWORD Identity 0 0 0 255 ECU_ADDRESS 0x1BE668 FORMAT "%.0" SYMBOL_LINK "testByte000" 1360 /end MEASUREMENT
/begin MEASUREMENT TestWord_341 "" UWORD Identity 0 0 0 255 ECU_ADDRESS 0x1BE670 FORMAT "%.0" SYMBOL_LINK "testByte000" 1368 /end MEASUREMENT
/begin MEASUREMENT TestWord_342 "" UWORD Identity 0 0 0 255 ECU_ADDRESS 0x1BE674 FORMAT "%.0" SYMBOL_LINK "testByte000" 1372 /end MEASUREMENT
/begin MEASUREMENT TestWord_343 "" UWORD Identity 0 0 0 255 ECU_ADDRESS 0x1BE678 FORMAT "%.0" SYMBOL_LINK "testByte000" 1376 /end MEASUREMENT
/begin MEASUREMENT TestWord_345 "" UWORD Identity 0 0 0 255 ECU_ADDRESS 0x1BE680 FORMAT "%.0" SYMBOL_LINK "testByte000" 1384 /end MEASUREMENT
/begin MEASUREMENT TestWord_347 "" UWORD Identity 0 0 0 255 ECU_ADDRESS 0x1BE688 FORMAT "%.0" SYMBOL_LINK "testByte000" 1392 /end MEASUREMENT
/begin MEASUREMENT TestWord_349 "" UWORD Identity 0 0 0 255 ECU_ADDRESS 0x1BE690 FORMAT "%.0" SYMBOL_LINK "testByte000" 1400 /end MEASUREMENT
/begin MEASUREMENT TestWord_350 "" UWORD Identity 0 0 0 255 ECU_ADDRESS 0x1BE694 FORMAT "%.0" SYMBOL_LINK "testByte000" 1404 /end MEASUREMENT
/begin MEASUREMENT TestWord_351 "" UWORD Identity 0 0 0 255 ECU_ADDRESS 0x1BE698 FORMAT "%.0" SYMBOL_LINK "testByte000" 1408 /end MEASUREMENT
/begin MEASUREMENT TestWord_352 "" UWORD Identity 0 0 0 255 ECU_ADDRESS 0x1BE69C FORMAT "%.0" SYMBOL_LINK "testByte000" 1412 /end MEASUREMENT
/begin MEASUREMENT TestWord_353 "" UWORD Identity 0 0 0 255 ECU_ADDRESS 0x1BE6A0 FORMAT "%.0" SYMBOL_LINK "testByte000" 1416 /end MEASUREMENT
/begin MEASUREMENT TestWord_356 "" UWORD Identity 0 0 0 255 ECU_ADDRESS 0x1BE6AC FORMAT "%.0" SYMBOL_LINK "testByte000" 1428 /end MEASUREMENT
/begin MEASUREMENT TestWord_357 "" UWORD Identity 0 0 0 255 ECU_ADDRESS 0x1BE6B0 FORMAT "%.0" SYMBOL_LINK "testByte000" 1432 /end MEASUREMENT
/begin MEASUREMENT TestWord_361 "" UWORD Identity 0 0 0 255 ECU_ADDRESS 0x1BE6C0 FORMAT "%.0" SYMBOL_LINK "testByte000" 1448 /end MEASUREMENT
/begin MEASUREMENT TestWord_362 "" UWORD Identity 0 0 0 255 ECU_ADDRESS 0x1BE6C4 FORMAT "%.0" SYMBOL_LINK "testByte000" 1452 /end MEASUREMENT
/begin MEASUREMENT TestWord_363 "" UWORD Identity 0 0 0 255 ECU_ADDRESS 0x1BE6C8 FORMAT "%.0" SYMBOL_LINK "testByte000" 1456 /end MEASUREMENT
/begin MEASUREMENT TestWord_364 "" UWORD Identity 0 0 0 255 ECU_ADDRESS 0x1BE6CC FORMAT "%.0" SYMBOL_LINK "testByte000" 1460 /end MEASUREMENT
/begin MEASUREMENT TestWord_365 "" UWORD Identity 0 0 0 255 ECU_ADDRESS 0x1BE6D0 FORMAT "%.0" SYMBOL_LINK "testByte000" 1464 /end MEASUREMENT
/begin MEASUREMENT TestWord_366 "" UWORD Identity 0 0 0 255 ECU_ADDRESS 0x1BE6D4 FORMAT "%.0" SYMBOL_LINK "testByte000" 1468 /end MEASUREMENT
/begin MEASUREMENT TestWord_367 "" UWORD Identity 0 0 0 255 ECU_ADDRESS 0x1BE6D8 FORMAT "%.0" SYMBOL_LINK "testByte000" 1472 /end MEASUREMENT
/begin MEASUREMENT TestWord_368 "" UWORD Identity 0 0 0 255 ECU_ADDRESS 0x1BE6DC FORMAT "%.0" SYMBOL_LINK "testByte000" 1476 /end MEASUREMENT
/begin MEASUREMENT TestWord_369 "" UWORD Identity 0 0 0 255 ECU_ADDRESS 0x1BE6E0 FORMAT "%.0" SYMBOL_LINK "testByte000" 1480 /end MEASUREMENT
/begin MEASUREMENT TestWord_370 "" UWORD Identity 0 0 0 255 ECU_ADDRESS 0x1BE6E4 FORMAT "%.0" SYMBOL_LINK "testByte000" 1484 /end MEASUREMENT
/begin MEASUREMENT TestWord_371 "" UWORD Identity 0 0 0 255 ECU_ADDRESS 0x1BE6E8 FORMAT "%.0" SYMBOL_LINK "testByte000" 1488 /end MEASUREMENT
/begin MEASUREMENT TestWord_373 "" UWORD Identity 0 0 0 255 ECU_ADDRESS 0x1BE6F0 FORMAT "%.0" SYMBOL_LINK "testByte000" 1496 /end MEASUREMENT
/begin MEASUREMENT TestWord_374 "" UWORD Identity 0 0 0 255 ECU_ADDRESS 0x1BE6F4 FORMAT "%.0" SYMBOL_LINK "testByte000" 1500 /end MEASUREMENT
/begin MEASUREMENT TestWord_377 "" UWORD Identity 0 0 0 255 ECU_ADDRESS 0x1BE700 FORMAT "%.0" SYMBOL_LINK "testByte000" 1512 /end MEASUREMENT
/begin MEASUREMENT TestWord_379 "" UWORD Identity 0 0 0 255 ECU_ADDRESS 0x1BE708 FORMAT "%.0" SYMBOL_LINK "testByte000" 1520 /end MEASUREMENT
/begin MEASUREMENT TestWord_380 "" UWORD Identity 0 0 0 255 ECU_ADDRESS 0x1BE70C FORMAT "%.0" SYMBOL_LINK "testByte000" 1524 /end MEASUREMENT
/begin MEASUREMENT TestWord_381 "" UWORD Identity 0 0 0 255 ECU_ADDRESS 0x1BE710 FORMAT "%.0" SYMBOL_LINK "testByte000" 1528 /end MEASUREMENT
/begin MEASUREMENT TestWord_382 "" UWORD Identity 0 0 0 255 ECU_ADDRESS 0x1BE714 FORMAT "%.0" SYMBOL_LINK "testByte000" 1532 /end MEASUREMENT
/begin MEASUREMENT TestWord_384 "" UWORD Identity 0 0 0 255 ECU_ADDRESS 0x1BE71C FORMAT "%.0" SYMBOL_LINK "testByte000" 1540 /end MEASUREMENT
/begin MEASUREMENT TestWord_386 "" UWORD Identity 0 0 0 255 ECU_ADDRESS 0x1BE724 FORMAT "%.0" SYMBOL_LINK "testByte000" 1548 /end MEASUREMENT
/begin MEASUREMENT TestWord_389 "" UWORD Identity 0 0 0 255 ECU_ADDRESS 0x1BE730 FORMAT "%.0" SYMBOL_LINK "testByte000" 1560 /end MEASUREMENT
/begin MEASUREMENT TestWord_390 "" UWORD Identity 0 0 0 255 ECU_ADDRESS 0x1BE734 FORMAT "%.0" SYMBOL_LINK "testByte000" 1564 /end MEASUREMENT
/begin MEASUREMENT TestWord_391 "" UWORD Identity 0 0 0 255 ECU_ADDRESS 0x1BE738 FORMAT "%.0" SYMBOL_LINK "testByte000" 1568 /end MEASUREMENT
/begin MEASUREMENT TestWord_392 "" UWORD Identity 0 0 0 255 ECU_ADDRESS 0x1BE73C FORMAT "%.0" SYMBOL_LINK "testByte000" 1572 /end MEASUREMENT
/begin MEASUREMENT TestWord_393 "" UWORD Identity 0 0 0 255 ECU_ADDRESS 0x1BE740 FORMAT "%.0" SYMBOL_LINK "testByte000" 1576 /end MEASUREMENT
/begin MEASUREMENT TestWord_394 "" UWORD Identity 0 0 0 255 ECU_ADDRESS 0x1BE744 FORMAT "%.0" SYMBOL_LINK "testByte000" 1580 /end MEASUREMENT
/begin MEASUREMENT TestWord_395 "" UWORD Identity 0 0 0 255 ECU_ADDRESS 0x1BE748 FORMAT "%.0" SYMBOL_LINK "testByte000" 1584 /end MEASUREMENT
/begin MEASUREMENT TestWord_397 "" UWORD Identity 0 0 0 255 ECU_ADDRESS 0x1BE750 FORMAT "%.0" SYMBOL_LINK "testByte000" 1592 /end MEASUREMENT
/begin MEASUREMENT TestWord_400 "" UWORD Identity 0 0 0 255 ECU_ADDRESS 0x1BE75C FORMAT "%.0" SYMBOL_LINK "testByte000" 1604 /end MEASUREMENT
/begin MEASUREMENT TestWord_401 "" UWORD Identity 0 0 0 255 ECU_ADDRESS 0x1BE760 FORMAT "%.0" SYMBOL_LINK "testByte000" 1608 /end MEASUREMENT
/begin MEASUREMENT TestWord_404 "" UWORD Identity 0 0 0 255 ECU_ADDRESS 0x1BE76C FORMAT "%.0" SYMBOL_LINK "testByte000" 1620 /end MEASUREMENT
/begin MEASUREMENT TestWord_405 "" UWORD Identity 0 0 0 255 ECU_ADDRESS 0x1BE770 FORMAT "%.0" SYMBOL_LINK "testByte000" 1624 /end MEASUREMENT
/begin MEASUREMENT TestWord_408 "" UWORD Identity 0 0 0 255 ECU_ADDRESS 0x1BE77C FORMAT "%.0" SYMBOL_LINK "testByte000" 1636 /end MEASUREMENT
/begin MEASUREMENT TestWord_412 "" UWORD Identity 0 0 0 255 ECU_ADDRESS 0x1BE78C FORMAT "%.0" SYMBOL_LINK "testByte000" 1652 /end MEASUREMENT
/begin MEASUREMENT TestWord_416 "" UWORD Identity 0 0 0 255 ECU_ADDRESS 0x1BE79C FORMAT "%.0" SYMBOL_LINK "testByte000" 1668 /end MEASUREMENT
/begin MEASUREMENT TestWord_417 "" UWORD Identity 0 0 0 255 ECU_ADDRESS 0x1BE7A0 FORMAT "%.0" SYMBOL_LINK "testByte000" 1672 /end MEASUREMENT
/begin MEASUREMENT TestWord_418 "" UWORD Identity 0 0 0 255 ECU_ADDRESS 0x1BE7A4 FORMAT "%.0" SYMBOL_LINK "testByte000" 1676 /end MEASUREMENT
/begin MEASUREMENT TestWord_419 "" UWORD Identity 0 0 0 255 ECU_ADDRESS 0x1BE7A8 FORMAT "%.0" SYMBOL_LINK "testByte000" 1680 /end MEASUREMENT
/begin MEASUREMENT TestWord_420 "" UWORD Identity 0 0 0 255 ECU_ADDRESS 0x1BE7AC FORMAT "%.0" SYMBOL_LINK "testByte000" 1684 /end MEASUREMENT
/begin MEASUREMENT TestWord_421 "" UWORD Identity 0 0 0 255 ECU_ADDRESS 0x1BE7B0 FORMAT "%.0" SYMBOL_LINK "testByte000" 1688 /end MEASUREMENT
/begin MEASUREMENT TestWord_422 "" UWORD Identity 0 0 0 255 ECU_ADDRESS 0x1BE7B4 FORMAT "%.0" SYMBOL_LINK "testByte000" 1692 /end MEASUREMENT
/begin MEASUREMENT TestWord_423 "" UWORD Identity 0 0 0 255 ECU_ADDRESS 0x1BE7B8 FORMAT "%.0" SYMBOL_LINK "testByte000" 1696 /end MEASUREMENT
/begin MEASUREMENT TestWord_424 "" UWORD Identity 0 0 0 255 ECU_ADDRESS 0x1BE7BC FORMAT "%.0" SYMBOL_LINK "testByte000" 1700 /end MEASUREMENT
/begin MEASUREMENT TestWord_425 "" UWORD Identity 0 0 0 255 ECU_ADDRESS 0x1BE7C0 FORMAT "%.0" SYMBOL_LINK "testByte000" 1704 /end MEASUREMENT
/begin MEASUREMENT TestWord_428 "" UWORD Identity 0 0 0 255 ECU_ADDRESS 0x1BE7CC FORMAT "%.0" SYMBOL_LINK "testByte000" 1716 /end MEASUREMENT
/begin MEASUREMENT TestWord_429 "" UWORD Identity 0 0 0 255 ECU_ADDRESS 0x1BE7D0 FORMAT "%.0" SYMBOL_LINK "testByte000" 1720 /end MEASUREMENT
/begin MEASUREMENT TestWord_430 "" UWORD Identity 0 0 0 255 ECU_ADDRESS 0x1BE7D4 FORMAT "%.0" SYMBOL_LINK "testByte000" 1724 /end MEASUREMENT
/begin MEASUREMENT TestWord_432 "" UWORD Identity 0 0 0 255 ECU_ADDRESS 0x1BE7DC FORMAT "%.0" SYMBOL_LINK "testByte000" 1732 /end MEASUREMENT
/begin MEASUREMENT TestWord_434 "" UWORD Identity 0 0 0 255 ECU_ADDRESS 0x1BE7E4 FORMAT "%.0" SYMBOL_LINK "testByte000" 1740 /end MEASUREMENT
/begin MEASUREMENT TestWord_435 "" UWORD Identity 0 0 0 255 ECU_ADDRESS 0x1BE7E8 FORMAT "%.0" SYMBOL_LINK "testByte000" 1744 /end MEASUREMENT
/begin MEASUREMENT TestWord_436 "" UWORD Identity 0 0 0 255 ECU_ADDRESS 0x1BE7EC FORMAT "%.0" SYMBOL_LINK "testByte000" 1748 /end MEASUREMENT
/begin MEASUREMENT TestWord_437 "" UWORD Identity 0 0 0 255 ECU_ADDRESS 0x1BE7F0 FORMAT "%.0" SYMBOL_LINK "testByte000" 1752 /end MEASUREMENT
/begin MEASUREMENT TestWord_439 "" UWORD Identity 0 0 0 255 ECU_ADDRESS 0x1BE7F8 FORMAT "%.0" SYMBOL_LINK "testByte000" 1760 /end MEASUREMENT
/begin MEASUREMENT TestWord_440 "" UWORD Identity 0 0 0 255 ECU_ADDRESS 0x1BE7FC FORMAT "%.0" SYMBOL_LINK "testByte000" 1764 /end MEASUREMENT
/begin MEASUREMENT TestWord_441 "" UWORD Identity 0 0 0 255 ECU_ADDRESS 0x1BE800 FORMAT "%.0" SYMBOL_LINK "testByte000" 1768 /end MEASUREMENT
/begin MEASUREMENT TestWord_442 "" UWORD Identity 0 0 0 255 ECU_ADDRESS 0x1BE804 FORMAT "%.0" SYMBOL_LINK "testByte000" 1772 /end MEASUREMENT
/begin MEASUREMENT TestWord_445 "" UWORD Identity 0 0 0 255 ECU_ADDRESS 0x1BE810 FORMAT "%.0" SYMBOL_LINK "testByte000" 1784 /end MEASUREMENT
/begin MEASUREMENT TestWord_447 "" UWORD Identity 0 0 0 255 ECU_ADDRESS 0x1BE818 FORMAT "%.0" SYMBOL_LINK "testByte000" 1792 /end MEASUREMENT
/begin MEASUREMENT TestWord_449 "" UWORD Identity 0 0 0 255 ECU_ADDRESS 0x1BE820 FORMAT "%.0" SYMBOL_LINK "testByte000" 1800 /end MEASUREMENT
/begin MEASUREMENT TestWord_450 "" UWORD Identity 0 0 0 255 ECU_ADDRESS 0x1BE824 FORMAT "%.0" SYMBOL_LINK "testByte000" 1804 /end MEASUREMENT
/begin MEASUREMENT TestWord_452 "" UWORD Identity 0 0 0 255 ECU_ADDRESS 0x1BE82C FORMAT "%.0" SYMBOL_LINK "testByte000" 1812 /end MEASUREMENT
/begin MEASUREMENT TestWord_453 "" UWORD Identity 0 0 0 255 ECU_ADDRESS 0x1BE830 FORMAT "%.0" SYMBOL_LINK "testByte000" 1816 /end MEASUREMENT
/begin MEASUREMENT TestWord_454 "" UWORD Identity 0 0 0 255 ECU_ADDRESS 0x1BE834 FORMAT "%.0" SYMBOL_LINK "testByte000" 1820 /end MEASUREMENT
/begin MEASUREMENT TestWord_455 "" UWORD Identity 0 0 0 255 ECU_ADDRESS 0x1BE838 FORMAT "%.0" SYMBOL_LINK "testByte000" 1824 /end MEASUREMENT
/begin MEASUREMENT TestWord_456 "" UWORD Identity 0 0 0 255 ECU_ADDRESS 0x1BE83C FORMAT "%.0" SYMBOL_LINK "testByte000" 1828 /end MEASUREMENT
/begin MEASUREMENT TestWord_457 "" UWORD Identity 0 0 0 255 ECU_ADDRESS 0x1BE840 FORMAT "%.0" SYMBOL_LINK "testByte000" 1832 /end MEASUREMENT
/begin MEASUREMENT TestWord_459 "" UWORD Identity 0 0 0 255 ECU_ADDRESS 0x1BE848 FORMAT "%.0" SYMBOL_LINK "testByte000" 1840 /end MEASUREMENT
/begin MEASUREMENT TestWord_460 "" UWORD Identity 0 0 0 255 ECU_ADDRESS 0x1BE84C FORMAT "%.0" SYMBOL_LINK "testByte000" 1844 /end MEASUREMENT
/begin MEASUREMENT TestWord_461 "" UWORD Identity 0 0 0 255 ECU_ADDRESS 0x1BE850 FORMAT "%.0" SYMBOL_LINK "testByte000" 1848 /end MEASUREMENT
/begin MEASUREMENT TestWord_463 "" UWORD Identity 0 0 0 255 ECU_ADDRESS 0x1BE858 FORMAT "%.0" SYMBOL_LINK "testByte000" 1856 /end MEASUREMENT
/begin MEASUREMENT TestWord_464 "" UWORD Identity 0 0 0 255 ECU_ADDRESS 0x1BE85C FORMAT "%.0" SYMBOL_LINK "testByte000" 1860 /end MEASUREMENT
/begin MEASUREMENT TestWord_465 "" UWORD Identity 0 0 0 255 ECU_ADDRESS 0x1BE860 FORMAT "%.0" SYMBOL_LINK "testByte000" 1864 /end MEASUREMENT
/begin MEASUREMENT TestWord_467 "" UWORD Identity 0 0 0 255 ECU_ADDRESS 0x1BE868 FORMAT "%.0" SYMBOL_LINK "testByte000" 1872 /end MEASUREMENT
/begin MEASUREMENT TestWord_468 "" UWORD Identity 0 0 0 255 ECU_ADDRESS 0x1BE86C FORMAT "%.0" SYMBOL_LINK "testByte000" 1876 /end MEASUREMENT
/begin MEASUREMENT TestWord_472 "" UWORD Identity 0 0 0 255 ECU_ADDRESS 0x1BE87C FORMAT "%.0" SYMBOL_LINK "testByte000" 1892 /end MEASUREMENT
/begin MEASUREMENT TestWord_473 "" UWORD Identity 0 0 0 255 ECU_ADDRESS 0x1BE880 FORMAT "%.0" SYMBOL_LINK "testByte000" 1896 /end MEASUREMENT
/begin MEASUREMENT TestWord_475 "" UWORD Identity 0 0 0 255 ECU_ADDRESS 0x1BE888 FORMAT "%.0" SYMBOL_LINK "testByte000" 1904 /end MEASUREMENT
/begin MEASUREMENT TestWord_476 "" UWORD Identity 0 0 0 255 ECU_ADDRESS 0x1BE88C FORMAT "%.0" SYMBOL_LINK "testByte000" 1908 /end MEASUREMENT
/begin MEASUREMENT TestWord_477 "" UWORD Identity 0 0 0 255 ECU_ADDRESS 0x1BE890 FORMAT "%.0" SYMBOL_LINK "testByte000" 1912 /end MEASUREMENT
/begin MEASUREMENT TestWord_481 "" UWORD Identity 0 0 0 255 ECU_ADDRESS 0x1BE8A0 FORMAT "%.0" SYMBOL_LINK "testByte000" 1928 /end MEASUREMENT
/begin MEASUREMENT TestWord_482 "" UWORD Identity 0 0 0 255 ECU_ADDRESS 0x1BE8A4 FORMAT "%.0" SYMBOL_LINK "testByte000" 1932 /end MEASUREMENT
/begin MEASUREMENT TestWord_484 "" UWORD Identity 0 0 0 255 ECU_ADDRESS 0x1BE8AC FORMAT "%.0" SYMBOL_LINK "testByte000" 1940 /end MEASUREMENT
/begin MEASUREMENT TestWord_485 "" UWORD Identity 0 0 0 255 ECU_ADDRESS 0x1BE8B0 FORMAT "%.0" SYMBOL_LINK "testByte000" 1944 /end MEASUREMENT
/begin MEASUREMENT TestWord_487 "" UWORD Identity 0 0 0 255 ECU_ADDRESS 0x1BE8B8 FORMAT "%.0" SYMBOL_LINK "testByte000" 1952 /end MEASUREMENT
/begin MEASUREMENT TestWord_489 "" UWORD Identity 0 0 0 255 ECU_ADDRESS 0x1BE8C0 FORMAT "%.0" SYMBOL_LINK "testByte000" 1960 /end MEASUREMENT
/begin MEASUREMENT TestWord_490 "" UWORD Identity 0 0 0 255 ECU_ADDRESS 0x1BE8C4 FORMAT "%.0" SYMBOL_LINK "testByte000" 1964 /end MEASUREMENT
/begin MEASUREMENT TestWord_491 "" UWORD Identity 0 0 0 255 ECU_ADDRESS 0x1BE8C8 FORMAT "%.0" SYMBOL_LINK "testByte000" 1968 /end MEASUREMENT
/begin MEASUREMENT TestWord_493 "" UWORD Identity 0 0 0 255 ECU_ADDRESS 0x1BE8D0 FORMAT "%.0" SYMBOL_LINK "testByte000" 1976 /end MEASUREMENT
/begin MEASUREMENT TestWord_495 "" UWORD Identity 0 0 0 255 ECU_ADDRESS 0x1BE8D8 FORMAT "%.0" SYMBOL_LINK "testByte000" 1984 /end MEASUREMENT
/begin MEASUREMENT TestWord_497 "" UWORD Identity 0 0 0 255 ECU_ADDRESS 0x1BE8E0 FORMAT "%.0" SYMBOL_LINK "testByte000" 1992 /end MEASUREMENT
/begin MEASUREMENT TestWord_498 "" UWORD Identity 0 0 0 255 ECU_ADDRESS 0x1BE8E4 FORMAT "%.0" SYMBOL_LINK "testByte000" 1996 /end MEASUREMENT
/begin MEASUREMENT TestWord_499 "" UWORD Identity 0 0 0 255 ECU_ADDRESS 0x1BE8E8 FORMAT "%.0" SYMBOL_LINK "testByte000" 2000 /end MEASUREMENT
/begin MEASUREMENT TestWord_505 "" UWORD Identity 0 0 0 255 ECU_ADDRESS 0x1BE900 FORMAT "%.0" SYMBOL_LINK "testByte000" 2024 /end MEASUREMENT
/begin MEASUREMENT TestWord_506 "" UWORD Identity 0 0 0 255 ECU_ADDRESS 0x1BE904 FORMAT "%.0" SYMBOL_LINK "testByte000" 2028 /end MEASUREMENT
/begin MEASUREMENT TestWord_507 "" UWORD Identity 0 0 0 255 ECU_ADDRESS 0x1BE908 FORMAT "%.0" SYMBOL_LINK "testByte000" 2032 /end MEASUREMENT
/begin MEASUREMENT TestWord_509 "" UWORD Identity 0 0 0 255 ECU_ADDRESS 0x1BE910 FORMAT "%.0" SYMBOL_LINK "testByte000" 2040 /end MEASUREMENT
/begin MEASUREMENT TestWord_510 "" UWORD Identity 0 0 0 255 ECU_ADDRESS 0x1BE914 FORMAT "%.0" SYMBOL_LINK "testByte000" 2044 /end MEASUREMENT
/begin MEASUREMENT TestWord_511 "" UWORD Identity 0 0 0 255 ECU_ADDRESS 0x1BE918 FORMAT "%.0" SYMBOL_LINK "testByte000" 2048 /end MEASUREMENT
/begin MEASUREMENT TestWord_512 "" UWORD Identity 0 0 0 255 ECU_ADDRESS 0x1BE91C FORMAT "%.0" SYMBOL_LINK "testByte000" 2052 /end MEASUREMENT
/begin MEASUREMENT TestWord_513 "" UWORD Identity 0 0 0 255 ECU_ADDRESS 0x1BE920 FORMAT "%.0" SYMBOL_LINK "testByte000" 2056 /end MEASUREMENT
/begin MEASUREMENT TestWord_514 "" UWORD Identity 0 0 0 255 ECU_ADDRESS 0x1BE924 FORMAT "%.0" SYMBOL_LINK "testByte000" 2060 /end MEASUREMENT
/begin MEASUREMENT TestWord_515 "" UWORD Identity 0 0 0 255 ECU_ADDRESS 0x1BE928 FORMAT "%.0" SYMBOL_LINK "testByte000" 2064 /end MEASUREMENT
/begin MEASUREMENT TestWord_517 "" UWORD Identity 0 0 0 255 ECU_ADDRESS 0x1BE930 FORMAT "%.0" SYMBOL_LINK "testByte000" 2072 /end MEASUREMENT
/begin MEASUREMENT TestWord_518 "" UWORD Identity 0 0 0 255 ECU_ADDRESS 0x1BE934 FORMAT "%.0" SYMBOL_LINK "testByte000" 2076 /end MEASUREMENT
/begin MEASUREMENT TestWord_519 "" UWORD Identity 0 0 0 255 ECU_ADDRESS 0x1BE938 FORMAT "%.0" SYMBOL_LINK "testByte000" 2080 /end MEASUREMENT
/begin MEASUREMENT TestWord_520 "" UWORD Identity 0 0 0 255 ECU_ADDRESS 0x1BE93C FORMAT "%.0" SYMBOL_LINK "testByte000" 2084 /end MEASUREMENT
/begin MEASUREMENT TestWord_521 "" UWORD Identity 0 0 0 255 ECU_ADDRESS 0x1BE940 FORMAT "%.0" SYMBOL_LINK "testByte000" 2088 /end MEASUREMENT
/begin MEASUREMENT TestWord_522 "" UWORD Identity 0 0 0 255 ECU_ADDRESS 0x1BE944 FORMAT "%.0" SYMBOL_LINK "testByte000" 2092 /end MEASUREMENT
/begin MEASUREMENT TestWord_523 "" UWORD Identity 0 0 0 255 ECU_ADDRESS 0x1BE948 FORMAT "%.0" SYMBOL_LINK "testByte000" 2096 /end MEASUREMENT
/begin MEASUREMENT TestWord_525 "" UWORD Identity 0 0 0 255 ECU_ADDRESS 0x1BE950 FORMAT "%.0" SYMBOL_LINK "testByte000" 2104 /end MEASUREMENT
/begin MEASUREMENT TestWord_526 "" UWORD Identity 0 0 0 255 ECU_ADDRESS 0x1BE954 FORMAT "%.0" SYMBOL_LINK "testByte000" 2108 /end MEASUREMENT
/begin MEASUREMENT TestWord_528 "" UWORD Identity 0 0 0 255 ECU_ADDRESS 0x1BE95C FORMAT "%.0" SYMBOL_LINK "testByte000" 2116 /end MEASUREMENT
/begin MEASUREMENT TestWord_531 "" UWORD Identity 0 0 0 255 ECU_ADDRESS 0x1BE968 FORMAT "%.0" SYMBOL_LINK "testByte000" 2128 /end MEASUREMENT
/begin MEASUREMENT TestWord_532 "" UWORD Identity 0 0 0 255 ECU_ADDRESS 0x1BE96C FORMAT "%.0" SYMBOL_LINK "testByte000" 2132 /end MEASUREMENT
/begin MEASUREMENT TestWord_536 "" UWORD Identity 0 0 0 255 ECU_ADDRESS 0x1BE97C FORMAT "%.0" SYMBOL_LINK "testByte000" 2148 /end MEASUREMENT
/begin MEASUREMENT TestWord_537 "" UWORD Identity 0 0 0 255 ECU_ADDRESS 0x1BE980 FORMAT "%.0" SYMBOL_LINK "testByte000" 2152 /end MEASUREMENT
/begin MEASUREMENT TestWord_538 "" UWORD Identity 0 0 0 255 ECU_ADDRESS 0x1BE984 FORMAT "%.0" SYMBOL_LINK "testByte000" 2156 /end MEASUREMENT
/begin MEASUREMENT TestWord_539 "" UWORD Identity 0 0 0 255 ECU_ADDRESS 0x1BE988 FORMAT "%.0" SYMBOL_LINK "testByte000" 2160 /end MEASUREMENT
/begin MEASUREMENT TestWord_540 "" UWORD Identity 0 0 0 255 ECU_ADDRESS 0x1BE98C FORMAT "%.0" SYMBOL_LINK "testByte000" 2164 /end MEASUREMENT
/begin MEASUREMENT TestWord_541 "" UWORD Identity 0 0 0 255 ECU_ADDRESS 0x1BE990 FORMAT "%.0" SYMBOL_LINK "testByte000" 2168 /end MEASUREMENT
/begin MEASUREMENT TestWord_542 "" UWORD Identity 0 0 0 255 ECU_ADDRESS 0x1BE994 FORMAT "%.0" SYMBOL_LINK "testByte000" 2172 /end MEASUREMENT
/begin MEASUREMENT TestWord_543 "" UWORD Identity 0 0 0 255 ECU_ADDRESS 0x1BE998 FORMAT "%.0" SYMBOL_LINK "testByte000" 2176 /end MEASUREMENT
/begin MEASUREMENT TestWord_544 "" UWORD Identity 0 0 0 255 ECU_ADDRESS 0x1BE99C FORMAT "%.0" SYMBOL_LINK "testByte000" 2180 /end MEASUREMENT
/begin MEASUREMENT TestWord_546 "" UWORD Identity 0 0 0 255 ECU_ADDRESS 0x1BE9A4 FORMAT "%.0" SYMBOL_LINK "testByte000" 2188 /end MEASUREMENT
/begin MEASUREMENT TestWord_547 "" UWORD Identity 0 0 0 255 ECU_ADDRESS 0x1BE9A8 FORMAT "%.0" SYMBOL_LINK "testByte000" 2192 /end MEASUREMENT
/begin MEASUREMENT TestWord_548 "" UWORD Identity 0 0 0 255 ECU_ADDRESS 0x1BE9AC FORMAT "%.0" SYMBOL_LINK "testByte000" 2196 /end MEASUREMENT
/begin MEASUREMENT TestWord_549 "" UWORD Identity 0 0 0 255 ECU_ADDRESS 0x1BE9B0 FORMAT "%.0" SYMBOL_LINK "testByte000" 2200 /end MEASUREMENT
/begin MEASUREMENT TestWord_551 "" UWORD Identity 0 0 0 255 ECU_ADDRESS 0x1BE9B8 FORMAT "%.0" SYMBOL_LINK "testByte000" 2208 /end MEASUREMENT
/begin MEASUREMENT TestWord_552 "" UWORD Identity 0 0 0 255 ECU_ADDRESS 0x1BE9BC FORMAT "%.0" SYMBOL_LINK "testByte000" 2212 /end MEASUREMENT
/begin MEASUREMENT TestWord_553 "" UWORD Identity 0 0 0 255 ECU_ADDRESS 0x1BE9C0 FORMAT "%.0" SYMBOL_LINK "testByte000" 2216 /end MEASUREMENT
/begin MEASUREMENT TestWord_554 "" UWORD Identity 0 0 0 255 ECU_ADDRESS 0x1BE9C4 FORMAT "%.0" SYMBOL_LINK "testByte000" 2220 /end MEASUREMENT
/begin MEASUREMENT TestWord_555 "" UWORD Identity 0 0 0 255 ECU_ADDRESS 0x1BE9C8 FORMAT "%.0" SYMBOL_LINK "testByte000" 2224 /end MEASUREMENT
/begin MEASUREMENT TestWord_559 "" UWORD Identity 0 0 0 255 ECU_ADDRESS 0x1BE9D8 FORMAT "%.0" SYMBOL_LINK "testByte000" 2240 /end MEASUREMENT
/begin MEASUREMENT TestWord_560 "" UWORD Identity 0 0 0 255 ECU_ADDRESS 0x1BE9DC FORMAT "%.0" SYMBOL_LINK "testByte000" 2244 /end MEASUREMENT
/begin MEASUREMENT TestWord_561 "" UWORD Identity 0 0 0 255 ECU_ADDRESS 0x1BE9E0 FORMAT "%.0" SYMBOL_LINK "testByte000" 2248 /end MEASUREMENT
/begin MEASUREMENT TestWord_562 "" UWORD Identity 0 0 0 255 ECU_ADDRESS 0x1BE9E4 FORMAT "%.0" SYMBOL_LINK "testByte000" 2252 /end MEASUREMENT
/begin MEASUREMENT TestWord_563 "" UWORD Identity 0 0 0 255 ECU_ADDRESS 0x1BE9E8 FORMAT "%.0" SYMBOL_LINK "testByte000" 2256 /end MEASUREMENT
/begin MEASUREMENT TestWord_564 "" UWORD Identity 0 0 0 255 ECU_ADDRESS 0x1BE9EC FORMAT "%.0" SYMBOL_LINK "testByte000" 2260 /end MEASUREMENT
/begin MEASUREMENT TestWord_565 "" UWORD Identity 0 0 0 255 ECU_ADDRESS 0x1BE9F0 FORMAT "%.0" SYMBOL_LINK "testByte000" 2264 /end MEASUREMENT
/begin MEASUREMENT TestWord_566 "" UWORD Identity 0 0 0 255 ECU_ADDRESS 0x1BE9F4 FORMAT "%.0" SYMBOL_LINK "testByte000" 2268 /end MEASUREMENT
/begin MEASUREMENT TestWord_567 "" UWORD Identity 0 0 0 255 ECU_ADDRESS 0x1BE9F8 FORMAT "%.0" SYMBOL_LINK "testByte000" 2272 /end MEASUREMENT
/begin MEASUREMENT TestWord_568 "" UWORD Identity 0 0 0 255 ECU_ADDRESS 0x1BE9FC FORMAT "%.0" SYMBOL_LINK "testByte000" 2276 /end MEASUREMENT
/begin MEASUREMENT TestWord_569 "" UWORD Identity 0 0 0 255 ECU_ADDRESS 0x1BEA00 FORMAT "%.0" SYMBOL_LINK "testByte000" 2280 /end MEASUREMENT
/begin MEASUREMENT TestWord_570 "" UWORD Identity 0 0 0 255 ECU_ADDRESS 0x1BEA04 FORMAT "%.0" SYMBOL_LINK "testByte000" 2284 /end MEASUREMENT
/begin MEASUREMENT TestWord_571 "" UWORD Identity 0 0 0 255 ECU_ADDRESS 0x1BEA08 FORMAT "%.0" SYMBOL_LINK "testByte000" 2288 /end MEASUREMENT
/begin MEASUREMENT TestWord_572 "" UWORD Identity 0 0 0 255 ECU_ADDRESS 0x1BEA0C FORMAT "%.0" SYMBOL_LINK "testByte000" 2292 /end MEASUREMENT
/begin MEASUREMENT TestWord_573 "" UWORD Identity 0 0 0 255 ECU_ADDRESS 0x1BEA10 FORMAT "%.0" SYMBOL_LINK "testByte000" 2296 /end MEASUREMENT
/begin MEASUREMENT TestWord_574 "" UWORD Identity 0 0 0 255 ECU_ADDRESS 0x1BEA14 FORMAT "%.0" SYMBOL_LINK "testByte000" 2300 /end MEASUREMENT
/begin MEASUREMENT TestWord_578 "" UWORD Identity 0 0 0 255 ECU_ADDRESS 0x1BEA24 FORMAT "%.0" SYMBOL_LINK "testByte000" 2316 /end MEASUREMENT
/begin MEASUREMENT TestWord_579 "" UWORD Identity 0 0 0 255 ECU_ADDRESS 0x1BEA28 FORMAT "%.0" SYMBOL_LINK "testByte000" 2320 /end MEASUREMENT
/begin MEASUREMENT TestWord_580 "" UWORD Identity 0 0 0 255 ECU_ADDRESS 0x1BEA2C FORMAT "%.0" SYMBOL_LINK "testByte000" 2324 /end MEASUREMENT
/begin MEASUREMENT TestWord_581 "" UWORD Identity 0 0 0 255 ECU_ADDRESS 0x1BEA30 FORMAT "%.0" SYMBOL_LINK "testByte000" 2328 /end MEASUREMENT
/begin MEASUREMENT TestWord_583 "" UWORD Identity 0 0 0 255 ECU_ADDRESS 0x1BEA38 FORMAT "%.0" SYMBOL_LINK "testByte000" 2336 /end MEASUREMENT
/begin MEASUREMENT TestWord_585 "" UWORD Identity 0 0 0 255 ECU_ADDRESS 0x1BEA40 FORMAT "%.0" SYMBOL_LINK "testByte000" 2344 /end MEASUREMENT
/begin MEASUREMENT TestWord_586 "" UWORD Identity 0 0 0 255 ECU_ADDRESS 0x1BEA44 FORMAT "%.0" SYMBOL_LINK "testByte000" 2348 /end MEASUREMENT
/begin MEASUREMENT TestWord_587 "" UWORD Identity 0 0 0 255 ECU_ADDRESS 0x1BEA48 FORMAT "%.0" SYMBOL_LINK "testByte000" 2352 /end MEASUREMENT
/begin MEASUREMENT TestWord_588 "" UWORD Identity 0 0 0 255 ECU_ADDRESS 0x1BEA4C FORMAT "%.0" SYMBOL_LINK "testByte000" 2356 /end MEASUREMENT
/begin MEASUREMENT TestWord_593 "" UWORD Identity 0 0 0 255 ECU_ADDRESS 0x1BEA60 FORMAT "%.0" SYMBOL_LINK "testByte000" 2376 /end MEASUREMENT
/begin MEASUREMENT TestWord_594 "" UWORD Identity 0 0 0 255 ECU_ADDRESS 0x1BEA64 FORMAT "%.0" SYMBOL_LINK "testByte000" 2380 /end MEASUREMENT
/begin MEASUREMENT TestWord_595 "" UWORD Identity 0 0 0 255 ECU_ADDRESS 0x1BEA68 FORMAT "%.0" SYMBOL_LINK "testByte000" 2384 /end MEASUREMENT
/begin MEASUREMENT TestWord_597 "" UWORD Identity 0 0 0 255 ECU_ADDRESS 0x1BEA70 FORMAT "%.0" SYMBOL_LINK "testByte000" 2392 /end MEASUREMENT
/begin MEASUREMENT TestWord_599 "" UWORD Identity 0 0 0 255 ECU_ADDRESS 0x1BEA78 FORMAT "%.0" SYMBOL_LINK "testByte000" 2400 /end MEASUREMENT
/begin MEASUREMENT TestWord_600 "" UWORD Identity 0 0 0 255 ECU_ADDRESS 0x1BEA7C FORMAT "%.0" SYMBOL_LINK "testByte000" 2404 /end MEASUREMENT
/begin MEASUREMENT TestWord_602 "" UWORD Identity 0 0 0 255 ECU_ADDRESS 0x1BEA84 FORMAT "%.0" SYMBOL_LINK "testByte000" 2412 /end MEASUREMENT
/begin MEASUREMENT TestWord_603 "" UWORD Identity 0 0 0 255 ECU_ADDRESS 0x1BEA88 FORMAT "%.0" SYMBOL_LINK "testByte000" 2416 /end MEASUREMENT
/begin MEASUREMENT TestWord_604 "" UWORD Identity 0 0 0 255 ECU_ADDRESS 0x1BEA8C FORMAT "%.0" SYMBOL_LINK "testByte000" 2420 /end MEASUREMENT
/begin MEASUREMENT TestWord_605 "" UWORD Identity 0 0 0 255 ECU_ADDRESS 0x1BEA90 FORMAT "%.0" SYMBOL_LINK "testByte000" 2424 /end MEASUREMENT
/begin MEASUREMENT TestWord_607 "" UWORD Identity 0 0 0 255 ECU_ADDRESS 0x1BEA98 FORMAT "%.0" SYMBOL_LINK "testByte000" 2432 /end MEASUREMENT
/begin MEASUREMENT TestWord_609 "" UWORD Identity 0 0 0 255 ECU_ADDRESS 0x1BEAA0 FORMAT "%.0" SYMBOL_LINK "testByte000" 2440 /end MEASUREMENT
/begin MEASUREMENT TestWord_610 "" UWORD Identity 0 0 0 255 ECU_ADDRESS 0x1BEAA4 FORMAT "%.0" SYMBOL_LINK "testByte000" 2444 /end MEASUREMENT
/begin MEASUREMENT TestWord_611 "" UWORD Identity 0 0 0 255 ECU_ADDRESS 0x1BEAA8 FORMAT "%.0" SYMBOL_LINK "testByte000" 2448 /end MEASUREMENT
/begin MEASUREMENT TestWord_612 "" UWORD Identity 0 0 0 255 ECU_ADDRESS 0x1BEAAC FORMAT "%.0" SYMBOL_LINK "testByte000" 2452 /end MEASUREMENT
/begin MEASUREMENT TestWord_613 "" UWORD Identity 0 0 0 255 ECU_ADDRESS 0x1BEAB0 FORMAT "%.0" SYMBOL_LINK "testByte000" 2456 /end MEASUREMENT
/begin MEASUREMENT TestWord_614 "" UWORD Identity 0 0 0 255 ECU_ADDRESS 0x1BEAB4 FORMAT "%.0" SYMBOL_LINK "testByte000" 2460 /end MEASUREMENT
/begin MEASUREMENT TestWord_615 "" UWORD Identity 0 0 0 255 ECU_ADDRESS 0x1BEAB8 FORMAT "%.0" SYMBOL_LINK "testByte000" 2464 /end MEASUREMENT
/begin MEASUREMENT TestWord_616 "" UWORD Identity 0 0 0 255 ECU_ADDRESS 0x1BEABC FORMAT "%.0" SYMBOL_LINK "testByte000" 2468 /end MEASUREMENT
/begin MEASUREMENT TestWord_617 "" UWORD Identity 0 0 0 255 ECU_ADDRESS 0x1BEAC0 FORMAT "%.0" SYMBOL_LINK "testByte000" 2472 /end MEASUREMENT
/begin MEASUREMENT TestWord_619 "" UWORD Identity 0 0 0 255 ECU_ADDRESS 0x1BEAC8 FORMAT "%.0" SYMBOL_LINK "testByte000" 2480 /end MEASUREMENT
/begin MEASUREMENT TestWord_622 "" UWORD Identity 0 0 0 255 ECU_ADDRESS 0x1BEAD4 FORMAT "%.0" SYMBOL_LINK "testByte000" 2492 /end MEASUREMENT
/begin MEASUREMENT TestWord_623 "" UWORD Identity 0 0 0 255 ECU_ADDRESS 0x1BEAD8 FORMAT "%.0" SYMBOL_LINK "testByte000" 2496 /end MEASUREMENT
/begin MEASUREMENT TestWord_625 "" UWORD Identity 0 0 0 255 ECU_ADDRESS 0x1BEAE0 FORMAT "%.0" SYMBOL_LINK "testByte000" 2504 /end MEASUREMENT
/begin MEASUREMENT TestWord_626 "" UWORD Identity 0 0 0 255 ECU_ADDRESS 0x1BEAE4 FORMAT "%.0" SYMBOL_LINK "testByte000" 2508 /end MEASUREMENT
/begin MEASUREMENT TestWord_628 "" UWORD Identity 0 0 0 255 ECU_ADDRESS 0x1BEAEC FORMAT "%.0" SYMBOL_LINK "testByte000" 2516 /end MEASUREMENT
/begin MEASUREMENT TestWord_629 "" UWORD Identity 0 0 0 255 ECU_ADDRESS 0x1BEAF0 FORMAT "%.0" SYMBOL_LINK "testByte000" 2520 /end MEASUREMENT
/begin MEASUREMENT TestWord_630 "" UWORD Identity 0 0 0 255 ECU_ADDRESS 0x1BEAF4 FORMAT "%.0" SYMBOL_LINK "testByte000" 2524 /end MEASUREMENT
/begin MEASUREMENT TestWord_631 "" UWORD Identity 0 0 0 255 ECU_ADDRESS 0x1BEAF8 FORMAT "%.0" SYMBOL_LINK "testByte000" 2528 /end MEASUREMENT
/begin MEASUREMENT TestWord_632 "" UWORD Identity 0 0 0 255 ECU_ADDRESS 0x1BEAFC FORMAT "%.0" SYMBOL_LINK "testByte000" 2532 /end MEASUREMENT
/begin MEASUREMENT TestWord_633 "" UWORD Identity 0 0 0 255 ECU_ADDRESS 0x1BEB00 FORMAT "%.0" SYMBOL_LINK "testByte000" 2536 /end MEASUREMENT
/begin MEASUREMENT TestWord_634 "" UWORD Identity 0 0 0 255 ECU_ADDRESS 0x1BEB04 FORMAT "%.0" SYMBOL_LINK "testByte000" 2540 /end MEASUREMENT
/begin MEASUREMENT TestWord_635 "" UWORD Identity 0 0 0 255 ECU_ADDRESS 0x1BEB08 FORMAT "%.0" SYMBOL_LINK "testByte000" 2544 /end MEASUREMENT
/begin MEASUREMENT TestWord_636 "" UWORD Identity 0 0 0 255 ECU_ADDRESS 0x1BEB0C FORMAT "%.0" SYMBOL_LINK "testByte000" 2548 /end MEASUREMENT
/begin MEASUREMENT TestWord_637 "" UWORD Identity 0 0 0 255 ECU_ADDRESS 0x1BEB10 FORMAT "%.0" SYMBOL_LINK "testByte000" 2552 /end MEASUREMENT
/begin MEASUREMENT TestWord_639 "" UWORD Identity 0 0 0 255 ECU_ADDRESS 0x1BEB18 FORMAT "%.0" SYMBOL_LINK "testByte000" 2560 /end MEASUREMENT
/begin MEASUREMENT TestWord_640 "" UWORD Identity 0 0 0 255 ECU_ADDRESS 0x1BEB1C FORMAT "%.0" SYMBOL_LINK "testByte000" 2564 /end MEASUREMENT
/begin MEASUREMENT TestWord_641 "" UWORD Identity 0 0 0 255 ECU_ADDRESS 0x1BEB20 FORMAT "%.0" SYMBOL_LINK "testByte000" 2568 /end MEASUREMENT
/begin MEASUREMENT TestWord_642 "" UWORD Identity 0 0 0 255 ECU_ADDRESS 0x1BEB24 FORMAT "%.0" SYMBOL_LINK "testByte000" 2572 /end MEASUREMENT
/begin MEASUREMENT TestWord_645 "" UWORD Identity 0 0 0 255 ECU_ADDRESS 0x1BEB30 FORMAT "%.0" SYMBOL_LINK "testByte000" 2584 /end MEASUREMENT
/begin MEASUREMENT TestWord_646 "" UWORD Identity 0 0 0 255 ECU_ADDRESS 0x1BEB34 FORMAT "%.0" SYMBOL_LINK "testByte000" 2588 /end MEASUREMENT
/begin MEASUREMENT TestWord_649 "" UWORD Identity 0 0 0 255 ECU_ADDRESS 0x1BEB40 FORMAT "%.0" SYMBOL_LINK "testByte000" 2600 /end MEASUREMENT
/begin MEASUREMENT TestWord_650 "" UWORD Identity 0 0 0 255 ECU_ADDRESS 0x1BEB44 FORMAT "%.0" SYMBOL_LINK "testByte000" 2604 /end MEASUREMENT
/begin MEASUREMENT TestWord_651 "" UWORD Identity 0 0 0 255 ECU_ADDRESS 0x1BEB48 FORMAT "%.0" SYMBOL_LINK "testByte000" 2608 /end MEASUREMENT
/begin MEASUREMENT TestWord_652 "" UWORD Identity 0 0 0 255 ECU_ADDRESS 0x1BEB4C FORMAT "%.0" SYMBOL_LINK "testByte000" 2612 /end MEASUREMENT
/begin MEASUREMENT TestWord_653 "" UWORD Identity 0 0 0 255 ECU_ADDRESS 0x1BEB50 FORMAT "%.0" SYMBOL_LINK "testByte000" 2616 /end MEASUREMENT
/begin MEASUREMENT TestWord_654 "" UWORD Identity 0 0 0 255 ECU_ADDRESS 0x1BEB54 FORMAT "%.0" SYMBOL_LINK "testByte000" 2620 /end MEASUREMENT
/begin MEASUREMENT TestWord_655 "" UWORD Identity 0 0 0 255 ECU_ADDRESS 0x1BEB58 FORMAT "%.0" SYMBOL_LINK "testByte000" 2624 /end MEASUREMENT
/begin MEASUREMENT TestWord_656 "" UWORD Identity 0 0 0 255 ECU_ADDRESS 0x1BEB5C FORMAT "%.0" SYMBOL_LINK "testByte000" 2628 /end MEASUREMENT
/begin MEASUREMENT TestWord_657 "" UWORD Identity 0 0 0 255 ECU_ADDRESS 0x1BEB60 FORMAT "%.0" SYMBOL_LINK "testByte000" 2632 /end MEASUREMENT
/begin MEASUREMENT TestWord_658 "" UWORD Identity 0 0 0 255 ECU_ADDRESS 0x1BEB64 FORMAT "%.0" SYMBOL_LINK "testByte000" 2636 /end MEASUREMENT
/begin MEASUREMENT TestWord_660 "" UWORD Identity 0 0 0 255 ECU_ADDRESS 0x1BEB6C FORMAT "%.0" SYMBOL_LINK "testByte000" 2644 /end MEASUREMENT
/begin MEASUREMENT TestWord_661 "" UWORD Identity 0 0 0 255 ECU_ADDRESS 0x1BEB70 FORMAT "%.0" SYMBOL_LINK "testByte000" 2648 /end MEASUREMENT
/begin MEASUREMENT TestWord_662 "" UWORD Identity 0 0 0 255 ECU_ADDRESS 0x1BEB74 FORMAT "%.0" SYMBOL_LINK "testByte000" 2652 /end MEASUREMENT
/begin MEASUREMENT TestWord_663 "" UWORD Identity 0 0 0 255 ECU_ADDRESS 0x1BEB78 FORMAT "%.0" SYMBOL_LINK "testByte000" 2656 /end MEASUREMENT
/begin MEASUREMENT TestWord_664 "" UWORD Identity 0 0 0 255 ECU_ADDRESS 0x1BEB7C FORMAT "%.0" SYMBOL_LINK "testByte000" 2660 /end MEASUREMENT
/begin MEASUREMENT TestWord_665 "" UWORD Identity 0 0 0 255 ECU_ADDRESS 0x1BEB80 FORMAT "%.0" SYMBOL_LINK "testByte000" 2664 /end MEASUREMENT
/begin MEASUREMENT TestWord_666 "" UWORD Identity 0 0 0 255 ECU_ADDRESS 0x1BEB84 FORMAT "%.0" SYMBOL_LINK "testByte000" 2668 /end MEASUREMENT
/begin MEASUREMENT TestWord_667 "" UWORD Identity 0 0 0 255 ECU_ADDRESS 0x1BEB88 FORMAT "%.0" SYMBOL_LINK "testByte000" 2672 /end MEASUREMENT
/begin MEASUREMENT TestWord_670 "" UWORD Identity 0 0 0 255 ECU_ADDRESS 0x1BEB94 FORMAT "%.0" SYMBOL_LINK "testByte000" 2684 /end MEASUREMENT
/begin MEASUREMENT TestWord_672 "" UWORD Identity 0 0 0 255 ECU_ADDRESS 0x1BEB9C FORMAT "%.0" SYMBOL_LINK "testByte000" 2692 /end MEASUREMENT
/begin MEASUREMENT TestWord_673 "" UWORD Identity 0 0 0 255 ECU_ADDRESS 0x1BEBA0 FORMAT "%.0" SYMBOL_LINK "testByte000" 2696 /end MEASUREMENT
/begin MEASUREMENT TestWord_674 "" UWORD Identity 0 0 0 255 ECU_ADDRESS 0x1BEBA4 FORMAT "%.0" SYMBOL_LINK "testByte000" 2700 /end MEASUREMENT
/begin MEASUREMENT TestWord_676 "" UWORD Identity 0 0 0 255 ECU_ADDRESS 0x1BEBAC FORMAT "%.0" SYMBOL_LINK "testByte000" 2708 /end MEASUREMENT
/begin MEASUREMENT TestWord_677 "" UWORD Identity 0 0 0 255 ECU_ADDRESS 0x1BEBB0 FORMAT "%.0" SYMBOL_LINK "testByte000" 2712 /end MEASUREMENT
/begin MEASUREMENT TestWord_678 "" UWORD Identity 0 0 0 255 ECU_ADDRESS 0x1BEBB4 FORMAT "%.0" SYMBOL_LINK "testByte000" 2716 /end MEASUREMENT
/begin MEASUREMENT TestWord_680 "" UWORD Identity 0 0 0 255 ECU_ADDRESS 0x1BEBBC FORMAT "%.0" SYMBOL_LINK "testByte000" 2724 /end MEASUREMENT
/begin MEASUREMENT TestWord_681 "" UWORD Identity 0 0 0 255 ECU_ADDRESS 0x1BEBC0 FORMAT "%.0" SYMBOL_LINK "testByte000" 2728 /end MEASUREMENT
/begin MEASUREMENT TestWord_682 "" UWORD Identity 0 0 0 255 ECU_ADDRESS 0x1BEBC4 FORMAT "%.0" SYMBOL_LINK "testByte000" 2732 /end MEASUREMENT
/begin MEASUREMENT TestWord_683 "" UWORD Identity 0 0 0 255 ECU_ADDRESS 0x1BEBC8 FORMAT "%.0" SYMBOL_LINK "testByte000" 2736 /end MEASUREMENT
/begin MEASUREMENT TestWord_685 "" UWORD Identity 0 0 0 255 ECU_ADDRESS 0x1BEBD0 FORMAT "%.0" SYMBOL_LINK "testByte000" 2744 /end MEASUREMENT
/begin MEASUREMENT TestWord_686 "" UWORD Identity 0 0 0 255 ECU_ADDRESS 0x1BEBD4 FORMAT "%.0" SYMBOL_LINK "testByte000" 2748 /end MEASUREMENT
/begin MEASUREMENT TestWord_687 "" UWORD Identity 0 0 0 255 ECU_ADDRESS 0x1BEBD8 FORMAT "%.0" SYMBOL_LINK "testByte000" 2752 /end MEASUREMENT
/begin MEASUREMENT TestWord_688 "" UWORD Identity 0 0 0 255 ECU_ADDRESS 0x1BEBDC FORMAT "%.0" SYMBOL_LINK "testByte000" 2756 /end MEASUREMENT
/begin MEASUREMENT TestWord_689 "" UWORD Identity 0 0 0 255 ECU_ADDRESS 0x1BEBE0 FORMAT "%.0" SYMBOL_LINK "testByte000" 2760 /end MEASUREMENT
/begin MEASUREMENT TestWord_690 "" UWORD Identity 0 0 0 255 ECU_ADDRESS 0x1BEBE4 FORMAT "%.0" SYMBOL_LINK "testByte000" 2764 /end MEASUREMENT
/begin MEASUREMENT TestWord_692 "" UWORD Identity 0 0 0 255 ECU_ADDRESS 0x1BEBEC FORMAT "%.0" SYMBOL_LINK "testByte000" 2772 /end MEASUREMENT
/begin MEASUREMENT TestWord_695 "" UWORD Identity 0 0 0 255 ECU_ADDRESS 0x1BEBF8 FORMAT "%.0" SYMBOL_LINK "testByte000" 2784 /end MEASUREMENT
/begin MEASUREMENT TestWord_696 "" UWORD Identity 0 0 0 255 ECU_ADDRESS 0x1BEBFC FORMAT "%.0" SYMBOL_LINK "testByte000" 2788 /end MEASUREMENT
/begin MEASUREMENT TestWord_698 "" UWORD Identity 0 0 0 255 ECU_ADDRESS 0x1BEC04 FORMAT "%.0" SYMBOL_LINK "testByte000" 2796 /end MEASUREMENT
/begin MEASUREMENT TestWord_699 "" UWORD Identity 0 0 0 255 ECU_ADDRESS 0x1BEC08 FORMAT "%.0" SYMBOL_LINK "testByte000" 2800 /end MEASUREMENT
/begin MEASUREMENT TestWord_701 "" UWORD Identity 0 0 0 255 ECU_ADDRESS 0x1BEC10 FORMAT "%.0" SYMBOL_LINK "testByte000" 2808 /end MEASUREMENT
/begin MEASUREMENT TestWord_702 "" UWORD Identity 0 0 0 255 ECU_ADDRESS 0x1BEC14 FORMAT "%.0" SYMBOL_LINK "testByte000" 2812 /end MEASUREMENT
/begin MEASUREMENT TestWord_704 "" UWORD Identity 0 0 0 255 ECU_ADDRESS 0x1BEC1C FORMAT "%.0" SYMBOL_LINK "testByte000" 2820 /end MEASUREMENT
/begin MEASUREMENT TestWord_705 "" UWORD Identity 0 0 0 255 ECU_ADDRESS 0x1BEC20 FORMAT "%.0" SYMBOL_LINK "testByte000" 2824 /end MEASUREMENT
/begin MEASUREMENT TestWord_706 "" UWORD Identity 0 0 0 255 ECU_ADDRESS 0x1BEC24 FORMAT "%.0" SYMBOL_LINK "testByte000" 2828 /end MEASUREMENT
/begin MEASUREMENT TestWord_707 "" UWORD Identity 0 0 0 255 ECU_ADDRESS 0x1BEC28 FORMAT "%.0" SYMBOL_LINK "testByte000" 2832 /end MEASUREMENT
/begin MEASUREMENT TestWord_709 "" UWORD Identity 0 0 0 255 ECU_ADDRESS 0x1BEC30 FORMAT "%.0" SYMBOL_LINK "testByte000" 2840 /end MEASUREMENT
/begin MEASUREMENT TestWord_710 "" UWORD Identity 0 0 0 255 ECU_ADDRESS 0x1BEC34 FORMAT "%.0" SYMBOL_LINK "testByte000" 2844 /end MEASUREMENT
/begin MEASUREMENT TestWord_712 "" UWORD Identity 0 0 0 255 ECU_ADDRESS 0x1BEC3C FORMAT "%.0" SYMBOL_LINK "testByte000" 2852 /end MEASUREMENT
/begin MEASUREMENT TestWord_713 "" UWORD Identity 0 0 0 255 ECU_ADDRESS 0x1BEC40 FORMAT "%.0" SYMBOL_LINK "testByte000" 2856 /end MEASUREMENT
/begin MEASUREMENT TestWord_717 "" UWORD Identity 0 0 0 255 ECU_ADDRESS 0x1BEC50 FORMAT "%.0" SYMBOL_LINK "testByte000" 2872 /end MEASUREMENT
/begin MEASUREMENT TestWord_718 "" UWORD Identity 0 0 0 255 ECU_ADDRESS 0x1BEC54 FORMAT "%.0" SYMBOL_LINK "testByte000" 2876 /end MEASUREMENT
/begin MEASUREMENT TestWord_719 "" UWORD Identity 0 0 0 255 ECU_ADDRESS 0x1BEC58 FORMAT "%.0" SYMBOL_LINK "testByte000" 2880 /end MEASUREMENT
/begin MEASUREMENT TestWord_720 "" UWORD Identity 0 0 0 255 ECU_ADDRESS 0x1BEC5C FORMAT "%.0" SYMBOL_LINK "testByte000" 2884 /end MEASUREMENT
/begin MEASUREMENT TestWord_721 "" UWORD Identity 0 0 0 255 ECU_ADDRESS 0x1BEC60 FORMAT "%.0" SYMBOL_LINK "testByte000" 2888 /end MEASUREMENT
/begin MEASUREMENT TestWord_723 "" UWORD Identity 0 0 0 255 ECU_ADDRESS 0x1BEC68 FORMAT "%.0" SYMBOL_LINK "testByte000" 2896 /end MEASUREMENT
/begin MEASUREMENT TestWord_726 "" UWORD Identity 0 0 0 255 ECU_ADDRESS 0x1BEC74 FORMAT "%.0" SYMBOL_LINK "testByte000" 2908 /end MEASUREMENT
/begin MEASUREMENT TestWord_729 "" UWORD Identity 0 0 0 255 ECU_ADDRESS 0x1BEC80 FORMAT "%.0" SYMBOL_LINK "testByte000" 2920 /end MEASUREMENT
/begin MEASUREMENT TestWord_733 "" UWORD Identity 0 0 0 255 ECU_ADDRESS 0x1BEC90 FORMAT "%.0" SYMBOL_LINK "testByte000" 2936 /end MEASUREMENT
/begin MEASUREMENT TestWord_734 "" UWORD Identity 0 0 0 255 ECU_ADDRESS 0x1BEC94 FORMAT "%.0" SYMBOL_LINK "testByte000" 2940 /end MEASUREMENT
/begin MEASUREMENT TestWord_735 "" UWORD Identity 0 0 0 255 ECU_ADDRESS 0x1BEC98 FORMAT "%.0" SYMBOL_LINK "testByte000" 2944 /end MEASUREMENT
/begin MEASUREMENT TestWord_736 "" UWORD Identity 0 0 0 255 ECU_ADDRESS 0x1BEC9C FORMAT "%.0" SYMBOL_LINK "testByte000" 2948 /end MEASUREMENT
/begin MEASUREMENT TestWord_737 "" UWORD Identity 0 0 0 255 ECU_ADDRESS 0x1BECA0 FORMAT "%.0" SYMBOL_LINK "testByte000" 2952 /end MEASUREMENT
/begin MEASUREMENT TestWord_739 "" UWORD Identity 0 0 0 255 ECU_ADDRESS 0x1BECA8 FORMAT "%.0" SYMBOL_LINK "testByte000" 2960 /end MEASUREMENT
/begin MEASUREMENT TestWord_740 "" UWORD Identity 0 0 0 255 ECU_ADDRESS 0x1BECAC FORMAT "%.0" SYMBOL_LINK "testByte000" 2964 /end MEASUREMENT
/begin MEASUREMENT TestWord_741 "" UWORD Identity 0 0 0 255 ECU_ADDRESS 0x1BECB0 FORMAT "%.0" SYMBOL_LINK "testByte000" 2968 /end MEASUREMENT
/begin MEASUREMENT TestWord_742 "" UWORD Identity 0 0 0 255 ECU_ADDRESS 0x1BECB4 FORMAT "%.0" SYMBOL_LINK "testByte000" 2972 /end MEASUREMENT
/begin MEASUREMENT TestWord_743 "" UWORD Identity 0 0 0 255 ECU_ADDRESS 0x1BECB8 FORMAT "%.0" SYMBOL_LINK "testByte000" 2976 /end MEASUREMENT
/begin MEASUREMENT TestWord_744 "" UWORD Identity 0 0 0 255 ECU_ADDRESS 0x1BECBC FORMAT "%.0" SYMBOL_LINK "testByte000" 2980 /end MEASUREMENT
/begin MEASUREMENT TestWord_745 "" UWORD Identity 0 0 0 255 ECU_ADDRESS 0x1BECC0 FORMAT "%.0" SYMBOL_LINK "testByte000" 2984 /end MEASUREMENT
/begin MEASUREMENT TestWord_747 "" UWORD Identity 0 0 0 255 ECU_ADDRESS 0x1BECC8 FORMAT "%.0" SYMBOL_LINK "testByte000" 2992 /end MEASUREMENT
/begin MEASUREMENT TestWord_749 "" UWORD Identity 0 0 0 255 ECU_ADDRESS 0x1BECD0 FORMAT "%.0" SYMBOL_LINK "testByte000" 3000 /end MEASUREMENT
/begin MEASUREMENT TestWord_750 "" UWORD Identity 0 0 0 255 ECU_ADDRESS 0x1BECD4 FORMAT "%.0" SYMBOL_LINK "testByte000" 3004 /end MEASUREMENT
/begin MEASUREMENT TestWord_751 "" UWORD Identity 0 0 0 255 ECU_ADDRESS 0x1BECD8 FORMAT "%.0" SYMBOL_LINK "testByte000" 3008 /end MEASUREMENT
/begin MEASUREMENT TestWord_753 "" UWORD Identity 0 0 0 255 ECU_ADDRESS 0x1BECE0 FORMAT "%.0" SYMBOL_LINK "testByte000" 3016 /end MEASUREMENT
/begin MEASUREMENT TestWord_754 "" UWORD Identity 0 0 0 255 ECU_ADDRESS 0x1BECE4 FORMAT "%.0" SYMBOL_LINK "testByte000" 3020 /end MEASUREMENT
/begin MEASUREMENT TestWord_755 "" UWORD Identity 0 0 0 255 ECU_ADDRESS 0x1BECE8 FORMAT "%.0" SYMBOL_LINK "testByte000" 3024 /end MEASUREMENT
/begin MEASUREMENT TestWord_756 "" UWORD Identity 0 0 0 255 ECU_ADDRESS 0x1BECEC FORMAT "%.0" SYMBOL_LINK "testByte000" 3028 /end MEASUREMENT
/begin MEASUREMENT TestWord_757 "" UWORD Identity 0 0 0 255 ECU_ADDRESS 0x1BECF0 FORMAT "%.0" SYMBOL_LINK "testByte000" 3032 /end MEASUREMENT
/begin MEASUREMENT TestWord_759 "" UWORD Identity 0 0 0 255 ECU_ADDRESS 0x1BECF8 FORMAT "%.0" SYMBOL_LINK "testByte000" 3040 /end MEASUREMENT
/begin MEASUREMENT TestWord_760 "" UWORD Identity 0 0 0 255 ECU_ADDRESS 0x1BECFC FORMAT "%.0" SYMBOL_LINK "testByte000" 3044 /end MEASUREMENT
/begin MEASUREMENT TestWord_761 "" UWORD Identity 0 0 0 255 ECU_ADDRESS 0x1BED00 FORMAT "%.0" SYMBOL_LINK "testByte000" 3048 /end MEASUREMENT
/begin MEASUREMENT TestWord_762 "" UWORD Identity 0 0 0 255 ECU_ADDRESS 0x1BED04 FORMAT "%.0" SYMBOL_LINK "testByte000" 3052 /end MEASUREMENT
/begin MEASUREMENT TestWord_763 "" UWORD Identity 0 0 0 255 ECU_ADDRESS 0x1BED08 FORMAT "%.0" SYMBOL_LINK "testByte000" 3056 /end MEASUREMENT
/begin MEASUREMENT TestWord_764 "" UWORD Identity 0 0 0 255 ECU_ADDRESS 0x1BED0C FORMAT "%.0" SYMBOL_LINK "testByte000" 3060 /end MEASUREMENT
/begin MEASUREMENT TestWord_765 "" UWORD Identity 0 0 0 255 ECU_ADDRESS 0x1BED10 FORMAT "%.0" SYMBOL_LINK "testByte000" 3064 /end MEASUREMENT
/begin MEASUREMENT TestWord_766 "" UWORD Identity 0 0 0 255 ECU_ADDRESS 0x1BED14 FORMAT "%.0" SYMBOL_LINK "testByte000" 3068 /end MEASUREMENT
/begin MEASUREMENT TestWord_767 "" UWORD Identity 0 0 0 255 ECU_ADDRESS 0x1BED18 FORMAT "%.0" SYMBOL_LINK "testByte000" 3072 /end MEASUREMENT
/begin MEASUREMENT TestWord_768 "" UWORD Identity 0 0 0 255 ECU_ADDRESS 0x1BED1C FORMAT "%.0" SYMBOL_LINK "testByte000" 3076 /end MEASUREMENT
/begin MEASUREMENT TestWord_770 "" UWORD Identity 0 0 0 255 ECU_ADDRESS 0x1BED24 FORMAT "%.0" SYMBOL_LINK "testByte000" 3084 /end MEASUREMENT
/begin MEASUREMENT TestWord_771 "" UWORD Identity 0 0 0 255 ECU_ADDRESS 0x1BED28 FORMAT "%.0" SYMBOL_LINK "testByte000" 3088 /end MEASUREMENT
/begin MEASUREMENT TestWord_772 "" UWORD Identity 0 0 0 255 ECU_ADDRESS 0x1BED2C FORMAT "%.0" SYMBOL_LINK "testByte000" 3092 /end MEASUREMENT
/begin MEASUREMENT TestWord_775 "" UWORD Identity 0 0 0 255 ECU_ADDRESS 0x1BED38 FORMAT "%.0" SYMBOL_LINK "testByte000" 3104 /end MEASUREMENT
/begin MEASUREMENT TestWord_776 "" UWORD Identity 0 0 0 255 ECU_ADDRESS 0x1BED3C FORMAT "%.0" SYMBOL_LINK "testByte000" 3108 /end MEASUREMENT
/begin MEASUREMENT TestWord_779 "" UWORD Identity 0 0 0 255 ECU_ADDRESS 0x1BED48 FORMAT "%.0" SYMBOL_LINK "testByte000" 3120 /end MEASUREMENT
/begin MEASUREMENT TestWord_780 "" UWORD Identity 0 0 0 255 ECU_ADDRESS 0x1BED4C FORMAT "%.0" SYMBOL_LINK "testByte000" 3124 /end MEASUREMENT
/begin MEASUREMENT TestWord_781 "" UWORD Identity 0 0 0 255 ECU_ADDRESS 0x1BED50 FORMAT "%.0" SYMBOL_LINK "testByte000" 3128 /end MEASUREMENT
/begin MEASUREMENT TestWord_785 "" UWORD Identity 0 0 0 255 ECU_ADDRESS 0x1BED60 FORMAT "%.0" SYMBOL_LINK "testByte000" 3144 /end MEASUREMENT
/begin MEASUREMENT TestWord_787 "" UWORD Identity 0 0 0 255 ECU_ADDRESS 0x1BED68 FORMAT "%.0" SYMBOL_LINK "testByte000" 3152 /end MEASUREMENT
/begin MEASUREMENT TestWord_788 "" UWORD Identity 0 0 0 255 ECU_ADDRESS 0x1BED6C FORMAT "%.0" SYMBOL_LINK "testByte000" 3156 /end MEASUREMENT
/begin MEASUREMENT TestWord_790 "" UWORD Identity 0 0 0 255 ECU_ADDRESS 0x1BED74 FORMAT "%.0" SYMBOL_LINK "testByte000" 3164 /end MEASUREMENT
/begin MEASUREMENT TestWord_791 "" UWORD Identity 0 0 0 255 ECU_ADDRESS 0x1BED78 FORMAT "%.0" SYMBOL_LINK "testByte000" 3168 /end MEASUREMENT
/begin MEASUREMENT TestWord_792 "" UWORD Identity 0 0 0 255 ECU_ADDRESS 0x1BED7C FORMAT "%.0" SYMBOL_LINK "testByte000" 3172 /end MEASUREMENT
/begin MEASUREMENT TestWord_795 "" UWORD Identity 0 0 0 255 ECU_ADDRESS 0x1BED88 FORMAT "%.0" SYMBOL_LINK "testByte000" 3184 /end MEASUREMENT
/begin MEASUREMENT TestWord_796 "" UWORD Identity 0 0 0 255 ECU_ADDRESS 0x1BED8C FORMAT "%.0" SYMBOL_LINK "testByte000" 3188 /end MEASUREMENT
/begin MEASUREMENT TestWord_797 "" UWORD Identity 0 0 0 255 ECU_ADDRESS 0x1BED90 FORMAT "%.0" SYMBOL_LINK "testByte000" 3192 /end MEASUREMENT
/begin MEASUREMENT TestWord_799 "" UWORD Identity 0 0 0 255 ECU_ADDRESS 0x1BED98 FORMAT "%.0" SYMBOL_LINK "testByte000" 3200 /end MEASUREMENT
/begin MEASUREMENT TestWord_801 "" UWORD Identity 0 0 0 255 ECU_ADDRESS 0x1BEDA0 FORMAT "%.0" SYMBOL_LINK "testByte000" 3208 /end MEASUREMENT
/begin MEASUREMENT TestWord_802 "" UWORD Identity 0 0 0 255 ECU_ADDRESS 0x1BEDA4 FORMAT "%.0" SYMBOL_LINK "testByte000" 3212 /end MEASUREMENT
/begin MEASUREMENT TestWord_803 "" UWORD Identity 0 0 0 255 ECU_ADDRESS 0x1BEDA8 FORMAT "%.0" SYMBOL_LINK "testByte000" 3216 /end MEASUREMENT
/begin MEASUREMENT TestWord_804 "" UWORD Identity 0 0 0 255 ECU_ADDRESS 0x1BEDAC FORMAT "%.0" SYMBOL_LINK "testByte000" 3220 /end MEASUREMENT
/begin MEASUREMENT TestWord_806 "" UWORD Identity 0 0 0 255 ECU_ADDRESS 0x1BEDB4 FORMAT "%.0" SYMBOL_LINK "testByte000" 3228 /end MEASUREMENT
/begin MEASUREMENT TestWord_807 "" UWORD Identity 0 0 0 255 ECU_ADDRESS 0x1BEDB8 FORMAT "%.0" SYMBOL_LINK "testByte000" 3232 /end MEASUREMENT
/begin MEASUREMENT TestWord_808 "" UWORD Identity 0 0 0 255 ECU_ADDRESS 0x1BEDBC FORMAT "%.0" SYMBOL_LINK "testByte000" 3236 /end MEASUREMENT
/begin MEASUREMENT TestWord_809 "" UWORD Identity 0 0 0 255 ECU_ADDRESS 0x1BEDC0 FORMAT "%.0" SYMBOL_LINK "testByte000" 3240 /end MEASUREMENT
/begin MEASUREMENT TestWord_810 "" UWORD Identity 0 0 0 255 ECU_ADDRESS 0x1BEDC4 FORMAT "%.0" SYMBOL_LINK "testByte000" 3244 /end MEASUREMENT
/begin MEASUREMENT TestWord_812 "" UWORD Identity 0 0 0 255 ECU_ADDRESS 0x1BEDCC FORMAT "%.0" SYMBOL_LINK "testByte000" 3252 /end MEASUREMENT
/begin MEASUREMENT TestWord_813 "" UWORD Identity 0 0 0 255 ECU_ADDRESS 0x1BEDD0 FORMAT "%.0" SYMBOL_LINK "testByte000" 3256 /end MEASUREMENT
/begin MEASUREMENT TestWord_815 "" UWORD Identity 0 0 0 255 ECU_ADDRESS 0x1BEDD8 FORMAT "%.0" SYMBOL_LINK "testByte000" 3264 /end MEASUREMENT
/begin MEASUREMENT TestWord_816 "" UWORD Identity 0 0 0 255 ECU_ADDRESS 0x1BEDDC FORMAT "%.0" SYMBOL_LINK "testByte000" 3268 /end MEASUREMENT
/begin MEASUREMENT TestWord_817 "" UWORD Identity 0 0 0 255 ECU_ADDRESS 0x1BEDE0 FORMAT "%.0" SYMBOL_LINK "testByte000" 3272 /end MEASUREMENT
/begin MEASUREMENT TestWord_818 "" UWORD Identity 0 0 0 255 ECU_ADDRESS 0x1BEDE4 FORMAT "%.0" SYMBOL_LINK "testByte000" 3276 /end MEASUREMENT
/begin MEASUREMENT TestWord_819 "" UWORD Identity 0 0 0 255 ECU_ADDRESS 0x1BEDE8 FORMAT "%.0" SYMBOL_LINK "testByte000" 3280 /end MEASUREMENT
/begin MEASUREMENT TestWord_820 "" UWORD Identity 0 0 0 255 ECU_ADDRESS 0x1BEDEC FORMAT "%.0" SYMBOL_LINK "testByte000" 3284 /end MEASUREMENT
/begin MEASUREMENT TestWord_821 "" UWORD Identity 0 0 0 255 ECU_ADDRESS 0x1BEDF0 FORMAT "%.0" SYMBOL_LINK "testByte000" 3288 /end MEASUREMENT
/begin MEASUREMENT TestWord_822 "" UWORD Identity 0 0 0 255 ECU_ADDRESS 0x1BEDF4 FORMAT "%.0" SYMBOL_LINK "testByte000" 3292 /end MEASUREMENT
/begin MEASUREMENT TestWord_824 "" UWORD Identity 0 0 0 255 ECU_ADDRESS 0x1BEDFC FORMAT "%.0" SYMBOL_LINK "testByte000" 3300 /end MEASUREMENT
/begin MEASUREMENT TestWord_826 "" UWORD Identity 0 0 0 255 ECU_ADDRESS 0x1BEE04 FORMAT "%.0" SYMBOL_LINK "testByte000" 3308 /end MEASUREMENT
/begin MEASUREMENT TestWord_827 "" UWORD Identity 0 0 0 255 ECU_ADDRESS 0x1BEE08 FORMAT "%.0" SYMBOL_LINK "testByte000" 3312 /end MEASUREMENT
/begin MEASUREMENT TestWord_829 "" UWORD Identity 0 0 0 255 ECU_ADDRESS 0x1BEE10 FORMAT "%.0" SYMBOL_LINK "testByte000" 3320 /end MEASUREMENT
/begin MEASUREMENT TestWord_830 "" UWORD Identity 0 0 0 255 ECU_ADDRESS 0x1BEE14 FORMAT "%.0" SYMBOL_LINK "testByte000" 3324 /end MEASUREMENT
/begin MEASUREMENT TestWord_831 "" UWORD Identity 0 0 0 255 ECU_ADDRESS 0x1BEE18 FORMAT "%.0" SYMBOL_LINK "testByte000" 3328 /end MEASUREMENT
/begin MEASUREMENT TestWord_832 "" UWORD Identity 0 0 0 255 ECU_ADDRESS 0x1BEE1C FORMAT "%.0" SYMBOL_LINK "testByte000" 3332 /end MEASUREMENT
/begin MEASUREMENT TestWord_833 "" UWORD Identity 0 0 0 255 ECU_ADDRESS 0x1BEE20 FORMAT "%.0" SYMBOL_LINK "testByte000" 3336 /end MEASUREMENT
/begin MEASUREMENT TestWord_834 "" UWORD Identity 0 0 0 255 ECU_ADDRESS 0x1BEE24 FORMAT "%.0" SYMBOL_LINK "testByte000" 3340 /end MEASUREMENT
/begin MEASUREMENT TestWord_835 "" UWORD Identity 0 0 0 255 ECU_ADDRESS 0x1BEE28 FORMAT "%.0" SYMBOL_LINK "testByte000" 3344 /end MEASUREMENT
/begin MEASUREMENT TestWord_836 "" UWORD Identity 0 0 0 255 ECU_ADDRESS 0x1BEE2C FORMAT "%.0" SYMBOL_LINK "testByte000" 3348 /end MEASUREMENT
/begin MEASUREMENT TestWord_837 "" UWORD Identity 0 0 0 255 ECU_ADDRESS 0x1BEE30 FORMAT "%.0" SYMBOL_LINK "testByte000" 3352 /end MEASUREMENT
/begin MEASUREMENT TestWord_838 "" UWORD Identity 0 0 0 255 ECU_ADDRESS 0x1BEE34 FORMAT "%.0" SYMBOL_LINK "testByte000" 3356 /end MEASUREMENT
/begin MEASUREMENT TestWord_840 "" UWORD Identity 0 0 0 255 ECU_ADDRESS 0x1BEE3C FORMAT "%.0" SYMBOL_LINK "testByte000" 3364 /end MEASUREMENT
/begin MEASUREMENT TestWord_841 "" UWORD Identity 0 0 0 255 ECU_ADDRESS 0x1BEE40 FORMAT "%.0" SYMBOL_LINK "testByte000" 3368 /end MEASUREMENT
/begin MEASUREMENT TestWord_842 "" UWORD Identity 0 0 0 255 ECU_ADDRESS 0x1BEE44 FORMAT "%.0" SYMBOL_LINK "testByte000" 3372 /end MEASUREMENT
/begin MEASUREMENT TestWord_843 "" UWORD Identity 0 0 0 255 ECU_ADDRESS 0x1BEE48 FORMAT "%.0" SYMBOL_LINK "testByte000" 3376 /end MEASUREMENT
/begin MEASUREMENT TestWord_844 "" UWORD Identity 0 0 0 255 ECU_ADDRESS 0x1BEE4C FORMAT "%.0" SYMBOL_LINK "testByte000" 3380 /end MEASUREMENT
/begin MEASUREMENT TestWord_845 "" UWORD Identity 0 0 0 255 ECU_ADDRESS 0x1BEE50 FORMAT "%.0" SYMBOL_LINK "testByte000" 3384 /end MEASUREMENT
/begin MEASUREMENT TestWord_846 "" UWORD Identity 0 0 0 255 ECU_ADDRESS 0x1BEE54 FORMAT "%.0" SYMBOL_LINK "testByte000" 3388 /end MEASUREMENT
/begin MEASUREMENT TestWord_847 "" UWORD Identity 0 0 0 255 ECU_ADDRESS 0x1BEE58 FORMAT "%.0" SYMBOL_LINK "testByte000" 3392 /end MEASUREMENT
/begin MEASUREMENT TestWord_848 "" UWORD Identity 0 0 0 255 ECU_ADDRESS 0x1BEE5C FORMAT "%.0" SYMBOL_LINK "testByte000" 3396 /end MEASUREMENT
/begin MEASUREMENT TestWord_852 "" UWORD Identity 0 0 0 255 ECU_ADDRESS 0x1BEE6C FORMAT "%.0" SYMBOL_LINK "testByte000" 3412 /end MEASUREMENT
/begin MEASUREMENT TestWord_853 "" UWORD Identity 0 0 0 255 ECU_ADDRESS 0x1BEE70 FORMAT "%.0" SYMBOL_LINK "testByte000" 3416 /end MEASUREMENT
/begin MEASUREMENT TestWord_854 "" UWORD Identity 0 0 0 255 ECU_ADDRESS 0x1BEE74 FORMAT "%.0" SYMBOL_LINK "testByte000" 3420 /end MEASUREMENT
/begin MEASUREMENT TestWord_856 "" UWORD Identity 0 0 0 255 ECU_ADDRESS 0x1BEE7C FORMAT "%.0" SYMBOL_LINK "testByte000" 3428 /end MEASUREMENT
/begin MEASUREMENT TestWord_858 "" UWORD Identity 0 0 0 255 ECU_ADDRESS 0x1BEE84 FORMAT "%.0" SYMBOL_LINK "testByte000" 3436 /end MEASUREMENT
/begin MEASUREMENT TestWord_859 "" UWORD Identity 0 0 0 255 ECU_ADDRESS 0x1BEE88 FORMAT "%.0" SYMBOL_LINK "testByte000" 3440 /end MEASUREMENT
/begin MEASUREMENT TestWord_860 "" UWORD Identity 0 0 0 255 ECU_ADDRESS 0x1BEE8C FORMAT "%.0" SYMBOL_LINK "testByte000" 3444 /end MEASUREMENT
/begin MEASUREMENT TestWord_862 "" UWORD Identity 0 0 0 255 ECU_ADDRESS 0x1BEE94 FORMAT "%.0" SYMBOL_LINK "testByte000" 3452 /end MEASUREMENT
/begin MEASUREMENT TestWord_864 "" UWORD Identity 0 0 0 255 ECU_ADDRESS 0x1BEE9C FORMAT "%.0" SYMBOL_LINK "testByte000" 3460 /end MEASUREMENT
/begin MEASUREMENT TestWord_867 "" UWORD Identity 0 0 0 255 ECU_ADDRESS 0x1BEEA8 FORMAT "%.0" SYMBOL_LINK "testByte000" 3472 /end MEASUREMENT
/begin MEASUREMENT TestWord_868 "" UWORD Identity 0 0 0 255 ECU_ADDRESS 0x1BEEAC FORMAT "%.0" SYMBOL_LINK "testByte000" 3476 /end MEASUREMENT
/begin MEASUREMENT TestWord_869 "" UWORD Identity 0 0 0 255 ECU_ADDRESS 0x1BEEB0 FORMAT "%.0" SYMBOL_LINK "testByte000" 3480 /end MEASUREMENT
/begin MEASUREMENT TestWord_870 "" UWORD Identity 0 0 0 255 ECU_ADDRESS 0x1BEEB4 FORMAT "%.0" SYMBOL_LINK "testByte000" 3484 /end MEASUREMENT
/begin MEASUREMENT TestWord_871 "" UWORD Identity 0 0 0 255 ECU_ADDRESS 0x1BEEB8 FORMAT "%.0" SYMBOL_LINK "testByte000" 3488 /end MEASUREMENT
/begin MEASUREMENT TestWord_872 "" UWORD Identity 0 0 0 255 ECU_ADDRESS 0x1BEEBC FORMAT "%.0" SYMBOL_LINK "testByte000" 3492 /end MEASUREMENT
/begin MEASUREMENT TestWord_874 "" UWORD Identity 0 0 0 255 ECU_ADDRESS 0x1BEEC4 FORMAT "%.0" SYMBOL_LINK "testByte000" 3500 /end MEASUREMENT
/begin MEASUREMENT TestWord_876 "" UWORD Identity 0 0 0 255 ECU_ADDRESS 0x1BEECC FORMAT "%.0" SYMBOL_LINK "testByte000" 3508 /end MEASUREMENT
/begin MEASUREMENT TestWord_877 "" UWORD Identity 0 0 0 255 ECU_ADDRESS 0x1BEED0 FORMAT "%.0" SYMBOL_LINK "testByte000" 3512 /end MEASUREMENT
/begin MEASUREMENT TestWord_878 "" UWORD Identity 0 0 0 255 ECU_ADDRESS 0x1BEED4 FORMAT "%.0" SYMBOL_LINK "testByte000" 3516 /end MEASUREMENT
/begin MEASUREMENT TestWord_879 "" UWORD Identity 0 0 0 255 ECU_ADDRESS 0x1BEED8 FORMAT "%.0" SYMBOL_LINK "testByte000" 3520 /end MEASUREMENT
/begin MEASUREMENT TestWord_881 "" UWORD Identity 0 0 0 255 ECU_ADDRESS 0x1BEEE0 FORMAT "%.0" SYMBOL_LINK "testByte000" 3528 /end MEASUREMENT
/begin MEASUREMENT TestWord_882 "" UWORD Identity 0 0 0 255 ECU_ADDRESS 0x1BEEE4 FORMAT "%.0" SYMBOL_LINK "testByte000" 3532 /end MEASUREMENT
/begin MEASUREMENT TestWord_884 "" UWORD Identity 0 0 0 255 ECU_ADDRESS 0x1BEEEC FORMAT "%.0" SYMBOL_LINK "testByte000" 3540 /end MEASUREMENT
/begin MEASUREMENT TestWord_885 "" UWORD Identity 0 0 0 255 ECU_ADDRESS 0x1BEEF0 FORMAT "%.0" SYMBOL_LINK "testByte000" 3544 /end MEASUREMENT
/begin MEASUREMENT TestWord_886 "" UWORD Identity 0 0 0 255 ECU_ADDRESS 0x1BEEF4 FORMAT "%.0" SYMBOL_LINK "testByte000" 3548 /end MEASUREMENT
/begin MEASUREMENT TestWord_887 "" UWORD Identity 0 0 0 255 ECU_ADDRESS 0x1BEEF8 FORMAT "%.0" SYMBOL_LINK "testByte000" 3552 /end MEASUREMENT
/begin MEASUREMENT TestWord_888 "" UWORD Identity 0 0 0 255 ECU_ADDRESS 0x1BEEFC FORMAT "%.0" SYMBOL_LINK "testByte000" 3556 /end MEASUREMENT
/begin MEASUREMENT TestWord_889 "" UWORD Identity 0 0 0 255 ECU_ADDRESS 0x1BEF00 FORMAT "%.0" SYMBOL_LINK "testByte000" 3560 /end MEASUREMENT
/begin MEASUREMENT TestWord_890 "" UWORD Identity 0 0 0 255 ECU_ADDRESS 0x1BEF04 FORMAT "%.0" SYMBOL_LINK "testByte000" 3564 /end MEASUREMENT
/begin MEASUREMENT TestWord_891 "" UWORD Identity 0 0 0 255 ECU_ADDRESS 0x1BEF08 FORMAT "%.0" SYMBOL_LINK "testByte000" 3568 /end MEASUREMENT
/begin MEASUREMENT TestWord_892 "" UWORD Identity 0 0 0 255 ECU_ADDRESS 0x1BEF0C FORMAT "%.0" SYMBOL_LINK "testByte000" 3572 /end MEASUREMENT
/begin MEASUREMENT TestWord_893 "" UWORD Identity 0 0 0 255 ECU_ADDRESS 0x1BEF10 FORMAT "%.0" SYMBOL_LINK "testByte000" 3576 /end MEASUREMENT
/begin MEASUREMENT TestWord_894 "" UWORD Identity 0 0 0 255 ECU_ADDRESS 0x1BEF14 FORMAT "%.0" SYMBOL_LINK "testByte000" 3580 /end MEASUREMENT
/begin MEASUREMENT TestWord_896 "" UWORD Identity 0 0 0 255 ECU_ADDRESS 0x1BEF1C FORMAT "%.0" SYMBOL_LINK "testByte000" 3588 /end MEASUREMENT
/begin MEASUREMENT TestWord_897 "" UWORD Identity 0 0 0 255 ECU_ADDRESS 0x1BEF20 FORMAT "%.0" SYMBOL_LINK "testByte000" 3592 /end MEASUREMENT
/begin MEASUREMENT TestWord_898 "" UWORD Identity 0 0 0 255 ECU_ADDRESS 0x1BEF24 FORMAT "%.0" SYMBOL_LINK "testByte000" 3596 /end MEASUREMENT
/begin MEASUREMENT TestWord_900 "" UWORD Identity 0 0 0 255 ECU_ADDRESS 0x1BEF2C FORMAT "%.0" SYMBOL_LINK "testByte000" 3604 /end MEASUREMENT
/begin MEASUREMENT TestWord_901 "" UWORD Identity 0 0 0 255 ECU_ADDRESS 0x1BEF30 FORMAT "%.0" SYMBOL_LINK "testByte000" 3608 /end MEASUREMENT
/begin MEASUREMENT TestWord_903 "" UWORD Identity 0 0 0 255 ECU_ADDRESS 0x1BEF38 FORMAT "%.0" SYMBOL_LINK "testByte000" 3616 /end MEASUREMENT
/begin MEASUREMENT TestWord_904 "" UWORD Identity 0 0 0 255 ECU_ADDRESS 0x1BEF3C FORMAT "%.0" SYMBOL_LINK "testByte000" 3620 /end MEASUREMENT
/begin MEASUREMENT TestWord_909 "" UWORD Identity 0 0 0 255 ECU_ADDRESS 0x1BEF50 FORMAT "%.0" SYMBOL_LINK "testByte000" 3640 /end MEASUREMENT
/begin MEASUREMENT TestWord_911 "" UWORD Identity 0 0 0 255 ECU_ADDRESS 0x1BEF58 FORMAT "%.0" SYMBOL_LINK "testByte000" 3648 /end MEASUREMENT
/begin MEASUREMENT TestWord_912 "" UWORD Identity 0 0 0 255 ECU_ADDRESS 0x1BEF5C FORMAT "%.0" SYMBOL_LINK "testByte000" 3652 /end MEASUREMENT
/begin MEASUREMENT TestWord_913 "" UWORD Identity 0 0 0 255 ECU_ADDRESS 0x1BEF60 FORMAT "%.0" SYMBOL_LINK "testByte000" 3656 /end MEASUREMENT
/begin MEASUREMENT TestWord_914 "" UWORD Identity 0 0 0 255 ECU_ADDRESS 0x1BEF64 FORMAT "%.0" SYMBOL_LINK "testByte000" 3660 /end MEASUREMENT
/begin MEASUREMENT TestWord_915 "" UWORD Identity 0 0 0 255 ECU_ADDRESS 0x1BEF68 FORMAT "%.0" SYMBOL_LINK "testByte000" 3664 /end MEASUREMENT
/begin MEASUREMENT TestWord_916 "" UWORD Identity 0 0 0 255 ECU_ADDRESS 0x1BEF6C FORMAT "%.0" SYMBOL_LINK "testByte000" 3668 /end MEASUREMENT
/begin MEASUREMENT TestWord_918 "" UWORD Identity 0 0 0 255 ECU_ADDRESS 0x1BEF74 FORMAT "%.0" SYMBOL_LINK "testByte000" 3676 /end MEASUREMENT
/begin MEASUREMENT TestWord_919 "" UWORD Identity 0 0 0 255 ECU_ADDRESS 0x1BEF78 FORMAT "%.0" SYMBOL_LINK "testByte000" 3680 /end MEASUREMENT
/begin MEASUREMENT TestWord_920 "" UWORD Identity 0 0 0 255 ECU_ADDRESS 0x1BEF7C FORMAT "%.0" SYMBOL_LINK "testByte000" 3684 /end MEASUREMENT
/begin MEASUREMENT TestWord_921 "" UWORD Identity 0 0 0 255 ECU_ADDRESS 0x1BEF80 FORMAT "%.0" SYMBOL_LINK "testByte000" 3688 /end MEASUREMENT
/begin MEASUREMENT TestWord_924 "" UWORD Identity 0 0 0 255 ECU_ADDRESS 0x1BEF8C FORMAT "%.0" SYMBOL_LINK "testByte000" 3700 /end MEASUREMENT
/begin MEASUREMENT TestWord_926 "" UWORD Identity 0 0 0 255 ECU_ADDRESS 0x1BEF94 FORMAT "%.0" SYMBOL_LINK "testByte000" 3708 /end MEASUREMENT
/begin MEASUREMENT TestWord_928 "" UWORD Identity 0 0 0 255 ECU_ADDRESS 0x1BEF9C FORMAT "%.0" SYMBOL_LINK "testByte000" 3716 /end MEASUREMENT
/begin MEASUREMENT TestWord_930 "" UWORD Identity 0 0 0 255 ECU_ADDRESS 0x1BEFA4 FORMAT "%.0" SYMBOL_LINK "testByte000" 3724 /end MEASUREMENT
/begin MEASUREMENT TestWord_931 "" UWORD Identity 0 0 0 255 ECU_ADDRESS 0x1BEFA8 FORMAT "%.0" SYMBOL_LINK "testByte000" 3728 /end MEASUREMENT
/begin MEASUREMENT TestWord_935 "" UWORD Identity 0 0 0 255 ECU_ADDRESS 0x1BEFB8 FORMAT "%.0" SYMBOL_LINK "testByte000" 3744 /end MEASUREMENT
/begin MEASUREMENT TestWord_936 "" UWORD Identity 0 0 0 255 ECU_ADDRESS 0x1BEFBC FORMAT "%.0" SYMBOL_LINK "testByte000" 3748 /end MEASUREMENT
/begin MEASUREMENT TestWord_937 "" UWORD Identity 0 0 0 255 ECU_ADDRESS 0x1BEFC0 FORMAT "%.0" SYMBOL_LINK "testByte000" 3752 /end MEASUREMENT
/begin MEASUREMENT TestWord_939 "" UWORD Identity 0 0 0 255 ECU_ADDRESS 0x1BEFC8 FORMAT "%.0" SYMBOL_LINK "testByte000" 3760 /end MEASUREMENT
/begin MEASUREMENT TestWord_940 "" UWORD Identity 0 0 0 255 ECU_ADDRESS 0x1BEFCC FORMAT "%.0" SYMBOL_LINK "testByte000" 3764 /end MEASUREMENT
/begin MEASUREMENT TestWord_941 "" UWORD Identity 0 0 0 255 ECU_ADDRESS 0x1BEFD0 FORMAT "%.0" SYMBOL_LINK "testByte000" 3768 /end MEASUREMENT
/begin MEASUREMENT TestWord_942 "" UWORD Identity 0 0 0 255 ECU_ADDRESS 0x1BEFD4 FORMAT "%.0" SYMBOL_LINK "testByte000" 3772 /end MEASUREMENT
/begin MEASUREMENT TestWord_943 "" UWORD Identity 0 0 0 255 ECU_ADDRESS 0x1BEFD8 FORMAT "%.0" SYMBOL_LINK "testByte000" 3776 /end MEASUREMENT
/begin MEASUREMENT TestWord_944 "" UWORD Identity 0 0 0 255 ECU_ADDRESS 0x1BEFDC FORMAT "%.0" SYMBOL_LINK "testByte000" 3780 /end MEASUREMENT
/begin MEASUREMENT TestWord_946 "" UWORD Identity 0 0 0 255 ECU_ADDRESS 0x1BEFE4 FORMAT "%.0" SYMBOL_LINK "testByte000" 3788 /end MEASUREMENT
/begin MEASUREMENT TestWord_948 "" UWORD Identity 0 0 0 255 ECU_ADDRESS 0x1BEFEC FORMAT "%.0" SYMBOL_LINK "testByte000" 3796 /end MEASUREMENT
/begin MEASUREMENT TestWord_949 "" UWORD Identity 0 0 0 255 ECU_ADDRESS 0x1BEFF0 FORMAT "%.0" SYMBOL_LINK "testByte000" 3800 /end MEASUREMENT
/begin MEASUREMENT TestWord_950 "" UWORD Identity 0 0 0 255 ECU_ADDRESS 0x1BEFF4 FORMAT "%.0" SYMBOL_LINK "testByte000" 3804 /end MEASUREMENT
/begin MEASUREMENT TestWord_952 "" UWORD Identity 0 0 0 255 ECU_ADDRESS 0x1BEFFC FORMAT "%.0" SYMBOL_LINK "testByte000" 3812 /end MEASUREMENT
/begin MEASUREMENT TestWord_953 "" UWORD Identity 0 0 0 255 ECU_ADDRESS 0x1BF000 FORMAT "%.0" SYMBOL_LINK "testByte000" 3816 /end MEASUREMENT
/begin MEASUREMENT TestWord_954 "" UWORD Identity 0 0 0 255 ECU_ADDRESS 0x1BF004 FORMAT "%.0" SYMBOL_LINK "testByte000" 3820 /end MEASUREMENT
/begin MEASUREMENT TestWord_955 "" UWORD Identity 0 0 0 255 ECU_ADDRESS 0x1BF008 FORMAT "%.0" SYMBOL_LINK "testByte000" 3824 /end MEASUREMENT
/begin MEASUREMENT TestWord_957 "" UWORD Identity 0 0 0 255 ECU_ADDRESS 0x1BF010 FORMAT "%.0" SYMBOL_LINK "testByte000" 3832 /end MEASUREMENT
/begin MEASUREMENT TestWord_958 "" UWORD Identity 0 0 0 255 ECU_ADDRESS 0x1BF014 FORMAT "%.0" SYMBOL_LINK "testByte000" 3836 /end MEASUREMENT
/begin MEASUREMENT TestWord_960 "" UWORD Identity 0 0 0 255 ECU_ADDRESS 0x1BF01C FORMAT "%.0" SYMBOL_LINK "testByte000" 3844 /end MEASUREMENT
/begin MEASUREMENT TestWord_962 "" UWORD Identity 0 0 0 255 ECU_ADDRESS 0x1BF024 FORMAT "%.0" SYMBOL_LINK "testByte000" 3852 /end MEASUREMENT
/begin MEASUREMENT TestWord_963 "" UWORD Identity 0 0 0 255 ECU_ADDRESS 0x1BF028 FORMAT "%.0" SYMBOL_LINK "testByte000" 3856 /end MEASUREMENT
/begin MEASUREMENT TestWord_964 "" UWORD Identity 0 0 0 255 ECU_ADDRESS 0x1BF02C FORMAT "%.0" SYMBOL_LINK "testByte000" 3860 /end MEASUREMENT
/begin MEASUREMENT TestWord_966 "" UWORD Identity 0 0 0 255 ECU_ADDRESS 0x1BF034 FORMAT "%.0" SYMBOL_LINK "testByte000" 3868 /end MEASUREMENT
/begin MEASUREMENT TestWord_967 "" UWORD Identity 0 0 0 255 ECU_ADDRESS 0x1BF038 FORMAT "%.0" SYMBOL_LINK "testByte000" 3872 /end MEASUREMENT
/begin MEASUREMENT TestWord_968 "" UWORD Identity 0 0 0 255 ECU_ADDRESS 0x1BF03C FORMAT "%.0" SYMBOL_LINK "testByte000" 3876 /end MEASUREMENT
/begin MEASUREMENT TestWord_969 "" UWORD Identity 0 0 0 255 ECU_ADDRESS 0x1BF040 FORMAT "%.0" SYMBOL_LINK "testByte000" 3880 /end MEASUREMENT
/begin MEASUREMENT TestWord_970 "" UWORD Identity 0 0 0 255 ECU_ADDRESS 0x1BF044 FORMAT "%.0" SYMBOL_LINK "testByte000" 3884 /end MEASUREMENT
/begin MEASUREMENT TestWord_971 "" UWORD Identity 0 0 0 255 ECU_ADDRESS 0x1BF048 FORMAT "%.0" SYMBOL_LINK "testByte000" 3888 /end MEASUREMENT
/begin MEASUREMENT TestWord_972 "" UWORD Identity 0 0 0 255 ECU_ADDRESS 0x1BF04C FORMAT "%.0" SYMBOL_LINK "testByte000" 3892 /end MEASUREMENT
/begin MEASUREMENT TestWord_973 "" UWORD Identity 0 0 0 255 ECU_ADDRESS 0x1BF050 FORMAT "%.0" SYMBOL_LINK "testByte000" 3896 /end MEASUREMENT
/begin MEASUREMENT TestWord_975 "" UWORD Identity 0 0 0 255 ECU_ADDRESS 0x1BF058 FORMAT "%.0" SYMBOL_LINK "testByte000" 3904 /end MEASUREMENT
/begin MEASUREMENT TestWord_977 "" UWORD Identity 0 0 0 255 ECU_ADDRESS 0x1BF060 FORMAT "%.0" SYMBOL_LINK "testByte000" 3912 /end MEASUREMENT
/begin MEASUREMENT TestWord_978 "" UWORD Identity 0 0 0 255 ECU_ADDRESS 0x1BF064 FORMAT "%.0" SYMBOL_LINK "testByte000" 3916 /end MEASUREMENT
/begin MEASUREMENT TestWord_982 "" UWORD Identity 0 0 0 255 ECU_ADDRESS 0x1BF074 FORMAT "%.0" SYMBOL_LINK "testByte000" 3932 /end MEASUREMENT
/begin MEASUREMENT TestWord_984 "" UWORD Identity 0 0 0 255 ECU_ADDRESS 0x1BF07C FORMAT "%.0" SYMBOL_LINK "testByte000" 3940 /end MEASUREMENT
/begin MEASUREMENT TestWord_985 "" UWORD Identity 0 0 0 255 ECU_ADDRESS 0x1BF080 FORMAT "%.0" SYMBOL_LINK "testByte000" 3944 /end MEASUREMENT
/begin MEASUREMENT TestWord_986 "" UWORD Identity 0 0 0 255 ECU_ADDRESS 0x1BF084 FORMAT "%.0" SYMBOL_LINK "testByte000" 3948 /end MEASUREMENT
/begin MEASUREMENT TestWord_987 "" UWORD Identity 0 0 0 255 ECU_ADDRESS 0x1BF088 FORMAT "%.0" SYMBOL_LINK "testByte000" 3952 /end MEASUREMENT
/begin MEASUREMENT TestWord_988 "" UWORD Identity 0 0 0 255 ECU_ADDRESS 0x1BF08C FORMAT "%.0" SYMBOL_LINK "testByte000" 3956 /end MEASUREMENT
/begin MEASUREMENT TestWord_989 "" UWORD Identity 0 0 0 255 ECU_ADDRESS 0x1BF090 FORMAT "%.0" SYMBOL_LINK "testByte000" 3960 /end MEASUREMENT
/begin MEASUREMENT TestWord_991 "" UWORD Identity 0 0 0 255 ECU_ADDRESS 0x1BF098 FORMAT "%.0" SYMBOL_LINK "testByte000" 3968 /end MEASUREMENT
/begin MEASUREMENT TestWord_992 "" UWORD Identity 0 0 0 255 ECU_ADDRESS 0x1BF09C FORMAT "%.0" SYMBOL_LINK "testByte000" 3972 /end MEASUREMENT
/begin MEASUREMENT TestWord_997 "" UWORD Identity 0 0 0 255 ECU_ADDRESS 0x1BF0B0 FORMAT "%.0" SYMBOL_LINK "testByte000" 3992 /end MEASUREMENT
/begin MEASUREMENT TestWord_998 "" UWORD Identity 0 0 0 255 ECU_ADDRESS 0x1BF0B4 FORMAT "%.0" SYMBOL_LINK "testByte000" 3996 /end MEASUREMENT
/begin MEASUREMENT TestWord_999 "" UWORD Identity 0 0 0 255 ECU_ADDRESS 0x1BF0B8 FORMAT "%.0" SYMBOL_LINK "testByte000" 4000 /end MEASUREMENT
/begin MEASUREMENT bit12Counter "Demo signal (12 bit, incrementing)" UWORD Identity 0 0 0 4095 ECU_ADDRESS 0x1BE05C FORMAT "%.3" SYMBOL_LINK "wordCounter" 0 /end MEASUREMENT
/begin CHARACTERISTIC byte1 "Demo, read and write possible" VALUE 0x1C00A6 __UByte_Value 0 Identity 0 255 FORMAT "%.3" /end CHARACTERISTIC
/begin CHARACTERISTIC byte2 "Demo, read and write possible" VALUE 0x1C00A7 __UByte_Value 0 Identity 0 255 FORMAT "%.3" /end CHARACTERISTIC
/begin CHARACTERISTIC byte3 "Demo, read and write possible" VALUE 0x1C00AA __UByte_Value 0 Identity 0 255 FORMAT "%.3" /end CHARACTERISTIC
/begin CHARACTERISTIC byte4 "Demo, read and write possible" VALUE 0x1C00AB __UByte_Value 0 Identity 0 255 FORMAT "%.3" /end CHARACTERISTIC
/begin MEASUREMENT byteCounter "Demo signal (byte, incrementing)" UBYTE Identity 0 0 0 255 ECU_ADDRESS 0x1BDCB3 FORMAT "%.3" /end MEASUREMENT
/begin MEASUREMENT dwordCounter "Demo signal (dword, incrementing)" ULONG Identity 0 0 0 255 ECU_ADDRESS 0x1BE060 FORMAT "%.3" /end MEASUREMENT
/begin CHARACTERISTIC gDropCRO "CRO dropout probabilty" VALUE 0x1A4344 __SLong_Value_ColumnDir 0 Identity 0 100 FORMAT "%.0" /end CHARACTERISTIC
/begin CHARACTERISTIC gDropDTO "DTO dropout probability" VALUE 0x1A4348 __SLong_Value_ColumnDir 0 Identity 0 100 FORMAT "%.0" /end CHARACTERISTIC
/begin CHARACTERISTIC gFlushAlways "Use individual UDP/TCP packets" VALUE 0xDE1A0 __SLong_Value_ColumnDir 0 Identity 0 1 FORMAT "%.0" /end CHARACTERISTIC
/begin CHARACTERISTIC gTimerDrift "Timer drift for ECU time stamps" VALUE 0x1B60D8 __SLong_Value_ColumnDir 0 Identity_ppm -10000 10000 FORMAT "%.0" /end CHARACTERISTIC
/begin CHARACTERISTIC map1 "8*8 BYTE shared axis Curve1/Curve1" MAP 0x1C00D0 __UByte_Value 0 map1Conversion 0 2550
 /begin AXIS_DESCR FIX_AXIS map1InputX map1Input_Conversion 8 -12.8 12.7 FIX_AXIS_PAR_DIST 0 1 8 FORMAT "%.3" /end AXIS_DESCR
 /begin AXIS_DESCR FIX_AXIS map1InputY map1Input_Conversion 8 -12.8 12.7 FIX_AXIS_PAR_DIST 0 1 8 FORMAT "%.3" /end AXIS_DESCR
 FORMAT "%.3" SYMBOL_LINK "map1_8_8_uc" 0 /end CHARACTERISTIC
/begin CHARACTERISTIC map1Counter "" VALUE 0x1C00AD __UByte_Value_ColumnDir 0 Identity 0 255 FORMAT "%.3" /end CHARACTERISTIC
/begin MEASUREMENT map1InputX "" UBYTE map1Input_Conversion 0 0 0 25.5 ECU_ADDRESS 0x1BDDCA FORMAT "%.3" /end MEASUREMENT
/begin MEASUREMENT map1InputY "" UBYTE map1Input_Conversion 0 0 0 25.5 ECU_ADDRESS 0x1BDDCB FORMAT "%.3" /end MEASUREMENT
/begin MEASUREMENT map1Output "" UBYTE map1Conversion 0 0 0 2550 ECU_ADDRESS 0x1BDDCE FORMAT "%.3" /end MEASUREMENT
/begin MEASUREMENT sbytePWMLevel "" SBYTE Identity 0 0 -128 127 ECU_ADDRESS 0x1C00A2 FORMAT "%.15" /end MEASUREMENT
/begin MEASUREMENT stim_timeout "" ULONG stim_timeout_stat_X_AXIS.CONVERSION 0 0 0 1000 ECU_ADDRESS 0x1BF118 FORMAT "%.12" /end MEASUREMENT
/begin CHARACTERISTIC stim_timeout_stat "" CURVE 0x1BF120 __ULong_Value 0 Identity 0 100000
 /begin AXIS_DESCR FIX_AXIS NO_INPUT_QUANTITY stim_timeout_stat_X_AXIS.CONVERSION 100 0 100 MONOTONY MON_INCREASE FIX_AXIS_PAR_DIST 0 1 100 FORMAT "%.12" /end AXIS_DESCR
 FORMAT "%.12" /end CHARACTERISTIC
/begin MEASUREMENT tcp_ctr_rx "" UWORD NO_COMPU_METHOD 0 0 0 65535 ECU_ADDRESS 0x1C10CC FORMAT "%.15" /end MEASUREMENT
/begin CHARACTERISTIC testString "vcv" ASCII 0x1BF464 __UByte_Value 0 NO_COMPU_METHOD 0 255 NUMBER 10 /end CHARACTERISTIC
/begin CHARACTERISTIC testbit0 "" VALUE 0x1C0C58 __UByte_Value 0 Identity 0 1 BIT_MASK 0x1 FORMAT "%.3" SYMBOL_LINK "calram" 0 /end CHARACTERISTIC
/begin CHARACTERISTIC testbit1 "" VALUE 0x1C0C58 __UByte_Value 0 Identity 0 1 BIT_MASK 0x2 FORMAT "%.3" SYMBOL_LINK "calram" 0 /end CHARACTERISTIC
/begin CHARACTERISTIC testbit2 "" VALUE 0x1C0C58 __UByte_Value 0 Identity 0 1 BIT_MASK 0x4 FORMAT "%.3" SYMBOL_LINK "calram" 0 /end CHARACTERISTIC
/begin CHARACTERISTIC testbit3 "" VALUE 0x1C0C58 __UByte_Value 0 Identity 0 1 BIT_MASK 0x8 FORMAT "%.3" SYMBOL_LINK "calram" 0 /end CHARACTERISTIC
/begin CHARACTERISTIC testbit4 "" VALUE 0x1C0C58 __UByte_Value 0 Identity 0 1 BIT_MASK 0x10 FORMAT "%.3" SYMBOL_LINK "calram" 0 /end CHARACTERISTIC
/begin CHARACTERISTIC testbit5 "" VALUE 0x1C0C58 __UByte_Value 0 Identity 0 1 BIT_MASK 0x20 FORMAT "%.3" SYMBOL_LINK "calram" 0 /end CHARACTERISTIC
/begin CHARACTERISTIC testbit6 "" VALUE 0x1C0C58 __UByte_Value 0 Identity 0 1 BIT_MASK 0x40 FORMAT "%.3" SYMBOL_LINK "calram" 0 /end CHARACTERISTIC
/begin CHARACTERISTIC testbit7 "" VALUE 0x1C0C58 __UByte_Value 0 Identity 0 1 BIT_MASK 0x80 FORMAT "%.3" SYMBOL_LINK "calram" 0 /end CHARACTERISTIC
/begin CHARACTERISTIC testbitslice0 "" VALUE 0x1C0C58 __UByte_Value 0 Identity 0 31 BIT_MASK 0x1F FORMAT "%.3" SYMBOL_LINK "calram" 0 /end CHARACTERISTIC
/begin CHARACTERISTIC testbitslice1 "" VALUE 0x1C0C58 __UWord_Value 0 Identity 0 31 BIT_MASK 0x3E0 FORMAT "%.3" SYMBOL_LINK "calram" 0 /end CHARACTERISTIC
/begin CHARACTERISTIC testbitslice2 "" VALUE 0x1C0C59 __UByte_Value 0 Identity 0 63 BIT_MASK 0xFC FORMAT "%.3" SYMBOL_LINK "calram" 1 /end CHARACTERISTIC
/begin CHARACTERISTIC testbyte0 "" VALUE 0x1C0C58 __UByte_Value 0 Identity 0 255 FORMAT "%.3" SYMBOL_LINK "calram" 0 /end CHARACTERISTIC
/begin CHARACTERISTIC testbyte1 "" VALUE 0x1C0C59 __UByte_Value 0 Identity 0 255 FORMAT "%.3" SYMBOL_LINK "calram" 1 /end CHARACTERISTIC
/begin CHARACTERISTIC testbyte2 "" VALUE 0x1C0C5A __UByte_Value 0 Identity 0 255 FORMAT "%.3" SYMBOL_LINK "calram" 2 /end CHARACTERISTIC
/begin CHARACTERISTIC testbyte3 "" VALUE 0x1C0C5B __UByte_Value 0 Identity 0 255 FORMAT "%.3" SYMBOL_LINK "calram" 3 /end CHARACTERISTIC
/begin CHARACTERISTIC testbyte4 "" VALUE 0x1C0C5C __UByte_Value 0 Identity 0 255 FORMAT "%.3" SYMBOL_LINK "calram" 4 /end CHARACTERISTIC
/begin CHARACTERISTIC testbyte5 "" VALUE 0x1C0C5D __UByte_Value 0 Identity 0 255 FORMAT "%.3" SYMBOL_LINK "calram" 5 /end CHARACTERISTIC
/begin CHARACTERISTIC testbyte6 "" VALUE 0x1C0C5E __UByte_Value 0 Identity 0 255 FORMAT "%.3" SYMBOL_LINK "calram" 6 /end CHARACTERISTIC
/begin CHARACTERISTIC testbyte7 "" VALUE 0x1C0C5F __UByte_Value 0 Identity 0 255 FORMAT "%.3" SYMBOL_LINK "calram" 7 /end CHARACTERISTIC
/begin CHARACTERISTIC testdword0 "" VALUE 0x1C0C58 __SLong_Value 0 Identity -2147483648 2147483647 FORMAT "%.3" SYMBOL_LINK "calram" 0 /end CHARACTERISTIC
/begin CHARACTERISTIC testdword1 "" VALUE 0x1C0C5C __SLong_Value 0 Identity -2147483648 2147483647 FORMAT "%.3" SYMBOL_LINK "calram" 4 /end CHARACTERISTIC
/begin CHARACTERISTIC testubitslice0 "" VALUE 0x1C0C58 __UByte_Value 0 Identity 0 31 BIT_MASK 0x1F FORMAT "%.3" SYMBOL_LINK "calram" 0 /end CHARACTERISTIC
/begin CHARACTERISTIC testubitslice1 "" VALUE 0x1C0C58 __UWord_Value 0 Identity 0 31 BIT_MASK 0x3E0 FORMAT "%.3" SYMBOL_LINK "calram" 0 /end CHARACTERISTIC
/begin CHARACTERISTIC testubitslice2 "" VALUE 0x1C0C59 __UByte_Value 0 Identity 0 63 BIT_MASK 0xFC FORMAT "%.3" SYMBOL_LINK "calram" 1 /end CHARACTERISTIC
/begin CHARACTERISTIC testubyte0 "" VALUE 0x1C0C58 __UByte_Value 0 Identity 0 255 FORMAT "%.3" SYMBOL_LINK "calram" 0 /end CHARACTERISTIC
/begin CHARACTERISTIC testubyte1 "" VALUE 0x1C0C59 __UByte_Value 0 Identity 0 255 FORMAT "%.3" SYMBOL_LINK "calram" 1 /end CHARACTERISTIC
/begin CHARACTERISTIC testubyte2 "" VALUE 0x1C0C5A __UByte_Value 0 Identity 0 255 FORMAT "%.3" SYMBOL_LINK "calram" 2 /end CHARACTERISTIC
/begin CHARACTERISTIC testubyte3 "" VALUE 0x1C0C5B __UByte_Value 0 Identity 0 255 FORMAT "%.3" SYMBOL_LINK "calram" 3 /end CHARACTERISTIC
/begin CHARACTERISTIC testubyte4 "" VALUE 0x1C0C5C __UByte_Value 0 Identity 0 255 FORMAT "%.3" SYMBOL_LINK "calram" 4 /end CHARACTERISTIC
/begin CHARACTERISTIC testubyte5 "" VALUE 0x1C0C5D __UByte_Value 0 Identity 0 255 FORMAT "%.3" SYMBOL_LINK "calram" 5 /end CHARACTERISTIC
/begin CHARACTERISTIC testubyte6 "" VALUE 0x1C0C5E __UByte_Value 0 Identity 0 255 FORMAT "%.3" SYMBOL_LINK "calram" 6 /end CHARACTERISTIC
/begin CHARACTERISTIC testubyte7 "" VALUE 0x1C0C5F __UByte_Value 0 Identity 0 255 FORMAT "%.3" SYMBOL_LINK "calram" 7 /end CHARACTERISTIC
/begin CHARACTERISTIC testudword0 "" VALUE 0x1C0C58 __ULong_Value_ColumnDir 0 Identity 0 4294967295 FORMAT "%.3" SYMBOL_LINK "calram" 0 /end CHARACTERISTIC
/begin CHARACTERISTIC testudword1 "" VALUE 0x1C0C5C __ULong_Value_ColumnDir 0 Identity 0 4294967295 FORMAT "%.3" SYMBOL_LINK "calram" 4 /end CHARACTERISTIC
/begin CHARACTERISTIC testuword0 "" VALUE 0x1C0C58 __UWord_Value_ColumnDir 0 Identity 0 65535 FORMAT "%.3" SYMBOL_LINK "calram" 0 /end CHARACTERISTIC
/begin CHARACTERISTIC testuword1 "" VALUE 0x1C0C5A __UWord_Value_ColumnDir 0 Identity 0 65535 FORMAT "%.3" SYMBOL_LINK "calram" 2 /end CHARACTERISTIC
/begin CHARACTERISTIC testuword2 "" VALUE 0x1C0C5C __UWord_Value_ColumnDir 0 Identity 0 65535 FORMAT "%.3" SYMBOL_LINK "calram" 4 /end CHARACTERISTIC
/begin CHARACTERISTIC testuword3 "" VALUE 0x1C0C5E __UWord_Value_ColumnDir 0 Identity 0 65535 FORMAT "%.3" SYMBOL_LINK "calram" 6 /end CHARACTERISTIC
/begin CHARACTERISTIC testword0 "" VALUE 0x1C0C58 __SWord_Value_ColumnDir 0 Identity -32768 32767 FORMAT "%.3" SYMBOL_LINK "calram" 0 /end CHARACTERISTIC
/begin CHARACTERISTIC testword1 "" VALUE 0x1C0C5A __SWord_Value_ColumnDir 0 Identity -32768 32767 FORMAT "%.3" SYMBOL_LINK "calram" 2 /end CHARACTERISTIC
/begin CHARACTERISTIC testword2 "" VALUE 0x1C0C5C __SWord_Value_ColumnDir 0 Identity -32768 32767 FORMAT "%.3" SYMBOL_LINK "calram" 4 /end CHARACTERISTIC
/begin CHARACTERISTIC testword3 "" VALUE 0x1C0C5E __SWord_Value_ColumnDir 0 Identity -32768 32767 FORMAT "%.3" SYMBOL_LINK "calram" 6 /end CHARACTERISTIC
/begin CHARACTERISTIC timeFactor "ECU clock factor (time master)" VALUE 0x1C0BC4 __Float32_Value_ColumnDir 0 NO_COMPU_METHOD 0 20 FORMAT "%.1" /end CHARACTERISTIC
/begin MEASUREMENT wordCounter "Demo signal (word, incrementing)" UWORD Identity 0 0 0 65535 ECU_ADDRESS 0x1BE05C FORMAT "%.3" /end MEASUREMENT
/begin COMPU_METHOD DtChannel1.Calculation "" FORM "%3.1" "" /begin FORMULA "time(X1)-time(X1[-1])" /end FORMULA /end COMPU_METHOD
/begin COMPU_METHOD Identity "" IDENTICAL "%6.2" "" /end COMPU_METHOD
/begin COMPU_METHOD Identity_ppm "" IDENTICAL "%3.1" "ppm" /end COMPU_METHOD
/begin COMPU_METHOD MaxChannel1.Calculation "" FORM "%3.1" "" /begin FORMULA "max(phy(X1))" /end FORMULA /end COMPU_METHOD
/begin COMPU_METHOD MinChannel1.Calculation "" FORM "%3.1" "" /begin FORMULA "min(phy(X1))" /end FORMULA /end COMPU_METHOD
/begin COMPU_METHOD map1Conversion "" LINEAR "%3.1" "cm" COEFFS_LINEAR 10 0 /end COMPU_METHOD
/begin COMPU_METHOD map1Input_Conversion "" LINEAR "%3.1" "m" COEFFS_LINEAR 0.1 0 /end COMPU_METHOD
/begin COMPU_METHOD stim_timeout_stat_X_AXIS.CONVERSION "" LINEAR "%3.1" "ms" COEFFS_LINEAR 0.1 0 /end COMPU_METHOD
/begin RECORD_LAYOUT CurveNxXVub NO_AXIS_PTS_X 1 UBYTE AXIS_PTS_X 2 UBYTE INDEX_INCR DIRECT FNC_VALUES 3 UBYTE ROW_DIR DIRECT /end RECORD_LAYOUT
/begin RECORD_LAYOUT MapNxNyVub NO_AXIS_PTS_X 1 UBYTE NO_AXIS_PTS_Y 2 UBYTE FNC_VALUES 3 UBYTE ROW_DIR DIRECT /end RECORD_LAYOUT
/begin RECORD_LAYOUT MapNxNyXYVub NO_AXIS_PTS_X 1 UBYTE NO_AXIS_PTS_Y 2 UBYTE AXIS_PTS_X 3 UBYTE INDEX_INCR DIRECT AXIS_PTS_Y 4 UBYTE INDEX_INCR DIRECT FNC_VALUES 5 UBYTE ROW_DIR DIRECT /end RECORD_LAYOUT
/begin RECORD_LAYOUT MapXYVub AXIS_PTS_X 1 UBYTE INDEX_INCR DIRECT AXIS_PTS_Y 2 UBYTE INDEX_INCR DIRECT FNC_VALUES 3 UBYTE ROW_DIR DIRECT /end RECORD_LAYOUT
/begin RECORD_LAYOUT __Float32_Value_ColumnDir FNC_VALUES 1 FLOAT32_IEEE COLUMN_DIR DIRECT /end RECORD_LAYOUT
/begin RECORD_LAYOUT __SLong_Value FNC_VALUES 1 SLONG ROW_DIR DIRECT /end RECORD_LAYOUT
/begin RECORD_LAYOUT __SLong_Value_ColumnDir FNC_VALUES 1 SLONG COLUMN_DIR DIRECT /end RECORD_LAYOUT
/begin RECORD_LAYOUT __SWord_Value_ColumnDir FNC_VALUES 1 SWORD COLUMN_DIR DIRECT /end RECORD_LAYOUT
/begin RECORD_LAYOUT __UByte_Value FNC_VALUES 1 UBYTE ROW_DIR DIRECT /end RECORD_LAYOUT
/begin RECORD_LAYOUT __UByte_Value_ColumnDir FNC_VALUES 1 UBYTE COLUMN_DIR DIRECT /end RECORD_LAYOUT
/begin RECORD_LAYOUT __ULong_Value FNC_VALUES 1 ULONG ROW_DIR DIRECT /end RECORD_LAYOUT
/begin RECORD_LAYOUT __ULong_Value_ColumnDir FNC_VALUES 1 ULONG COLUMN_DIR DIRECT /end RECORD_LAYOUT
/begin RECORD_LAYOUT __UWord_Value FNC_VALUES 1 UWORD ROW_DIR DIRECT /end RECORD_LAYOUT
/begin RECORD_LAYOUT __UWord_Value_ColumnDir FNC_VALUES 1 UWORD COLUMN_DIR DIRECT /end RECORD_LAYOUT
/begin GROUP TestData "Kommentar" ROOT
 /begin REF_MEASUREMENT TestByte_000 TestByte_015 TestByte_016 TestByte_023 TestByte_024 TestByte_034 TestByte_059 TestByte_061 TestByte_063 TestByte_064 TestByte_097 TestByte_107 TestByte_131 TestByte_156 TestByte_159 TestByte_182 TestByte_183 TestByte_189 TestByte_195 TestByte_216 TestByte_218 TestByte_221 TestByte_251 TestByte_263 TestByte_276 TestByte_277 TestByte_297 TestByte_302 TestByte_324 TestByte_344 TestByte_346 TestByte_354 TestByte_359 TestByte_378 TestByte_402 TestByte_403 TestByte_406 TestByte_413 TestByte_414 TestByte_415 TestByte_427 TestByte_438 TestByte_446 TestByte_448 TestByte_451 TestByte_462 TestByte_466 TestByte_469 TestByte_486 TestByte_494 TestByte_500 TestByte_527 TestByte_530 TestByte_533 TestByte_556 TestByte_589 TestByte_590 TestByte_591 TestByte_592 TestByte_598 TestByte_606 TestByte_608 TestByte_618 TestByte_621 TestByte_627 TestByte_638 TestByte_644 TestByte_647 TestByte_648 TestByte_659 TestByte_668 TestByte_700 TestByte_711 TestByte_715 TestByte_728 TestByte_731 TestByte_732 TestByte_738 TestByte_746 TestByte_752 TestByte_774 TestByte_777 TestByte_778 TestByte_784 TestByte_786 TestByte_789 TestByte_793 TestByte_798 TestByte_855 TestByte_857 TestByte_861 TestByte_865 TestByte_880 TestByte_902 TestByte_905 TestByte_934 TestByte_938 TestByte_947 TestByte_951 TestByte_961 TestByte_965 TestByte_974 TestByte_976 TestByte_981 TestByte_983 TestByte_993 TestDWord_002 TestDWord_010 TestDWord_018 TestDWord_019 TestDWord_022 TestDWord_030 TestDWord_045 TestDWord_047 TestDWord_049 TestDWord_056 TestDWord_057 TestDWord_066 TestDWord_067 TestDWord_073 TestDWord_079 TestDWord_086 TestDWord_087 TestDWord_094 TestDWord_100 TestDWord_102 TestDWord_110 TestDWord_114 TestDWord_115 TestDWord_118 TestDWord_122 TestDWord_128 TestDWord_135 TestDWord_145 TestDWord_147 TestDWord_150 TestDWord_161 TestDWord_165 TestDWord_167 TestDWord_168 TestDWord_172 TestDWord_174 TestDWord_180 TestDWord_181 TestDWord_186 TestDWord_187 TestDWord_190 TestDWord_197 TestDWord_199 TestDWord_201 TestDWord_205 TestDWord_210 TestDWord_212 TestDWord_223 TestDWord_224 TestDWord_227 TestDWord_240 TestDWord_244 TestDWord_245 TestDWord_257 TestDWord_269 TestDWord_270 TestDWord_274 TestDWord_283 TestDWord_286 TestDWord_296 TestDWord_306 TestDWord_308 TestDWord_309 TestDWord_313 TestDWord_326 TestDWord_338 TestDWord_340 TestDWord_348 TestDWord_355 TestDWord_358 TestDWord_360 TestDWord_372 TestDWord_375 TestDWord_376 TestDWord_383 TestDWord_385 TestDWord_387 TestDWord_388 TestDWord_396 TestDWord_398 TestDWord_399 TestDWord_407 TestDWord_409 TestDWord_410 TestDWord_411 TestDWord_426 TestDWord_431 TestDWord_433 TestDWord_443 TestDWord_444 TestDWord_458 TestDWord_470 TestDWord_471 TestDWord_474 TestDWord_478 TestDWord_479 TestDWord_480 TestDWord_483 TestDWord_488 TestDWord_492 TestDWord_496 TestDWord_501 TestDWord_502 TestDWord_503 TestDWord_504 TestDWord_508 TestDWord_516 TestDWord_524 TestDWord_529 TestDWord_534 TestDWord_535 TestDWord_545 TestDWord_550 TestDWord_557 TestDWord_558 TestDWord_575 TestDWord_576 TestDWord_577 TestDWord_582 TestDWord_584 TestDWord_596 TestDWord_601 TestDWord_620 TestDWord_624 TestDWord_643 TestDWord_669 TestDWord_671 TestDWord_675 TestDWord_679 TestDWord_684 TestDWord_691 TestDWord_693 TestDWord_694 TestDWord_697 TestDWord_703 TestDWord_708 TestDWord_714 TestDWord_716 TestDWord_722 TestDWord_724 TestDWord_725 TestDWord_727 TestDWord_730 TestDWord_748 TestDWord_758 TestDWord_769 TestDWord_773 TestDWord_782 TestDWord_783 TestDWord_794 TestDWord_800 TestDWord_805 TestDWord_811 TestDWord_814 TestDWord_823 TestDWord_825 TestDWord_828 TestDWord_839 TestDWord_849 TestDWord_850 TestDWord_851 TestDWord_863 TestDWord_866 TestDWord_873 TestDWord_875 TestDWord_883 TestDWord_895 TestDWord_899 TestDWord_906 TestDWord_907 TestDWord_908 TestDWord_910 TestDWord_917 TestDWord_922 TestDWord_923 TestDWord_925 TestDWord_927 TestDWord_929 TestDWord_932 TestDWord_933 TestDWord_945 TestDWord_956 TestDWord_959 TestDWord_979 TestDWord_980 TestDWord_990 TestDWord_994 TestDWord_995 TestDWord_996 TestWord_001 TestWord_003 TestWord_004 TestWord_005 TestWord_006 TestWord_007 TestWord_008 TestWord_009 TestWord_011 TestWord_012 TestWord_013 TestWord_014 TestWord_017 TestWord_020 TestWord_021 TestWord_025 TestWord_026 TestWord_027 TestWord_028 TestWord_029 TestWord_031 TestWord_032 TestWord_033 TestWord_035 TestWord_036 TestWord_037 TestWord_038 TestWord_039 TestWord_040 TestWord_041 TestWord_042 TestWord_043 TestWord_044 TestWord_046 TestWord_048 TestWord_050 TestWord_051 TestWord_052 TestWord_053 TestWord_054 TestWord_055 TestWord_058 TestWord_060 TestWord_062 TestWord_065 TestWord_068 TestWord_069 TestWord_070 TestWord_071 TestWord_072 TestWord_074 TestWord_075 TestWord_076 TestWord_077 TestWord_078 TestWord_080 TestWord_081 TestWord_082 TestWord_083 TestWord_084 TestWord_085 TestWord_088 TestWord_089 TestWord_090 TestWord_091 TestWord_092 TestWord_093 TestWord_095 TestWord_096 TestWord_098 TestWord_099 TestWord_101 TestWord_103 TestWord_104 TestWord_105 TestWord_106 TestWord_108 TestWord_109 TestWord_111 TestWord_112 TestWord_113 TestWord_116 TestWord_117 TestWord_119 TestWord_120 TestWord_121 TestWord_123 TestWord_124 TestWord_125 TestWord_126 TestWord_127 TestWord_129 TestWord_130 TestWord_132 TestWord_133 TestWord_134 TestWord_136 TestWord_137 TestWord_138 TestWord_139 TestWord_140 TestWord_141 TestWord_142 TestWord_143 TestWord_144 TestWord_146 TestWord_148 TestWord_149 TestWord_151 TestWord_152 TestWord_153 TestWord_154 TestWord_155 TestWord_157 TestWord_158 TestWord_160 TestWord_162 TestWord_163 TestWord_164 TestWord_166 TestWord_169 TestWord_170 TestWord_171 TestWord_173 TestWord_175 TestWord_176 TestWord_177 TestWord_178 TestWord_179 TestWord_184 TestWord_185 TestWord_188 TestWord_191 TestWord_192 TestWord_193 TestWord_194 TestWord_196 TestWord_198 TestWord_200 TestWord_202 TestWord_203 TestWord_204 TestWord_206 TestWord_207 TestWord_208 TestWord_209 TestWord_211 TestWord_213 TestWord_214 TestWord_215 TestWord_217 TestWord_219 TestWord_220 TestWord_222 TestWord_225 TestWord_226 TestWord_228 TestWord_229 TestWord_230 TestWord_231 TestWord_232 TestWord_233 TestWord_234 TestWord_235 TestWord_236 TestWord_237 TestWord_238 TestWord_239 TestWord_241 TestWord_242 TestWord_243 TestWord_246 TestWord_247 TestWord_248 TestWord_249 TestWord_250 TestWord_252 TestWord_253 TestWord_254 TestWord_255 TestWord_256 TestWord_258 TestWord_259 TestWord_260 TestWord_261 TestWord_262 TestWord_264 TestWord_265 TestWord_266 TestWord_267 TestWord_268 TestWord_271 TestWord_272 TestWord_273 TestWord_275 TestWord_278 TestWord_279 TestWord_280 TestWord_281 TestWord_282 TestWord_284 TestWord_285 TestWord_287 TestWord_288 TestWord_289 TestWord_290 TestWord_291 TestWord_292 TestWord_293 TestWord_294 TestWord_295 TestWord_298 TestWord_299 TestWord_300 TestWord_301 TestWord_303 TestWord_304 TestWord_305 TestWord_307 TestWord_310 TestWord_311 TestWord_312 TestWord_314 TestWord_315 TestWord_316 TestWord_317 TestWord_318 TestWord_319 TestWord_320 TestWord_321 TestWord_322 TestWord_323 TestWord_325 TestWord_327 TestWord_328 TestWord_329 TestWord_330 TestWord_331 TestWord_332 TestWord_333 TestWord_334 TestWord_335 TestWord_336 TestWord_337 TestWord_339 TestWord_341 TestWord_342 TestWord_343 TestWord_345 TestWord_347 TestWord_349 TestWord_350 TestWord_351 TestWord_352 TestWord_353 TestWord_356 TestWord_357 TestWord_361 TestWord_362 TestWord_363 TestWord_364 TestWord_365 TestWord_366 TestWord_367 TestWord_368 TestWord_369 TestWord_370 TestWord_371 TestWord_373 TestWord_374 TestWord_377 TestWord_379 TestWord_380 TestWord_381 TestWord_382 TestWord_384 TestWord_386 TestWord_389 TestWord_390 TestWord_391 TestWord_392 TestWord_393 TestWord_394 TestWord_395 TestWord_397 TestWord_400 TestWord_401 TestWord_404 TestWord_405 TestWord_408 TestWord_412 TestWord_416 TestWord_417 TestWord_418 TestWord_419 TestWord_420 TestWord_421 TestWord_422 TestWord_423 TestWord_424 TestWord_425 TestWord_428 TestWord_429 TestWord_430 TestWord_432 TestWord_434 TestWord_435 TestWord_436 TestWord_437 TestWord_439 TestWord_440 TestWord_441 TestWord_442 TestWord_445 TestWord_447 TestWord_449 TestWord_450 TestWord_452 TestWord_453 TestWord_454 TestWord_455 TestWord_456 TestWord_457 TestWord_459 TestWord_460 TestWord_461 TestWord_463 TestWord_464 TestWord_465 TestWord_467 TestWord_468 TestWord_472 TestWord_473 TestWord_475 TestWord_476 TestWord_477 TestWord_481 TestWord_482 TestWord_484 TestWord_485 TestWord_487 TestWord_489 TestWord_490 TestWord_491 TestWord_493 TestWord_495 TestWord_497 TestWord_498 TestWord_499 TestWord_505 TestWord_506 TestWord_507 TestWord_509 TestWord_510 TestWord_511 TestWord_512 TestWord_513 TestWord_514 TestWord_515 TestWord_517 TestWord_518 TestWord_519 TestWord_520 TestWord_521 TestWord_522 TestWord_523 TestWord_525 TestWord_526 TestWord_528 TestWord_531 TestWord_532 TestWord_536 TestWord_537 TestWord_538 TestWord_539 TestWord_540 TestWord_541 TestWord_542 TestWord_543 TestWord_544 TestWord_546 TestWord_547 TestWord_548 TestWord_549 TestWord_551 TestWord_552 TestWord_553 TestWord_554 TestWord_555 TestWord_559 TestWord_560 TestWord_561 TestWord_562 TestWord_563 TestWord_564 TestWord_565 TestWord_566 TestWord_567 TestWord_568 TestWord_569 TestWord_570 TestWord_571 TestWord_572 TestWord_573 TestWord_574 TestWord_578 TestWord_579 TestWord_580 TestWord_581 TestWord_583 TestWord_585 TestWord_586 TestWord_587 TestWord_588 TestWord_593 TestWord_594 TestWord_595 TestWord_597 TestWord_599 TestWord_600 TestWord_602 TestWord_603 TestWord_604 TestWord_605 TestWord_607 TestWord_609 TestWord_610 TestWord_611 TestWord_612 TestWord_613 TestWord_614 TestWord_615 TestWord_616 TestWord_617 TestWord_619 TestWord_622 TestWord_623 TestWord_625 TestWord_626 TestWord_628 TestWord_629 TestWord_630 TestWord_631 TestWord_632 TestWord_633 TestWord_634 TestWord_635 TestWord_636 TestWord_637 TestWord_639 TestWord_640 TestWord_641 TestWord_642 TestWord_645 TestWord_646 TestWord_649 TestWord_650 TestWord_651 TestWord_652 TestWord_653 TestWord_654 TestWord_655 TestWord_656 TestWord_657 TestWord_658 TestWord_660 TestWord_661 TestWord_662 TestWord_663 TestWord_664 TestWord_665 TestWord_666 TestWord_667 TestWord_670 TestWord_672 TestWord_673 TestWord_674 TestWord_676 TestWord_677 TestWord_678 TestWord_680 TestWord_681 TestWord_682 TestWord_683 TestWord_685 TestWord_686 TestWord_687 TestWord_688 TestWord_689 TestWord_690 TestWord_692 TestWord_695 TestWord_696 TestWord_698 TestWord_699 TestWord_701 TestWord_702 TestWord_704 TestWord_705 TestWord_706 TestWord_707 TestWord_709 TestWord_710 TestWord_712 TestWord_713 TestWord_717 TestWord_718 TestWord_719 TestWord_720 TestWord_721 TestWord_723 TestWord_726 TestWord_729 TestWord_733 TestWord_734 TestWord_735 TestWord_736 TestWord_737 TestWord_739 TestWord_740 TestWord_741 TestWord_742 TestWord_743 TestWord_744 TestWord_745 TestWord_747 TestWord_749 TestWord_750 TestWord_751 TestWord_753 TestWord_754 TestWord_755 TestWord_756 TestWord_757 TestWord_759 TestWord_760 TestWord_761 TestWord_762 TestWord_763 TestWord_764 TestWord_765 TestWord_766 TestWord_767 TestWord_768 TestWord_770 TestWord_771 TestWord_772 TestWord_775 TestWord_776 TestWord_779 TestWord_780 TestWord_781 TestWord_785 TestWord_787 TestWord_788 TestWord_790 TestWord_791 TestWord_792 TestWord_795 TestWord_796 TestWord_797 TestWord_799 TestWord_801 TestWord_802 TestWord_803 TestWord_804 TestWord_806 TestWord_807 TestWord_808 TestWord_809 TestWord_810 TestWord_812 TestWord_813 TestWord_815 TestWord_816 TestWord_817 TestWord_818 TestWord_819 TestWord_820 TestWord_821 TestWord_822 TestWord_824 TestWord_826 TestWord_827 TestWord_829 TestWord_830 TestWord_831 TestWord_832 TestWord_833 TestWord_834 TestWord_835 TestWord_836 TestWord_837 TestWord_838 TestWord_840 TestWord_841 TestWord_842 TestWord_843 TestWord_844 TestWord_845 TestWord_846 TestWord_847 TestWord_848 TestWord_852 TestWord_853 TestWord_854 TestWord_856 TestWord_858 TestWord_859 TestWord_860 TestWord_862 TestWord_864 TestWord_867 TestWord_868 TestWord_869 TestWord_870 TestWord_871 TestWord_872 TestWord_874 TestWord_876 TestWord_877 TestWord_878 TestWord_879 TestWord_881 TestWord_882 TestWord_884 TestWord_885 TestWord_886 TestWord_887 TestWord_888 TestWord_889 TestWord_890 TestWord_891 TestWord_892 TestWord_893 TestWord_894 TestWord_896 TestWord_897 TestWord_898 TestWord_900 TestWord_901 TestWord_903 TestWord_904 TestWord_909 TestWord_911 TestWord_912 TestWord_913 TestWord_914 TestWord_915 TestWord_916 TestWord_918 TestWord_919 TestWord_920 TestWord_921 TestWord_924 TestWord_926 TestWord_928 TestWord_930 TestWord_931 TestWord_935 TestWord_936 TestWord_937 TestWord_939 TestWord_940 TestWord_941 TestWord_942 TestWord_943 TestWord_944 TestWord_946 TestWord_948 TestWord_949 TestWord_950 TestWord_952 TestWord_953 TestWord_954 TestWord_955 TestWord_957 TestWord_958 TestWord_960 TestWord_962 TestWord_963 TestWord_964 TestWord_966 TestWord_967 TestWord_968 TestWord_969 TestWord_970 TestWord_971 TestWord_972 TestWord_973 TestWord_975 TestWord_977 TestWord_978 TestWord_982 TestWord_984 TestWord_985 TestWord_986 TestWord_987 TestWord_988 TestWord_989 TestWord_991 TestWord_992 TestWord_997 TestWord_998 TestWord_999 /end REF_MEASUREMENT
/end GROUP
/begin GROUP Test_Parameters "Test Parameters, BYTE"
 /begin REF_CHARACTERISTIC testbit0 testbit1 testbit2 testbit3 testbit4 testbit5 testbit6 testbit7 testbitslice0 testbitslice1 testbitslice2 testbyte0 testbyte1 testbyte2 testbyte3 testbyte4 testbyte5 testbyte6 testbyte7 testdword0 testdword1 testubitslice0 testubitslice1 testubitslice2 testubyte0 testubyte1 testubyte2 testubyte3 testubyte4 testubyte5 testubyte6 testubyte7 testudword0 testudword1 testuword0 testuword1 testuword2 testuword3 testword0 testword1 testword2 testword3 /end REF_CHARACTERISTIC
 /begin REF_MEASUREMENT tcp_ctr_rx /end REF_MEASUREMENT
/end GROUP
/begin GROUP Test_Signals "Test Signals" /begin REF_CHARACTERISTIC byte1 byte2 byte3 byte4 /end REF_CHARACTERISTIC
 /begin REF_MEASUREMENT KL1Output bit12Counter byteCounter dwordCounter wordCounter /end REF_MEASUREMENT
/end GROUP
/begin GROUP TimeControl "Time factors used for controlling the ECU clock." ROOT /begin REF_CHARACTERISTIC timeFactor /end REF_CHARACTERISTIC /end GROUP
/begin GROUP Virtual "Virtual Signals" ROOT /begin REF_MEASUREMENT DtChannel1 MaxChannel1 MinChannel1 /end REF_MEASUREMENT /end GROUP
/begin GROUP WorkingPoint "Example for working point" /begin REF_CHARACTERISTIC map1 map1Counter /end REF_CHARACTERISTIC /begin REF_MEASUREMENT map1InputX map1InputY map1Output /end REF_MEASUREMENT /end GROUP
/end MODULE
/end PROJECT
